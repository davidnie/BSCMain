VERSION "DNNBNNNYNNNNNNNNNNNNNNNNNNNNNNNNNNNNNNNNNN/4/%%%/4/'%**4NNN///"

NS_ :

BS_:

BU_: Vector__XXX xSolarWave xSolarSurveyor xSolarStorm xNova xMiata_SCP xMiata_AGS UI INV_CHG INV GATEWAY EMS DIAG CHG BMS BATTMON AGS

BO_ 2147569920 AcOutCfgOvRms: 223 DIAG
 SG_ RefEvtId : 40|16@1+ (1,0) [0|65532] "" DIAG,INV,INV_CHG,UI,xNova,xSolarWave
 SG_ OvLvlMin : 88|32@1- (0.001,0) [-2.14748E+06|2.14748E+06] "V" DIAG,INV,INV_CHG,UI,xNova,xSolarWave
 SG_ OvLvlMax : 120|32@1- (0.001,0) [-2.14748E+06|2.14748E+06] "V" DIAG,INV,INV_CHG,UI,xNova,xSolarWave
 SG_ OvLvl : 56|32@1- (0.001,0) [-2.14748E+06|2.14748E+06] "V" DIAG,INV,INV_CHG,UI,xNova,xSolarWave
 SG_ OvIntvlMin : 168|16@1+ (0.01,0) [0|655.32] "seconds" DIAG,INV,INV_CHG,UI,xNova,xSolarWave
 SG_ OvIntvlMax : 184|16@1+ (0.01,0) [0|655.32] "seconds" DIAG,INV,INV_CHG,UI,xNova,xSolarWave
 SG_ OvIntvl : 152|16@1+ (0.01,0) [0|655.32] "seconds" DIAG,INV,INV_CHG,UI,xNova,xSolarWave
 SG_ MsgCount : 2|6@1+ (1,0) [0|0] "" DIAG,INV,INV_CHG,UI,xNova,xSolarWave
 SG_ EvtId : 24|16@1+ (1,0) [0|65532] "" DIAG,INV,INV_CHG,UI,xNova,xSolarWave
 SG_ ConcurAccCtr : 8|8@1+ (1,0) [0|252] "" DIAG,INV,INV_CHG,UI,xNova,xSolarWave
 SG_ CfgType : 0|2@1+ (1,0) [0|0] "" DIAG,INV,INV_CHG,UI,xNova,xSolarWave
 SG_ AcSrcId : 16|8@1+ (1,0) [0|252] "" DIAG,INV,INV_CHG,UI,xNova,xSolarWave

BO_ 2147550720 AcOutCfg: 39 DIAG
 SG_ VoltageMin : 56|32@1+ (0.001,0) [0|4.29497E+06] "V" DIAG,INV,INV_CHG,UI,xNova,xSolarWave
 SG_ VoltageMax : 88|32@1+ (0.001,0) [0|4.29497E+06] "V" DIAG,INV,INV_CHG,UI,xNova,xSolarWave
 SG_ Voltage : 24|32@1+ (0.001,0) [0|4.29497E+06] "V" DIAG,INV,INV_CHG,UI,xNova,xSolarWave
 SG_ RealPwrMin : 248|32@1+ (1,0) [0|4.29497E+09] "W" DIAG,INV,INV_CHG,UI,xNova,xSolarWave
 SG_ RealPwrMax : 280|32@1+ (1,0) [0|4.29497E+09] "W" DIAG,INV,INV_CHG,UI,xNova,xSolarWave
 SG_ RealPwr : 216|32@1+ (1,0) [0|4.29497E+09] "W" DIAG,INV,INV_CHG,UI,xNova,xSolarWave
 SG_ MsgCount : 2|6@1+ (1,0) [0|0] "" DIAG,INV,INV_CHG,UI,xNova,xSolarWave
 SG_ FreqMin : 184|16@1+ (0.01,0) [0|655.32] "Hz" DIAG,INV,INV_CHG,UI,xNova,xSolarWave
 SG_ FreqMax : 200|16@1+ (0.01,0) [0|655.32] "Hz" DIAG,INV,INV_CHG,UI,xNova,xSolarWave
 SG_ Freq : 168|16@1+ (0.01,0) [0|655.32] "Hz" DIAG,INV,INV_CHG,UI,xNova,xSolarWave
 SG_ ConcurAccCtr : 8|8@1+ (1,0) [0|252] "" DIAG,INV,INV_CHG,UI,xNova,xSolarWave
 SG_ CfgType : 0|2@1+ (1,0) [0|0] "" DIAG,INV,INV_CHG,UI,xNova,xSolarWave
 SG_ BreakerSzMin : 136|16@1+ (0.01,0) [0|655.32] "A" DIAG,INV,INV_CHG,UI,xNova,xSolarWave
 SG_ BreakerSzMax : 152|16@1+ (0.01,0) [0|655.32] "A" DIAG,INV,INV_CHG,UI,xNova,xSolarWave
 SG_ BreakerSz : 120|16@1+ (0.01,0) [0|655.32] "A" DIAG,INV,INV_CHG,UI,xNova,xSolarWave
 SG_ AcSrcId : 16|8@1+ (1,0) [0|252] "" DIAG,INV,INV_CHG,UI,xNova,xSolarWave

BO_ 2147573760 AcLineCfg: 223 DIAG
 SG_ MsgCount : 2|6@1+ (1,0) [0|0] "" DIAG,INV_CHG,UI,xSolarWave
 SG_ ConcurAccCtr : 8|8@1+ (1,0) [0|252] "" DIAG,INV_CHG,UI,xSolarWave
 SG_ CfgType : 0|2@1+ (1,0) [0|0] "" DIAG,INV_CHG,UI,xSolarWave
 SG_ AcSrcId : 16|8@1+ (1,0) [0|252] "" DIAG,INV_CHG,UI,xSolarWave
 SG_ AcLineRemote : 32|8@1+ (1,0) [0|252] "" DIAG,INV_CHG,UI,xSolarWave
 SG_ AcLineLocal : 24|8@1+ (1,0) [0|252] "" DIAG,INV_CHG,UI,xSolarWave

BO_ 2147610627 AcInStsRms: 223 CHG
 SG_ Voltage : 32|32@1+ (0.001,0) [0|4.29497E+06] "V" AGS,CHG,DIAG,EMS,GATEWAY,INV_CHG,UI,xSolarWave
 SG_ RsvBits : 0|2@1+ (1,0) [0|0] "" AGS,CHG,DIAG,EMS,GATEWAY,INV_CHG,UI,xSolarWave
 SG_ RealPwr : 160|32@1+ (1,0) [0|4.29497E+09] "W" AGS,CHG,DIAG,EMS,GATEWAY,INV_CHG,UI,xSolarWave
 SG_ Quality : 24|8@1+ (1,0) [0|252] "" AGS,CHG,DIAG,EMS,GATEWAY,INV_CHG,UI,xSolarWave
 SG_ MsgCount : 2|6@1+ (1,0) [0|0] "" AGS,CHG,DIAG,EMS,GATEWAY,INV_CHG,UI,xSolarWave
 SG_ Line : 16|8@1+ (1,0) [0|252] "" AGS,CHG,DIAG,EMS,GATEWAY,INV_CHG,UI,xSolarWave
 SG_ Freq : 96|16@1+ (0.01,0) [0|655.32] "Hz" AGS,CHG,DIAG,EMS,GATEWAY,INV_CHG,UI,xSolarWave
 SG_ Current : 64|32@1+ (0.001,0) [0|4.29497E+06] "Amps" AGS,CHG,DIAG,EMS,GATEWAY,INV_CHG,UI,xSolarWave
 SG_ BreakerSz : 112|16@1+ (0.01,0) [0|655.32] "A" AGS,CHG,DIAG,EMS,GATEWAY,INV_CHG,UI,xSolarWave
 SG_ ApparentPwr : 128|32@1+ (1,0) [0|4.29497E+09] "VA" AGS,CHG,DIAG,EMS,GATEWAY,INV_CHG,UI,xSolarWave
 SG_ AcSrcId : 8|8@1+ (1,0) [0|252] "" AGS,CHG,DIAG,EMS,GATEWAY,INV_CHG,UI,xSolarWave

BO_ 2147610628 AcInStsPeak: 223 CHG
 SG_ Voltage : 32|32@1+ (0.001,0) [0|4.29497E+06] "V" AGS,CHG,DIAG,INV_CHG,UI
 SG_ RsvBits : 0|2@1+ (1,0) [0|0] "" AGS,CHG,DIAG,INV_CHG,UI
 SG_ RealPwr : 160|32@1+ (1,0) [0|4.29497E+09] "W" AGS,CHG,DIAG,INV_CHG,UI
 SG_ Quality : 24|8@1+ (1,0) [0|252] "" AGS,CHG,DIAG,INV_CHG,UI
 SG_ MsgCount : 2|6@1+ (1,0) [0|0] "" AGS,CHG,DIAG,INV_CHG,UI
 SG_ Line : 16|8@1+ (1,0) [0|252] "" AGS,CHG,DIAG,INV_CHG,UI
 SG_ Freq : 96|16@1+ (0.01,0) [0|655.32] "Hz" AGS,CHG,DIAG,INV_CHG,UI
 SG_ Current : 64|32@1+ (0.001,0) [0|4.29497E+06] "Amps" AGS,CHG,DIAG,INV_CHG,UI
 SG_ BreakerSz : 112|16@1+ (0.01,0) [0|655.32] "A" AGS,CHG,DIAG,INV_CHG,UI
 SG_ ApparentPwr : 128|32@1+ (1,0) [0|4.29497E+09] "VA" AGS,CHG,DIAG,INV_CHG,UI
 SG_ AcSrcId : 8|8@1+ (1,0) [0|252] "" AGS,CHG,DIAG,INV_CHG,UI

BO_ 2147610629 AcInStsAvg: 223 CHG
 SG_ Voltage : 32|32@1+ (0.001,0) [0|4.29497E+06] "V" AGS,CHG,DIAG,INV_CHG,UI
 SG_ RsvBits : 0|2@1+ (1,0) [0|0] "" AGS,CHG,DIAG,INV_CHG,UI
 SG_ RealPwr : 160|32@1+ (1,0) [0|4.29497E+09] "W" AGS,CHG,DIAG,INV_CHG,UI
 SG_ Quality : 24|8@1+ (1,0) [0|252] "" AGS,CHG,DIAG,INV_CHG,UI
 SG_ MsgCount : 2|6@1+ (1,0) [0|0] "" AGS,CHG,DIAG,INV_CHG,UI
 SG_ Line : 16|8@1+ (1,0) [0|252] "" AGS,CHG,DIAG,INV_CHG,UI
 SG_ Freq : 96|16@1+ (0.01,0) [0|655.32] "Hz" AGS,CHG,DIAG,INV_CHG,UI
 SG_ Current : 64|32@1+ (0.001,0) [0|4.29497E+06] "Amps" AGS,CHG,DIAG,INV_CHG,UI
 SG_ BreakerSz : 112|16@1+ (0.01,0) [0|655.32] "A" AGS,CHG,DIAG,INV_CHG,UI
 SG_ ApparentPwr : 128|32@1+ (1,0) [0|4.29497E+09] "VA" AGS,CHG,DIAG,INV_CHG,UI
 SG_ AcSrcId : 8|8@1+ (1,0) [0|252] "" AGS,CHG,DIAG,INV_CHG,UI

BO_ 2147550976 AcInCfgUvRms: 223 CHG
 SG_ UvLvlMin : 88|32@1- (0.001,0) [-2.14748E+06|2.14748E+06] "V" CHG,DIAG,INV_CHG,UI,xNova,xSolarWave
 SG_ UvLvlMax : 120|32@1- (0.001,0) [-2.14748E+06|2.14748E+06] "V" CHG,DIAG,INV_CHG,UI,xNova,xSolarWave
 SG_ UvLvl : 56|32@1- (0.001,0) [-2.14748E+06|2.14748E+06] "V" CHG,DIAG,INV_CHG,UI,xNova,xSolarWave
 SG_ UvIntvlMin : 168|16@1+ (0.01,0) [0|655.32] "seconds" CHG,DIAG,INV_CHG,UI,xNova,xSolarWave
 SG_ UvIntvlMax : 184|16@1+ (0.01,0) [0|655.32] "seconds" CHG,DIAG,INV_CHG,UI,xNova,xSolarWave
 SG_ UvIntvl : 152|16@1+ (0.01,0) [0|655.32] "seconds" CHG,DIAG,INV_CHG,UI,xNova,xSolarWave
 SG_ RefEvtId : 40|16@1+ (1,0) [0|65532] "" CHG,DIAG,INV_CHG,UI,xNova,xSolarWave
 SG_ MsgCount : 2|6@1+ (1,0) [0|0] "" CHG,DIAG,INV_CHG,UI,xNova,xSolarWave
 SG_ EvtId : 24|16@1+ (1,0) [0|65532] "" CHG,DIAG,INV_CHG,UI,xNova,xSolarWave
 SG_ ConcurAccCtr : 8|8@1+ (1,0) [0|252] "" CHG,DIAG,INV_CHG,UI,xNova,xSolarWave
 SG_ CfgType : 0|2@1+ (1,0) [0|0] "" CHG,DIAG,INV_CHG,UI,xNova,xSolarWave
 SG_ AcSrcId : 16|8@1+ (1,0) [0|252] "" CHG,DIAG,INV_CHG,UI,xNova,xSolarWave

BO_ 2147551232 AcInCfgUvPeak: 223 CHG
 SG_ UvLvlMin : 88|32@1- (0.001,0) [-2.14748E+06|2.14748E+06] "V" CHG,DIAG,INV_CHG,UI
 SG_ UvLvlMax : 120|32@1- (0.001,0) [-2.14748E+06|2.14748E+06] "V" CHG,DIAG,INV_CHG,UI
 SG_ UvLvl : 56|32@1- (0.001,0) [-2.14748E+06|2.14748E+06] "V" CHG,DIAG,INV_CHG,UI
 SG_ UvIntvlMin : 168|16@1+ (0.01,0) [0|655.32] "seconds" CHG,DIAG,INV_CHG,UI
 SG_ UvIntvlMax : 184|16@1+ (0.01,0) [0|655.32] "seconds" CHG,DIAG,INV_CHG,UI
 SG_ UvIntvl : 152|16@1+ (0.01,0) [0|655.32] "seconds" CHG,DIAG,INV_CHG,UI
 SG_ RefEvtId : 40|16@1+ (1,0) [0|65532] "" CHG,DIAG,INV_CHG,UI
 SG_ MsgCount : 2|6@1+ (1,0) [0|0] "" CHG,DIAG,INV_CHG,UI
 SG_ EvtId : 24|16@1+ (1,0) [0|65532] "" CHG,DIAG,INV_CHG,UI
 SG_ ConcurAccCtr : 8|8@1+ (1,0) [0|252] "" CHG,DIAG,INV_CHG,UI
 SG_ CfgType : 0|2@1+ (1,0) [0|0] "" CHG,DIAG,INV_CHG,UI
 SG_ AcSrcId : 16|8@1+ (1,0) [0|252] "" CHG,DIAG,INV_CHG,UI

BO_ 2147551488 AcInCfgUvAvg: 223 CHG
 SG_ UvLvlMin : 88|32@1- (0.001,0) [-2.14748E+06|2.14748E+06] "V" CHG,DIAG,INV_CHG,UI
 SG_ UvLvlMax : 120|32@1- (0.001,0) [-2.14748E+06|2.14748E+06] "V" CHG,DIAG,INV_CHG,UI
 SG_ UvLvl : 56|32@1- (0.001,0) [-2.14748E+06|2.14748E+06] "V" CHG,DIAG,INV_CHG,UI
 SG_ UvIntvlMin : 168|16@1+ (0.01,0) [0|655.32] "seconds" CHG,DIAG,INV_CHG,UI
 SG_ UvIntvlMax : 184|16@1+ (0.01,0) [0|655.32] "seconds" CHG,DIAG,INV_CHG,UI
 SG_ UvIntvl : 152|16@1+ (0.01,0) [0|655.32] "seconds" CHG,DIAG,INV_CHG,UI
 SG_ RefEvtId : 40|16@1+ (1,0) [0|65532] "" CHG,DIAG,INV_CHG,UI
 SG_ MsgCount : 2|6@1+ (1,0) [0|0] "" CHG,DIAG,INV_CHG,UI
 SG_ EvtId : 24|16@1+ (1,0) [0|65532] "" CHG,DIAG,INV_CHG,UI
 SG_ ConcurAccCtr : 8|8@1+ (1,0) [0|252] "" CHG,DIAG,INV_CHG,UI
 SG_ CfgType : 0|2@1+ (1,0) [0|0] "" CHG,DIAG,INV_CHG,UI
 SG_ AcSrcId : 16|8@1+ (1,0) [0|252] "" CHG,DIAG,INV_CHG,UI

BO_ 2147569408 AcInCfgUf: 223 CHG
 SG_ UfLvlMin : 72|16@1- (0.01,0) [-327.68|327.64] "Hz" CHG,DIAG,INV_CHG,UI,xNova,xSolarWave
 SG_ UfLvlMax : 88|16@1- (0.01,0) [-327.68|327.64] "Hz" CHG,DIAG,INV_CHG,UI,xNova,xSolarWave
 SG_ UfLvl : 56|16@1- (0.01,0) [-327.68|327.64] "Hz" CHG,DIAG,INV_CHG,UI,xNova,xSolarWave
 SG_ UfIntvlMin : 120|16@1+ (0.01,0) [0|655.32] "seconds" CHG,DIAG,INV_CHG,UI,xNova,xSolarWave
 SG_ UfIntvlMax : 136|16@1+ (0.01,0) [0|655.32] "seconds" CHG,DIAG,INV_CHG,UI,xNova,xSolarWave
 SG_ UfIntvl : 104|16@1+ (0.01,0) [0|655.32] "seconds" CHG,DIAG,INV_CHG,UI,xNova,xSolarWave
 SG_ RefEvtId : 40|16@1+ (1,0) [0|65532] "" CHG,DIAG,INV_CHG,UI,xNova,xSolarWave
 SG_ MsgCount : 2|6@1+ (1,0) [0|0] "" CHG,DIAG,INV_CHG,UI,xNova,xSolarWave
 SG_ EvtId : 24|16@1+ (1,0) [0|65532] "" CHG,DIAG,INV_CHG,UI,xNova,xSolarWave
 SG_ ConcurAccCtr : 8|8@1+ (1,0) [0|252] "" CHG,DIAG,INV_CHG,UI,xNova,xSolarWave
 SG_ CfgType : 0|2@1+ (1,0) [0|0] "" CHG,DIAG,INV_CHG,UI,xNova,xSolarWave
 SG_ AcSrcId : 16|8@1+ (1,0) [0|252] "" CHG,DIAG,INV_CHG,UI,xNova,xSolarWave

BO_ 2147551744 AcInCfgOvRms: 223 CHG
 SG_ RefEvtId : 40|16@1+ (1,0) [0|65532] "" CHG,DIAG,INV_CHG,UI,xNova,xSolarWave
 SG_ OvLvlMin : 88|32@1- (0.001,0) [-2.14748E+06|2.14748E+06] "V" CHG,DIAG,INV_CHG,UI,xNova,xSolarWave
 SG_ OvLvlMax : 120|32@1- (0.001,0) [-2.14748E+06|2.14748E+06] "V" CHG,DIAG,INV_CHG,UI,xNova,xSolarWave
 SG_ OvLvl : 56|32@1- (0.001,0) [-2.14748E+06|2.14748E+06] "V" CHG,DIAG,INV_CHG,UI,xNova,xSolarWave
 SG_ OvIntvlMin : 168|16@1+ (0.01,0) [0|655.32] "seconds" CHG,DIAG,INV_CHG,UI,xNova,xSolarWave
 SG_ OvIntvlMax : 184|16@1+ (0.01,0) [0|655.32] "seconds" CHG,DIAG,INV_CHG,UI,xNova,xSolarWave
 SG_ OvIntvl : 152|16@1+ (0.01,0) [0|655.32] "seconds" CHG,DIAG,INV_CHG,UI,xNova,xSolarWave
 SG_ MsgCount : 2|6@1+ (1,0) [0|0] "" CHG,DIAG,INV_CHG,UI,xNova,xSolarWave
 SG_ EvtId : 24|16@1+ (1,0) [0|65532] "" CHG,DIAG,INV_CHG,UI,xNova,xSolarWave
 SG_ ConcurAccCtr : 8|8@1+ (1,0) [0|252] "" CHG,DIAG,INV_CHG,UI,xNova,xSolarWave
 SG_ CfgType : 0|2@1+ (1,0) [0|0] "" CHG,DIAG,INV_CHG,UI,xNova,xSolarWave
 SG_ AcSrcId : 16|8@1+ (1,0) [0|252] "" CHG,DIAG,INV_CHG,UI,xNova,xSolarWave

BO_ 2147552000 AcInCfgOvPeak: 223 CHG
 SG_ RefEvtId : 40|16@1+ (1,0) [0|65532] "" CHG,DIAG,INV_CHG,UI
 SG_ OvLvlMin : 88|32@1- (0.001,0) [-2.14748E+06|2.14748E+06] "V" CHG,DIAG,INV_CHG,UI
 SG_ OvLvlMax : 120|32@1- (0.001,0) [-2.14748E+06|2.14748E+06] "V" CHG,DIAG,INV_CHG,UI
 SG_ OvLvl : 56|32@1- (0.001,0) [-2.14748E+06|2.14748E+06] "V" CHG,DIAG,INV_CHG,UI
 SG_ OvIntvlMin : 168|16@1+ (0.01,0) [0|655.32] "seconds" CHG,DIAG,INV_CHG,UI
 SG_ OvIntvlMax : 184|16@1+ (0.01,0) [0|655.32] "seconds" CHG,DIAG,INV_CHG,UI
 SG_ OvIntvl : 152|16@1+ (0.01,0) [0|655.32] "seconds" CHG,DIAG,INV_CHG,UI
 SG_ MsgCount : 2|6@1+ (1,0) [0|0] "" CHG,DIAG,INV_CHG,UI
 SG_ EvtId : 24|16@1+ (1,0) [0|65532] "" CHG,DIAG,INV_CHG,UI
 SG_ ConcurAccCtr : 8|8@1+ (1,0) [0|252] "" CHG,DIAG,INV_CHG,UI
 SG_ CfgType : 0|2@1+ (1,0) [0|0] "" CHG,DIAG,INV_CHG,UI
 SG_ AcSrcId : 16|8@1+ (1,0) [0|252] "" CHG,DIAG,INV_CHG,UI

BO_ 2147552256 AcInCfgOvAvg: 223 CHG
 SG_ RefEvtId : 40|16@1+ (1,0) [0|65532] "" CHG,DIAG,INV_CHG,UI
 SG_ OvLvlMin : 88|32@1- (0.001,0) [-2.14748E+06|2.14748E+06] "V" CHG,DIAG,INV_CHG,UI
 SG_ OvLvlMax : 120|32@1- (0.001,0) [-2.14748E+06|2.14748E+06] "V" CHG,DIAG,INV_CHG,UI
 SG_ OvLvl : 56|32@1- (0.001,0) [-2.14748E+06|2.14748E+06] "V" CHG,DIAG,INV_CHG,UI
 SG_ OvIntvlMin : 168|16@1+ (0.01,0) [0|655.32] "seconds" CHG,DIAG,INV_CHG,UI
 SG_ OvIntvlMax : 184|16@1+ (0.01,0) [0|655.32] "seconds" CHG,DIAG,INV_CHG,UI
 SG_ OvIntvl : 152|16@1+ (0.01,0) [0|655.32] "seconds" CHG,DIAG,INV_CHG,UI
 SG_ MsgCount : 2|6@1+ (1,0) [0|0] "" CHG,DIAG,INV_CHG,UI
 SG_ EvtId : 24|16@1+ (1,0) [0|65532] "" CHG,DIAG,INV_CHG,UI
 SG_ ConcurAccCtr : 8|8@1+ (1,0) [0|252] "" CHG,DIAG,INV_CHG,UI
 SG_ CfgType : 0|2@1+ (1,0) [0|0] "" CHG,DIAG,INV_CHG,UI
 SG_ AcSrcId : 16|8@1+ (1,0) [0|252] "" CHG,DIAG,INV_CHG,UI

BO_ 2147569152 AcInCfgOf: 223 CHG
 SG_ RefEvtId : 40|16@1+ (1,0) [0|65532] "" CHG,DIAG,INV_CHG,UI,xNova,xSolarWave
 SG_ OfLvlMin : 72|16@1- (0.01,0) [-327.68|327.64] "Hz" CHG,DIAG,INV_CHG,UI,xNova,xSolarWave
 SG_ OfLvlMax : 88|16@1- (0.01,0) [-327.68|327.64] "Hz" CHG,DIAG,INV_CHG,UI,xNova,xSolarWave
 SG_ OfLvl : 56|16@1- (0.01,0) [-327.68|327.64] "Hz" CHG,DIAG,INV_CHG,UI,xNova,xSolarWave
 SG_ OfIntvlMin : 120|16@1+ (0.01,0) [0|655.32] "seconds" CHG,DIAG,INV_CHG,UI,xNova,xSolarWave
 SG_ OfIntvlMax : 136|16@1+ (0.01,0) [0|655.32] "seconds" CHG,DIAG,INV_CHG,UI,xNova,xSolarWave
 SG_ OfIntvl : 104|16@1+ (0.01,0) [0|655.32] "seconds" CHG,DIAG,INV_CHG,UI,xNova,xSolarWave
 SG_ MsgCount : 2|6@1+ (1,0) [0|0] "" CHG,DIAG,INV_CHG,UI,xNova,xSolarWave
 SG_ EvtId : 24|16@1+ (1,0) [0|65532] "" CHG,DIAG,INV_CHG,UI,xNova,xSolarWave
 SG_ ConcurAccCtr : 8|8@1+ (1,0) [0|252] "" CHG,DIAG,INV_CHG,UI,xNova,xSolarWave
 SG_ CfgType : 0|2@1+ (1,0) [0|0] "" CHG,DIAG,INV_CHG,UI,xNova,xSolarWave
 SG_ AcSrcId : 16|8@1+ (1,0) [0|252] "" CHG,DIAG,INV_CHG,UI,xNova,xSolarWave

BO_ 2147558912 AcInCfg: 45 CHG
 SG_ VoltageMin : 56|32@1+ (0.001,0) [0|4.29497E+06] "V" CHG,DIAG,INV_CHG,UI,xNova,xSolarWave
 SG_ VoltageMax : 88|32@1+ (0.001,0) [0|4.29497E+06] "V" CHG,DIAG,INV_CHG,UI,xNova,xSolarWave
 SG_ Voltage : 24|32@1+ (0.001,0) [0|4.29497E+06] "V" CHG,DIAG,INV_CHG,UI,xNova,xSolarWave
 SG_ UnitBreakerSzMin : 136|16@1+ (0.01,0) [0|655.32] "A" CHG,DIAG,INV_CHG,UI,xNova,xSolarWave
 SG_ UnitBreakerSzMax : 152|16@1+ (0.01,0) [0|655.32] "A" CHG,DIAG,INV_CHG,UI,xNova,xSolarWave
 SG_ UnitBreakerSz : 120|16@1+ (0.01,0) [0|655.32] "A" CHG,DIAG,INV_CHG,UI,xNova,xSolarWave
 SG_ SrcBreakerSzMin : 328|16@1+ (0.01,0) [0|655.32] "A" CHG,DIAG,INV_CHG,UI,xNova,xSolarWave
 SG_ SrcBreakerSzMax : 344|16@1+ (0.01,0) [0|655.32] "A" CHG,DIAG,INV_CHG,UI,xNova,xSolarWave
 SG_ SrcBreakerSz : 312|16@1+ (0.01,0) [0|655.32] "A" CHG,DIAG,INV_CHG,UI,xNova,xSolarWave
 SG_ RealPwrMin : 248|32@1+ (1,0) [0|4.29497E+09] "W" CHG,DIAG,INV_CHG,UI,xNova,xSolarWave
 SG_ RealPwrMax : 280|32@1+ (1,0) [0|4.29497E+09] "W" CHG,DIAG,INV_CHG,UI,xNova,xSolarWave
 SG_ RealPwr : 216|32@1+ (1,0) [0|4.29497E+09] "W" CHG,DIAG,INV_CHG,UI,xNova,xSolarWave
 SG_ MsgCount : 2|6@1+ (1,0) [0|0] "" CHG,DIAG,INV_CHG,UI,xNova,xSolarWave
 SG_ FreqMin : 184|16@1+ (0.01,0) [0|655.32] "Hz" CHG,DIAG,INV_CHG,UI,xNova,xSolarWave
 SG_ FreqMax : 200|16@1+ (0.01,0) [0|655.32] "Hz" CHG,DIAG,INV_CHG,UI,xNova,xSolarWave
 SG_ Freq : 168|16@1+ (0.01,0) [0|655.32] "Hz" CHG,DIAG,INV_CHG,UI,xNova,xSolarWave
 SG_ ConcurAccCtr : 8|8@1+ (1,0) [0|252] "" CHG,DIAG,INV_CHG,UI,xNova,xSolarWave
 SG_ CfgType : 0|2@1+ (1,0) [0|0] "" CHG,DIAG,INV_CHG,UI,xNova,xSolarWave
 SG_ AcSrcId : 16|8@1+ (1,0) [0|252] "" CHG,DIAG,INV_CHG,UI,xNova,xSolarWave

BO_TX_BU_ 2147569920 : xSolarWave,INV,UI,INV_CHG,DIAG,xNova;
BO_TX_BU_ 2147550720 : xSolarWave,INV,UI,INV_CHG,DIAG,xNova;
BO_TX_BU_ 2147573760 : xSolarWave,UI,INV_CHG,DIAG;
BO_TX_BU_ 2147610627 : xSolarWave,CHG,INV_CHG,DIAG,xNova,EMS;
BO_TX_BU_ 2147610628 : CHG,INV_CHG,DIAG;
BO_TX_BU_ 2147610629 : CHG,INV_CHG,DIAG;
BO_TX_BU_ 2147550976 : xSolarWave,CHG,UI,INV_CHG,DIAG,xNova;
BO_TX_BU_ 2147551232 : CHG,UI,INV_CHG,DIAG;
BO_TX_BU_ 2147551488 : CHG,UI,INV_CHG,DIAG;
BO_TX_BU_ 2147569408 : xSolarWave,CHG,UI,INV_CHG,DIAG,xNova;
BO_TX_BU_ 2147551744 : xSolarWave,CHG,UI,INV_CHG,DIAG,xNova;
BO_TX_BU_ 2147552000 : CHG,UI,INV_CHG,DIAG;
BO_TX_BU_ 2147552256 : CHG,UI,INV_CHG,DIAG;
BO_TX_BU_ 2147569152 : xSolarWave,CHG,UI,INV_CHG,DIAG,xNova;
BO_TX_BU_ 2147558912 : xSolarWave,CHG,UI,INV_CHG,DIAG,xNova;
CM_ BO_ 2147569920 "AC Output Configuration - Over Voltage - RMS";
CM_ SG_ 2147569920 RefEvtId "Reference Event Identifier";
CM_ SG_ 2147569920 OvLvlMin "Over Voltage Level - Minimum";
CM_ SG_ 2147569920 OvLvlMax "Over Voltage Level - Maximum";
CM_ SG_ 2147569920 OvLvl "Over Voltage Level";
CM_ SG_ 2147569920 OvIntvlMin "Over Voltage Interval - Minimum";
CM_ SG_ 2147569920 OvIntvlMax "Over Voltage Interval - Maximum";
CM_ SG_ 2147569920 OvIntvl "Over Voltage Interval";
CM_ SG_ 2147569920 MsgCount "Message Count";
CM_ SG_ 2147569920 EvtId "Event Identifier";
CM_ SG_ 2147569920 ConcurAccCtr "Concurrent Access Counter";
CM_ SG_ 2147569920 CfgType "Configuration Type";
CM_ SG_ 2147569920 AcSrcId "AC Source Identifer";
CM_ BO_ 2147550720 "AC Output Configuration";
CM_ SG_ 2147550720 VoltageMin "Voltage - Minimum";
CM_ SG_ 2147550720 VoltageMax "Voltage - Maximum";
CM_ SG_ 2147550720 Voltage "Voltage";
CM_ SG_ 2147550720 RealPwrMin "Real Power - Minimum";
CM_ SG_ 2147550720 RealPwrMax "Real Power - Maximum";
CM_ SG_ 2147550720 RealPwr "Real Power";
CM_ SG_ 2147550720 MsgCount "Message Count";
CM_ SG_ 2147550720 FreqMin "Frequency - Minimum";
CM_ SG_ 2147550720 FreqMax "Frequency - Maximum";
CM_ SG_ 2147550720 Freq "Frequency";
CM_ SG_ 2147550720 ConcurAccCtr "Concurrent Access Counter";
CM_ SG_ 2147550720 CfgType "Configuration Type";
CM_ SG_ 2147550720 BreakerSzMin "Breaker Size - Minimum";
CM_ SG_ 2147550720 BreakerSzMax "Breaker Size - Maximum";
CM_ SG_ 2147550720 BreakerSz "Breaker Size";
CM_ SG_ 2147550720 AcSrcId "AC Source Identifer";
CM_ BO_ 2147573760 "AC Line Configuration";
CM_ SG_ 2147573760 MsgCount "Message Count";
CM_ SG_ 2147573760 ConcurAccCtr "Concurrent Access Counter";
CM_ SG_ 2147573760 CfgType "Configuration Type";
CM_ SG_ 2147573760 AcSrcId "AC Source Identifier";
CM_ SG_ 2147573760 AcLineRemote "Remote AC Line";
CM_ SG_ 2147573760 AcLineLocal "Local AC Line";
CM_ BO_ 2147610627 "AC Input Status - RMS";
CM_ SG_ 2147610627 Voltage "Voltage";
CM_ SG_ 2147610627 RsvBits "Reserved Bits";
CM_ SG_ 2147610627 RealPwr "Real Power";
CM_ SG_ 2147610627 Quality "Quality";
CM_ SG_ 2147610627 MsgCount "Message Count";
CM_ SG_ 2147610627 Line "Line";
CM_ SG_ 2147610627 Freq "Frequency";
CM_ SG_ 2147610627 Current "Current";
CM_ SG_ 2147610627 BreakerSz "Breaker Size";
CM_ SG_ 2147610627 ApparentPwr "Apparent Power";
CM_ SG_ 2147610627 AcSrcId "AC Source Identifer";
CM_ BO_ 2147610628 "AC Input Status - Peak";
CM_ SG_ 2147610628 Voltage "Voltage";
CM_ SG_ 2147610628 RsvBits "Reserved Bits";
CM_ SG_ 2147610628 RealPwr "Real Power";
CM_ SG_ 2147610628 Quality "Quality";
CM_ SG_ 2147610628 MsgCount "Message Count";
CM_ SG_ 2147610628 Line "Line";
CM_ SG_ 2147610628 Freq "Frequency";
CM_ SG_ 2147610628 Current "Current";
CM_ SG_ 2147610628 BreakerSz "Breaker Size";
CM_ SG_ 2147610628 ApparentPwr "Apparent Power";
CM_ SG_ 2147610628 AcSrcId "AC Source Identifer";
CM_ BO_ 2147610629 "AC Input Status - Average";
CM_ SG_ 2147610629 Voltage "Voltage";
CM_ SG_ 2147610629 RsvBits "Reserved Bits";
CM_ SG_ 2147610629 RealPwr "Real Power";
CM_ SG_ 2147610629 Quality "Quality";
CM_ SG_ 2147610629 MsgCount "Message Count";
CM_ SG_ 2147610629 Line "Line";
CM_ SG_ 2147610629 Freq "Frequency";
CM_ SG_ 2147610629 Current "Current";
CM_ SG_ 2147610629 BreakerSz "Breaker Size";
CM_ SG_ 2147610629 ApparentPwr "Apparent Power";
CM_ SG_ 2147610629 AcSrcId "AC Source Identifer";
CM_ BO_ 2147550976 "AC Input Configuration - Under Voltage - RMS";
CM_ SG_ 2147550976 UvLvlMin "Under Voltage Level - Minimum";
CM_ SG_ 2147550976 UvLvlMax "Under Voltage Level - Maximum";
CM_ SG_ 2147550976 UvLvl "Under Voltage Level";
CM_ SG_ 2147550976 UvIntvlMin "Under Voltage Interval - Minimum";
CM_ SG_ 2147550976 UvIntvlMax "Under Voltage Interval - Maximum";
CM_ SG_ 2147550976 UvIntvl "Under Voltage Interval";
CM_ SG_ 2147550976 RefEvtId "Reference Event Identifier";
CM_ SG_ 2147550976 MsgCount "Message Count";
CM_ SG_ 2147550976 EvtId "Event Identifier";
CM_ SG_ 2147550976 ConcurAccCtr "Concurrent Access Counter";
CM_ SG_ 2147550976 CfgType "Configuration Type";
CM_ SG_ 2147550976 AcSrcId "AC Source Identifer";
CM_ BO_ 2147551232 "AC Input Configuration - Under Voltage - Peak";
CM_ SG_ 2147551232 UvLvlMin "Under Voltage Level - Minimum";
CM_ SG_ 2147551232 UvLvlMax "Under Voltage Level - Maximum";
CM_ SG_ 2147551232 UvLvl "Under Voltage Level";
CM_ SG_ 2147551232 UvIntvlMin "Under Voltage Interval - Minimum";
CM_ SG_ 2147551232 UvIntvlMax "Under Voltage Interval - Maximum";
CM_ SG_ 2147551232 UvIntvl "Under Voltage Interval";
CM_ SG_ 2147551232 RefEvtId "Reference Event Identifier";
CM_ SG_ 2147551232 MsgCount "Message Count";
CM_ SG_ 2147551232 EvtId "Event Identifier";
CM_ SG_ 2147551232 ConcurAccCtr "Concurrent Access Counter";
CM_ SG_ 2147551232 CfgType "Configuration Type";
CM_ SG_ 2147551232 AcSrcId "AC Source Identifer";
CM_ BO_ 2147551488 "AC Input Configuration - Under Voltage - Average";
CM_ SG_ 2147551488 UvLvlMin "Under Voltage Level - Minimum";
CM_ SG_ 2147551488 UvLvlMax "Under Voltage Level - Maximum";
CM_ SG_ 2147551488 UvLvl "Under Voltage Level";
CM_ SG_ 2147551488 UvIntvlMin "Under Voltage Interval - Minimum";
CM_ SG_ 2147551488 UvIntvlMax "Under Voltage Interval - Maximum";
CM_ SG_ 2147551488 UvIntvl "Under Voltage Interval";
CM_ SG_ 2147551488 RefEvtId "Reference Event Identifier";
CM_ SG_ 2147551488 MsgCount "Message Count";
CM_ SG_ 2147551488 EvtId "Event Identifier";
CM_ SG_ 2147551488 ConcurAccCtr "Concurrent Access Counter";
CM_ SG_ 2147551488 CfgType "Configuration Type";
CM_ SG_ 2147551488 AcSrcId "AC Source Identifer";
CM_ BO_ 2147569408 "AC Input Configuration - Under Frequency";
CM_ SG_ 2147569408 UfLvlMin "Under Frequency Level - Minimum";
CM_ SG_ 2147569408 UfLvlMax "Under Frequency Level - Maximum";
CM_ SG_ 2147569408 UfLvl "Under Frequency Level";
CM_ SG_ 2147569408 UfIntvlMin "Under Frequency Interval - Minimum";
CM_ SG_ 2147569408 UfIntvlMax "Under Frequency Interval - Maximum";
CM_ SG_ 2147569408 UfIntvl "Under Frequency Interval";
CM_ SG_ 2147569408 RefEvtId "Reference Event Identifier";
CM_ SG_ 2147569408 MsgCount "Message Count";
CM_ SG_ 2147569408 EvtId "Event Identifier";
CM_ SG_ 2147569408 ConcurAccCtr "Concurrent Access Counter";
CM_ SG_ 2147569408 CfgType "Configuration Type";
CM_ SG_ 2147569408 AcSrcId "AC Source Identifer";
CM_ BO_ 2147551744 "AC Input Configuration - Over Voltage - RMS";
CM_ SG_ 2147551744 RefEvtId "Reference Event Identifier";
CM_ SG_ 2147551744 OvLvlMin "Over Voltage Level - Minimum";
CM_ SG_ 2147551744 OvLvlMax "Over Voltage Level - Maximum";
CM_ SG_ 2147551744 OvLvl "Over Voltage Level";
CM_ SG_ 2147551744 OvIntvlMin "Over Voltage Interval - Minimum";
CM_ SG_ 2147551744 OvIntvlMax "Over Voltage Interval - Maximum";
CM_ SG_ 2147551744 OvIntvl "Over Voltage Interval";
CM_ SG_ 2147551744 MsgCount "Message Count";
CM_ SG_ 2147551744 EvtId "Event Identifier";
CM_ SG_ 2147551744 ConcurAccCtr "Concurrent Access Counter";
CM_ SG_ 2147551744 CfgType "Configuration Type";
CM_ SG_ 2147551744 AcSrcId "AC Source Identifer";
CM_ BO_ 2147552000 "AC Input Configuration - Over Voltage - Peak";
CM_ SG_ 2147552000 RefEvtId "Reference Event Identifier";
CM_ SG_ 2147552000 OvLvlMin "Over Voltage Level - Minimum";
CM_ SG_ 2147552000 OvLvlMax "Over Voltage Level - Maximum";
CM_ SG_ 2147552000 OvLvl "Over Voltage Level";
CM_ SG_ 2147552000 OvIntvlMin "Over Voltage Interval - Minimum";
CM_ SG_ 2147552000 OvIntvlMax "Over Voltage Interval - Maximum";
CM_ SG_ 2147552000 OvIntvl "Over Voltage Interval";
CM_ SG_ 2147552000 MsgCount "Message Count";
CM_ SG_ 2147552000 EvtId "Event Identifier";
CM_ SG_ 2147552000 ConcurAccCtr "Concurrent Access Counter";
CM_ SG_ 2147552000 CfgType "Configuration Type";
CM_ SG_ 2147552000 AcSrcId "AC Source Identifer";
CM_ BO_ 2147552256 "AC Input Configuration - Over Voltage - Average";
CM_ SG_ 2147552256 RefEvtId "Reference Event Identifier";
CM_ SG_ 2147552256 OvLvlMin "Over Voltage Level - Minimum";
CM_ SG_ 2147552256 OvLvlMax "Over Voltage Level - Maximum";
CM_ SG_ 2147552256 OvLvl "Over Voltage Level";
CM_ SG_ 2147552256 OvIntvlMin "Over Voltage Interval - Minimum";
CM_ SG_ 2147552256 OvIntvlMax "Over Voltage Interval - Maximum";
CM_ SG_ 2147552256 OvIntvl "Over Voltage Interval";
CM_ SG_ 2147552256 MsgCount "Message Count";
CM_ SG_ 2147552256 EvtId "Event Identifier";
CM_ SG_ 2147552256 ConcurAccCtr "Concurrent Access Counter";
CM_ SG_ 2147552256 CfgType "Configuration Type";
CM_ SG_ 2147552256 AcSrcId "AC Source Identifer";
CM_ BO_ 2147569152 "AC Input Configuration - Over Frequency";
CM_ SG_ 2147569152 RefEvtId "Reference Event Identifier";
CM_ SG_ 2147569152 OfLvlMin "Over Frequency Level - Minimum";
CM_ SG_ 2147569152 OfLvlMax "Over Frequency Level - Maximum";
CM_ SG_ 2147569152 OfLvl "Over Frequency Level";
CM_ SG_ 2147569152 OfIntvlMin "Over Frequency Interval - Minimum";
CM_ SG_ 2147569152 OfIntvlMax "Over Frequency Interval - Maximum";
CM_ SG_ 2147569152 OfIntvl "Over Frequency Interval";
CM_ SG_ 2147569152 MsgCount "Message Count";
CM_ SG_ 2147569152 EvtId "Event Identifier";
CM_ SG_ 2147569152 ConcurAccCtr "Concurrent Access Counter";
CM_ SG_ 2147569152 CfgType "Configuration Type";
CM_ SG_ 2147569152 AcSrcId "AC Source Identifer";
CM_ BO_ 2147558912 "AC Input Configuration";
CM_ SG_ 2147558912 VoltageMin "Voltage - Minimum";
CM_ SG_ 2147558912 VoltageMax "Voltage - Maximum";
CM_ SG_ 2147558912 Voltage "Voltage";
CM_ SG_ 2147558912 UnitBreakerSzMin "Unit Breaker Size - Minimum";
CM_ SG_ 2147558912 UnitBreakerSzMax "Unit Breaker Size - Maximum";
CM_ SG_ 2147558912 UnitBreakerSz "Unit Breaker Size";
CM_ SG_ 2147558912 SrcBreakerSzMin "Source Breaker Size - Minimum";
CM_ SG_ 2147558912 SrcBreakerSzMax "Source Breaker Size - Maximum";
CM_ SG_ 2147558912 SrcBreakerSz "Source Breaker Size";
CM_ SG_ 2147558912 RealPwrMin "Real Power - Minimum";
CM_ SG_ 2147558912 RealPwrMax "Real Power - Maximum";
CM_ SG_ 2147558912 RealPwr "Real Power";
CM_ SG_ 2147558912 MsgCount "Message Count";
CM_ SG_ 2147558912 FreqMin "Frequency - Minimum";
CM_ SG_ 2147558912 FreqMax "Frequency - Maximum";
CM_ SG_ 2147558912 Freq "Frequency";
CM_ SG_ 2147558912 ConcurAccCtr "Concurrent Access Counter";
CM_ SG_ 2147558912 CfgType "Configuration Type";
CM_ SG_ 2147558912 AcSrcId "AC Source Identifer";
BA_DEF_ BO_  "J1939PGPrio" INT 0 7;
BA_DEF_ BO_  "J1939PGR1" INT 0 1;
BA_DEF_ BO_  "J1939PGDest" INT 0 255;
BA_DEF_ BO_  "J1939PGSrc" INT 0 255;
BA_DEF_ BO_  "CycleTime" INT 5 1000;
BA_DEF_ BO_  "SingleFrame" INT 0 1;
BA_DEF_DEF_  "J1939PGPrio" 0;
BA_DEF_DEF_  "J1939PGR1" 0;
BA_DEF_DEF_  "J1939PGDest" 0;
BA_DEF_DEF_  "J1939PGSrc" 0;
BA_DEF_DEF_  "CycleTime" 100;
BA_DEF_DEF_  "SingleFrame" 0;
BA_ "J1939PGPrio" BO_ 2147569920 6;
BA_ "J1939PGDest" BO_ 2147569920 255;
BA_ "J1939PGPrio" BO_ 2147550720 6;
BA_ "J1939PGDest" BO_ 2147550720 255;
BA_ "J1939PGPrio" BO_ 2147573760 6;
BA_ "J1939PGDest" BO_ 2147573760 255;
BA_ "J1939PGPrio" BO_ 2147610627 6;
BA_ "J1939PGDest" BO_ 2147610627 255;
BA_ "CycleTime" BO_ 2147610627 500;
BA_ "J1939PGPrio" BO_ 2147610628 6;
BA_ "J1939PGDest" BO_ 2147610628 255;
BA_ "CycleTime" BO_ 2147610628 500;
BA_ "J1939PGPrio" BO_ 2147610629 6;
BA_ "J1939PGDest" BO_ 2147610629 255;
BA_ "CycleTime" BO_ 2147610629 500;
BA_ "J1939PGPrio" BO_ 2147550976 6;
BA_ "J1939PGDest" BO_ 2147550976 255;
BA_ "J1939PGPrio" BO_ 2147551232 6;
BA_ "J1939PGDest" BO_ 2147551232 255;
BA_ "J1939PGPrio" BO_ 2147551488 6;
BA_ "J1939PGDest" BO_ 2147551488 255;
BA_ "J1939PGPrio" BO_ 2147569408 6;
BA_ "J1939PGDest" BO_ 2147569408 255;
BA_ "J1939PGPrio" BO_ 2147551744 6;
BA_ "J1939PGDest" BO_ 2147551744 255;
BA_ "J1939PGPrio" BO_ 2147552000 6;
BA_ "J1939PGDest" BO_ 2147552000 255;
BA_ "J1939PGPrio" BO_ 2147552256 6;
BA_ "J1939PGDest" BO_ 2147552256 255;
BA_ "J1939PGPrio" BO_ 2147569152 6;
BA_ "J1939PGDest" BO_ 2147569152 255;
BA_ "J1939PGPrio" BO_ 2147558912 6;
BA_ "J1939PGDest" BO_ 2147558912 255;
VAL_ 2147569920 RefEvtId 436 "SPS Auto Off Array V Low" 437 "SPS Auto On Array V Low" 438 "SPS Auto Off Ground Flt" 439 "SPS Auto On Ground Flt" 440 "SPS Auto Off External Shutdown Flt" 0 "None" 10 "Control Command Hibernate" 11 "Control Command Safe" 12 "Control Command Power Save" 13 "Control Command Operating" 14 "Control Command Diagnostic" 15 "Control Command Last Mode" 20 "Reset Command Reboot" 21 "Reset Command Download" 22 "Reset Command Oem" 23 "Reset Command Factory" 24 "Reset Command Reboot Clear Nv" 25 "Powered Up" 30 "Clear Command Active Faults" 31 "Clear Command Fault Log" 32 "Clear Command Active Warns" 33 "Clear Command Warn Log" 34 "Clear Command State Event Log" 35 "Clear Command Comm Stats" 36 "Clear Command Stats" 37 "Clear Command All" 40 "Date Time Configured" 50 "Warn Cleared" 51 "Fault Cleared" 52 "Fault Set" 60 "User Cfg Changed" 61 "Oem Cfg Changed" 70 "Triggered Fault" 250 "Shutdown Threshold" 251 "Shutdown Hysteresis" 252 "Warning Threshold" 253 "Warning Hysteresis" 254 "Transfer Threshold" 255 "Fan 0 Threshold" 256 "Fan 10 Threshold" 257 "Fan 20 Threshold" 258 "Fan 30 Threshold" 259 "Fan 40 Threshold" 260 "Fan 50 Threshold" 261 "Fan 60 Threshold" 262 "Fan 70 Threshold" 263 "Fan 80 Threshold" 264 "Fan 90 Threshold" 265 "Fan 100 Threshold" 266 "Relay Open Threshold" 267 "Relay Close Threshold" 268 "Charger Derating Ac In V" 269 "Charger Derating Ac In I" 270 "Charger Derating Ext Temp" 271 "Charger Derating Int Temp" 272 "Charger Derating Ripple V" 273 "Lost Ac Threshold" 274 "Lost Ac Hysteresis" 275 "Imm Shutdown Threshold" 276 "Imm Shutdown Hysteresis" 277 "Charger Shutdown Threshold" 278 "Charger Shutdown Hysteresis" 279 "Charger Warning Threshold" 280 "Charger Warning Hysteresis" 281 "Inverter Shutdown Threshold" 282 "Inverter Shutdown Hysteresis" 283 "Inverter Warning Threshold" 284 "Inverter Warning Hysteresis" 285 "Charger Derating Temp Start Point" 286 "Charger Derating Temp End Point" 287 "Charger Recharge Threshold" 300 "Ags Exercise Start" 301 "Ags Exercise Stop" 302 "Ags Quiet Time Begin" 303 "Ags Quiet Time End" 304 "Ags Battery Soc Start" 305 "Ags Battery Soc Stop" 306 "Ags Dc V Start" 307 "Ags Dc V Stop" 308 "Ags Ac I Start" 309 "Ags Ac I Stop" 310 "Ags Contact Start" 311 "Ags Contact Stop" 312 "Ags Float Stop" 313 "Ags Absorp Stop" 314 "Ags Manual On" 315 "Ags Manual Off" 316 "Ags Auto" 317 "Ags External On" 318 "Ags External Off" 319 "Gen External On" 320 "Gen External Off" 321 "Ags External Shutdown" 322 "Ags Auto Off" 323 "Ags Dc I Start" 324 "Ags Dc I Stop" 325 "Ags Ac Power Start" 326 "Ags Ac Power Stop" 400 "Sps Manual Off" 401 "Sps Manual On" 410 "Sps Auto Off" 411 "Sps Auto On" 420 "Sps Auto Off Batt V Low" 421 "Sps Auto On Batt V Low" 422 "Sps Auto Off Batt V High" 423 "Sps Auto On Batt V High" 424 "Sps Auto Off Array V High" 425 "Sps Auto On Array V High" 426 "Sps Auto Off Batt Temp Low" 427 "Sps Auto On Batt Temp Low" 428 "Sps Auto Off Batt Temp High" 429 "Sps Auto On Batt Temp High" 430 "Sps Auto Off Heat Sink Temp High" 431 "Sps Auto On Heat Sink Temp High" 432 "Sps Auto Off Fault" 433 "Sps Auto On Fault" 434 "Aps Check Timeout" 435 "Aps Qualify Timeout" 512 "Resume From Safe" 513 "AC Fault Set" 514 "Invert Fault Set" 515 "Charge Fault Set" 516 "Charger Enable" 517 "Charger Disable" 518 "Inverter Enable" 519 "Inverter Disable" 520 "Charge Suspend On" 521 "Charge Suspend Off" 522 "AC Good" 523 "AC Bad" 524 "Load Sense Enable" 525 "Load Sense Active" 526 "Invert Active" 527 "Bulk Exit" 528 "Absorption Exit" 529 "Float Exit" 530 "Float 3-Stage Set" 531 "Float 2-Stage Set" 532 "Equalize Enable" 533 "Equalize Disable" 534 "Equalize Exit" 535 "Load Sense Disable" 536 "Sell To Grid Enabled" 537 "Sell To Grid Disabled" 538 "Grid Support Enable" 539 "Grid Support Disable" 540 "Gen Support Enable" 541 "Gen Support Disable" 542 "Peak Load Shaving Enable" 543 "Peak Load Shaving Disable" 544 "Peak Load Shaving Tod Start" 545 "Peak Load Shaving Tod Stop" 546 "Unit Off" 547 "System Absorption Exit" 548 "System Inverter Enable" 549 "System AC Good" 550 "Anti Islanding Condition" 551 "Hibernate Timeout" 552 "External Sync Error" 553 "External Suspend Request" 554 "Engaging Charger" 555 "Engaging Gen Support" 556 "Grid Tie Engage Timeout" 557 "Gen Support Engage Timeout" 558 "Charge Engage Timeout" 559 "Inverter Engage Timeout" 560 "Charge Exit Timeout" 561 "Grid Support Entry Amps" 562 "Grid Support Exit Amps" 563 "Gen Support Entry Amps" 564 "Gen Support Exit Amps" 565 "Grid Support Entry Vdc" 566 "Grid Support Exit Vdc" 567 "Low Batt Cut Off Entry Vdc" 568 "Low Batt Recharge Vdc" 569 "Low Batt Cut Off Exit Vdc" 570 "Invert To Bypass Timeout" 571 "Force Charge" 572 "System Engage Bulk Charge" 441 "SPS Auto On External Shutdown Flt" 442 "SPS Auto Off Input Over Volt Flt" 443 "SPS Auto On Input Over Volt Flt" 444 "SPS Auto Off Input Over Volt Err" 445 "SPS Auto On Input Over Volt Err" 446 "SPS Auto Off Input Over Volt Wrn" 447 "SPS Auto On Input Over Volt Wrn" 448 "SPS Auto Off Output Over Volt Err" 449 "SPS Auto On Output Over Volt Err" 450 "SPS Auto Off Output Over Volt Wrn" 451 "SPS Auto On Output Over Volt Wrn" 452 "SPS Auto Off Output Under Volt Err" 453 "SPS Auto On Output Under Volt Err" 454 "SPS Auto Off Output Under Volt Wrn" 455 "SPS Auto On Output Under Volt Wrn" 456 "SPS Auto Off Output Over Curr Err" 457 "SPS Auto On Output Over Curr Err" 458 "SPS Auto Off Batt Over Temp Err" 459 "SPS Auto On Batt Over Temp Err" 460 "SPS Auto Off Batt Over Temp Wrn" 461 "SPS Auto On Batt Over Temp Wrn" 462 "SPS Auto Off Batt Under Temp Wrn" 463 "SPS Auto On Batt Under Temp Wrn" 464 "SPS Auto Off Heatsink Over Temp Err" 465 "SPS Auto On Heatsink Over Temp Err" 466 "SPS Auto Off Heatsink Over Temp Wrn" 467 "SPS Auto On Heatsink Over Temp Wrn" 468 "SPS Auto Off Ambient Over Temp Err" 469 "SPS Auto On Ambient Over Temp Err" 470 "SPS Auto Off Ambient Over Temp Wrn" 471 "SPS Auto On Ambient Over Temp Wrn" 472 "SPS Auto Off Capacitor Over Temp Err" 473 "SPS Auto On Capacitor Over Temp Err" 474 "SPS Auto Off Fan Flt" 475 "SPS Auto On Fan Flt" 476 "SPS Auto Off Fan Err" 477 "SPS Auto On Fan Err" 478 "SPS Auto Off Input Over Curr Err" 479 "SPS Auto On Input Over Curr Err" 480 "SPS Auto Off Output Over Curr Flt" 481 "SPS Auto On Output Over Curr Flt" 482 "SPS Auto Off Network PS Flt" 483 "SPS Auto On Network PS Flt" 484 "SPS Auto Off Setup Flt" 485 "SPS Auto On Setup Flt" 38 "Clear Command User Stats" 573 "AC Good Pending" 574 "Grid Safe" 585 "PLS Time In Float Ready" 575 "Power Conversion Fault" 576 "Low Battery Support Exit" 577 "Grid Support Exit" 578 "GFS Enable" 579 "GFS Disable" 580 "Force Sell" 486 "SPS Auto On Bulk Exit" 487 "SPS Auto Off Bulk Exit" 488 "SPS Auto On Absorption Exit" 489 "SPS Auto Off Absorption Exit" 490 "SPS Auto On State Of Charge Low" 491 "SPS Auto Off State Of Charge Low" 492 "SPS Auto On Time Of Day" 493 "SPS Auto Off Time Of Day" 581 "Sell Time Of Day Start" 582 "Sell Time Of Day Stop" 583 "Aux Port Time Of Day Start" 584 "Aux Port Time Of Day Stop" ;
VAL_ 2147569920 EvtId 436 "SPS Auto Off Array V Low" 437 "SPS Auto On Array V Low" 438 "SPS Auto Off Ground Flt" 439 "SPS Auto On Ground Flt" 440 "SPS Auto Off External Shutdown Flt" 0 "None" 10 "Control Command Hibernate" 11 "Control Command Safe" 12 "Control Command Power Save" 13 "Control Command Operating" 14 "Control Command Diagnostic" 15 "Control Command Last Mode" 20 "Reset Command Reboot" 21 "Reset Command Download" 22 "Reset Command Oem" 23 "Reset Command Factory" 24 "Reset Command Reboot Clear Nv" 25 "Powered Up" 30 "Clear Command Active Faults" 31 "Clear Command Fault Log" 32 "Clear Command Active Warns" 33 "Clear Command Warn Log" 34 "Clear Command State Event Log" 35 "Clear Command Comm Stats" 36 "Clear Command Stats" 37 "Clear Command All" 40 "Date Time Configured" 50 "Warn Cleared" 51 "Fault Cleared" 52 "Fault Set" 60 "User Cfg Changed" 61 "Oem Cfg Changed" 70 "Triggered Fault" 250 "Shutdown Threshold" 251 "Shutdown Hysteresis" 252 "Warning Threshold" 253 "Warning Hysteresis" 254 "Transfer Threshold" 255 "Fan 0 Threshold" 256 "Fan 10 Threshold" 257 "Fan 20 Threshold" 258 "Fan 30 Threshold" 259 "Fan 40 Threshold" 260 "Fan 50 Threshold" 261 "Fan 60 Threshold" 262 "Fan 70 Threshold" 263 "Fan 80 Threshold" 264 "Fan 90 Threshold" 265 "Fan 100 Threshold" 266 "Relay Open Threshold" 267 "Relay Close Threshold" 268 "Charger Derating Ac In V" 269 "Charger Derating Ac In I" 270 "Charger Derating Ext Temp" 271 "Charger Derating Int Temp" 272 "Charger Derating Ripple V" 273 "Lost Ac Threshold" 274 "Lost Ac Hysteresis" 275 "Imm Shutdown Threshold" 276 "Imm Shutdown Hysteresis" 277 "Charger Shutdown Threshold" 278 "Charger Shutdown Hysteresis" 279 "Charger Warning Threshold" 280 "Charger Warning Hysteresis" 281 "Inverter Shutdown Threshold" 282 "Inverter Shutdown Hysteresis" 283 "Inverter Warning Threshold" 284 "Inverter Warning Hysteresis" 285 "Charger Derating Temp Start Point" 286 "Charger Derating Temp End Point" 287 "Charger Recharge Threshold" 300 "Ags Exercise Start" 301 "Ags Exercise Stop" 302 "Ags Quiet Time Begin" 303 "Ags Quiet Time End" 304 "Ags Battery Soc Start" 305 "Ags Battery Soc Stop" 306 "Ags Dc V Start" 307 "Ags Dc V Stop" 308 "Ags Ac I Start" 309 "Ags Ac I Stop" 310 "Ags Contact Start" 311 "Ags Contact Stop" 312 "Ags Float Stop" 313 "Ags Absorp Stop" 314 "Ags Manual On" 315 "Ags Manual Off" 316 "Ags Auto" 317 "Ags External On" 318 "Ags External Off" 319 "Gen External On" 320 "Gen External Off" 321 "Ags External Shutdown" 322 "Ags Auto Off" 323 "Ags Dc I Start" 324 "Ags Dc I Stop" 325 "Ags Ac Power Start" 326 "Ags Ac Power Stop" 400 "Sps Manual Off" 401 "Sps Manual On" 410 "Sps Auto Off" 411 "Sps Auto On" 420 "Sps Auto Off Batt V Low" 421 "Sps Auto On Batt V Low" 422 "Sps Auto Off Batt V High" 423 "Sps Auto On Batt V High" 424 "Sps Auto Off Array V High" 425 "Sps Auto On Array V High" 426 "Sps Auto Off Batt Temp Low" 427 "Sps Auto On Batt Temp Low" 428 "Sps Auto Off Batt Temp High" 429 "Sps Auto On Batt Temp High" 430 "Sps Auto Off Heat Sink Temp High" 431 "Sps Auto On Heat Sink Temp High" 432 "Sps Auto Off Fault" 433 "Sps Auto On Fault" 434 "Aps Check Timeout" 435 "Aps Qualify Timeout" 512 "Resume From Safe" 513 "AC Fault Set" 514 "Invert Fault Set" 515 "Charge Fault Set" 516 "Charger Enable" 517 "Charger Disable" 518 "Inverter Enable" 519 "Inverter Disable" 520 "Charge Suspend On" 521 "Charge Suspend Off" 522 "AC Good" 523 "AC Bad" 524 "Load Sense Enable" 525 "Load Sense Active" 526 "Invert Active" 527 "Bulk Exit" 528 "Absorption Exit" 529 "Float Exit" 530 "Float 3-Stage Set" 531 "Float 2-Stage Set" 532 "Equalize Enable" 533 "Equalize Disable" 534 "Equalize Exit" 535 "Load Sense Disable" 536 "Sell To Grid Enabled" 537 "Sell To Grid Disabled" 538 "Grid Support Enable" 539 "Grid Support Disable" 540 "Gen Support Enable" 541 "Gen Support Disable" 542 "Peak Load Shaving Enable" 543 "Peak Load Shaving Disable" 544 "Peak Load Shaving Tod Start" 545 "Peak Load Shaving Tod Stop" 546 "Unit Off" 547 "System Absorption Exit" 548 "System Inverter Enable" 549 "System AC Good" 550 "Anti Islanding Condition" 551 "Hibernate Timeout" 552 "External Sync Error" 553 "External Suspend Request" 554 "Engaging Charger" 555 "Engaging Gen Support" 556 "Grid Tie Engage Timeout" 557 "Gen Support Engage Timeout" 558 "Charge Engage Timeout" 559 "Inverter Engage Timeout" 560 "Charge Exit Timeout" 561 "Grid Support Entry Amps" 562 "Grid Support Exit Amps" 563 "Gen Support Entry Amps" 564 "Gen Support Exit Amps" 565 "Grid Support Entry Vdc" 566 "Grid Support Exit Vdc" 567 "Low Batt Cut Off Entry Vdc" 568 "Low Batt Recharge Vdc" 569 "Low Batt Cut Off Exit Vdc" 570 "Invert To Bypass Timeout" 571 "Force Charge" 572 "System Engage Bulk Charge" 441 "SPS Auto On External Shutdown Flt" 442 "SPS Auto Off Input Over Volt Flt" 443 "SPS Auto On Input Over Volt Flt" 444 "SPS Auto Off Input Over Volt Err" 445 "SPS Auto On Input Over Volt Err" 446 "SPS Auto Off Input Over Volt Wrn" 447 "SPS Auto On Input Over Volt Wrn" 448 "SPS Auto Off Output Over Volt Err" 449 "SPS Auto On Output Over Volt Err" 450 "SPS Auto Off Output Over Volt Wrn" 451 "SPS Auto On Output Over Volt Wrn" 452 "SPS Auto Off Output Under Volt Err" 453 "SPS Auto On Output Under Volt Err" 454 "SPS Auto Off Output Under Volt Wrn" 455 "SPS Auto On Output Under Volt Wrn" 456 "SPS Auto Off Output Over Curr Err" 457 "SPS Auto On Output Over Curr Err" 458 "SPS Auto Off Batt Over Temp Err" 459 "SPS Auto On Batt Over Temp Err" 460 "SPS Auto Off Batt Over Temp Wrn" 461 "SPS Auto On Batt Over Temp Wrn" 462 "SPS Auto Off Batt Under Temp Wrn" 463 "SPS Auto On Batt Under Temp Wrn" 464 "SPS Auto Off Heatsink Over Temp Err" 465 "SPS Auto On Heatsink Over Temp Err" 466 "SPS Auto Off Heatsink Over Temp Wrn" 467 "SPS Auto On Heatsink Over Temp Wrn" 468 "SPS Auto Off Ambient Over Temp Err" 469 "SPS Auto On Ambient Over Temp Err" 470 "SPS Auto Off Ambient Over Temp Wrn" 471 "SPS Auto On Ambient Over Temp Wrn" 472 "SPS Auto Off Capacitor Over Temp Err" 473 "SPS Auto On Capacitor Over Temp Err" 474 "SPS Auto Off Fan Flt" 475 "SPS Auto On Fan Flt" 476 "SPS Auto Off Fan Err" 477 "SPS Auto On Fan Err" 478 "SPS Auto Off Input Over Curr Err" 479 "SPS Auto On Input Over Curr Err" 480 "SPS Auto Off Output Over Curr Flt" 481 "SPS Auto On Output Over Curr Flt" 482 "SPS Auto Off Network PS Flt" 483 "SPS Auto On Network PS Flt" 484 "SPS Auto Off Setup Flt" 485 "SPS Auto On Setup Flt" 38 "Clear Command User Stats" 573 "AC Good Pending" 574 "Grid Safe" 585 "PLS Time In Float Ready" 575 "Power Conversion Fault" 576 "Low Battery Support Exit" 577 "Grid Support Exit" 578 "GFS Enable" 579 "GFS Disable" 580 "Force Sell" 486 "SPS Auto On Bulk Exit" 487 "SPS Auto Off Bulk Exit" 488 "SPS Auto On Absorption Exit" 489 "SPS Auto Off Absorption Exit" 490 "SPS Auto On State Of Charge Low" 491 "SPS Auto Off State Of Charge Low" 492 "SPS Auto On Time Of Day" 493 "SPS Auto Off Time Of Day" 581 "Sell Time Of Day Start" 582 "Sell Time Of Day Stop" 583 "Aux Port Time Of Day Start" 584 "Aux Port Time Of Day Stop" ;
VAL_ 2147569920 CfgType 0 "User" 1 "OEM" 2 "Factory" 3 "Reserved" ;
VAL_ 2147569920 AcSrcId 0 "Invalid" 1 "None" 2 "Anonymous" 3 "Shore1" 4 "Shore2" 5 "Shore3" 6 "Shore4" 7 "Shore5" 8 "Shore6" 9 "Shore7" 10 "Shore8" 11 "Shore9" 12 "Shore10" 13 "Shore11" 14 "Shore12" 15 "Shore13" 16 "Shore14" 17 "Shore15" 18 "Shore16" 19 "Gen1" 20 "Gen2" 21 "Gen3" 22 "Gen4" 23 "Gen5" 24 "Gen6" 25 "Gen7" 26 "Gen8" 27 "Gen9" 28 "Gen10" 29 "Gen11" 30 "Gen12" 31 "Gen13" 32 "Gen14" 33 "Gen15" 34 "Gen16" 35 "AC1" 36 "AC2" 37 "AC3" 38 "AC4" 39 "AC5" 40 "AC6" 41 "AC7" 42 "AC8" 43 "AC9" 44 "AC10" 45 "AC11" 46 "AC12" 47 "AC13" 48 "AC14" 49 "AC15" 50 "AC16" 51 "AC Load1" 52 "AC Load2" 53 "AC Load3" 54 "AC Load4" 55 "AC Load5" 56 "AC Load6" 57 "AC Load7" 58 "AC Load8" 59 "AC Load9" 60 "AC Load10" 61 "AC Load11" 62 "AC Load12" 63 "AC Load13" 64 "AC Load14" 65 "AC Load15" 66 "AC Load16" 67 "Grid1" 68 "Grid2" 69 "Grid3" 70 "Grid4" 71 "Grid5" 72 "Grid6" 73 "Grid7" 74 "Grid8" 75 "Grid9" 76 "Grid10" 77 "Grid11" 78 "Grid12" 79 "Grid13" 80 "Grid14" 81 "Grid15" 82 "Grid16" 252 "All" 253 "Reserved" 254 "Out Of Range" 255 "Data Not Available Do Not Change" ;
VAL_ 2147550720 CfgType 0 "User" 1 "OEM" 2 "Factory" 3 "Reserved" ;
VAL_ 2147550720 AcSrcId 0 "Invalid" 1 "None" 2 "Anonymous" 3 "Shore1" 4 "Shore2" 5 "Shore3" 6 "Shore4" 7 "Shore5" 8 "Shore6" 9 "Shore7" 10 "Shore8" 11 "Shore9" 12 "Shore10" 13 "Shore11" 14 "Shore12" 15 "Shore13" 16 "Shore14" 17 "Shore15" 18 "Shore16" 19 "Gen1" 20 "Gen2" 21 "Gen3" 22 "Gen4" 23 "Gen5" 24 "Gen6" 25 "Gen7" 26 "Gen8" 27 "Gen9" 28 "Gen10" 29 "Gen11" 30 "Gen12" 31 "Gen13" 32 "Gen14" 33 "Gen15" 34 "Gen16" 35 "AC1" 36 "AC2" 37 "AC3" 38 "AC4" 39 "AC5" 40 "AC6" 41 "AC7" 42 "AC8" 43 "AC9" 44 "AC10" 45 "AC11" 46 "AC12" 47 "AC13" 48 "AC14" 49 "AC15" 50 "AC16" 51 "AC Load1" 52 "AC Load2" 53 "AC Load3" 54 "AC Load4" 55 "AC Load5" 56 "AC Load6" 57 "AC Load7" 58 "AC Load8" 59 "AC Load9" 60 "AC Load10" 61 "AC Load11" 62 "AC Load12" 63 "AC Load13" 64 "AC Load14" 65 "AC Load15" 66 "AC Load16" 67 "Grid1" 68 "Grid2" 69 "Grid3" 70 "Grid4" 71 "Grid5" 72 "Grid6" 73 "Grid7" 74 "Grid8" 75 "Grid9" 76 "Grid10" 77 "Grid11" 78 "Grid12" 79 "Grid13" 80 "Grid14" 81 "Grid15" 82 "Grid16" 252 "All" 253 "Reserved" 254 "Out Of Range" 255 "Data Not Available Do Not Change" ;
VAL_ 2147573760 CfgType 0 "User" 1 "OEM" 2 "Factory" 3 "Reserved" ;
VAL_ 2147573760 AcSrcId 0 "Invalid" 1 "None" 2 "Anonymous" 3 "Shore1" 4 "Shore2" 5 "Shore3" 6 "Shore4" 7 "Shore5" 8 "Shore6" 9 "Shore7" 10 "Shore8" 11 "Shore9" 12 "Shore10" 13 "Shore11" 14 "Shore12" 15 "Shore13" 16 "Shore14" 17 "Shore15" 18 "Shore16" 19 "Gen1" 20 "Gen2" 21 "Gen3" 22 "Gen4" 23 "Gen5" 24 "Gen6" 25 "Gen7" 26 "Gen8" 27 "Gen9" 28 "Gen10" 29 "Gen11" 30 "Gen12" 31 "Gen13" 32 "Gen14" 33 "Gen15" 34 "Gen16" 35 "AC1" 36 "AC2" 37 "AC3" 38 "AC4" 39 "AC5" 40 "AC6" 41 "AC7" 42 "AC8" 43 "AC9" 44 "AC10" 45 "AC11" 46 "AC12" 47 "AC13" 48 "AC14" 49 "AC15" 50 "AC16" 51 "AC Load1" 52 "AC Load2" 53 "AC Load3" 54 "AC Load4" 55 "AC Load5" 56 "AC Load6" 57 "AC Load7" 58 "AC Load8" 59 "AC Load9" 60 "AC Load10" 61 "AC Load11" 62 "AC Load12" 63 "AC Load13" 64 "AC Load14" 65 "AC Load15" 66 "AC Load16" 67 "Grid1" 68 "Grid2" 69 "Grid3" 70 "Grid4" 71 "Grid5" 72 "Grid6" 73 "Grid7" 74 "Grid8" 75 "Grid9" 76 "Grid10" 77 "Grid11" 78 "Grid12" 79 "Grid13" 80 "Grid14" 81 "Grid15" 82 "Grid16" 252 "All" 253 "Reserved" 254 "Out Of Range" 255 "Data Not Available Do Not Change" ;
VAL_ 2147573760 AcLineRemote 0 "Invalid" 1 "Line 1" 2 "Line 2" 3 "Line 3" 253 "Reserved" 254 "Out Of Range" 255 "Data Not Available Do Not Change" ;
VAL_ 2147573760 AcLineLocal 0 "Invalid" 1 "Line 1" 2 "Line 2" 3 "Line 3" 253 "Reserved" 254 "Out Of Range" 255 "Data Not Available Do Not Change" ;
VAL_ 2147610627 Quality 0 "Invalid" 1 "Being Qualified" 2 "Bad Frequency" 3 "Bad Level" 4 "Good" 21 "Frequency Low" 22 "Frequency High" 31 "Voltage Low" 32 "Voltage High" 253 "Reserved" 254 "Out Of Range" 255 "Data Not Available Do Not Change" ;
VAL_ 2147610627 Line 0 "Invalid" 1 "Line 1" 2 "Line 2" 3 "Line 3" 253 "Reserved" 254 "Out Of Range" 255 "Data Not Available Do Not Change" ;
VAL_ 2147610627 AcSrcId 0 "Invalid" 1 "None" 2 "Anonymous" 3 "Shore1" 4 "Shore2" 5 "Shore3" 6 "Shore4" 7 "Shore5" 8 "Shore6" 9 "Shore7" 10 "Shore8" 11 "Shore9" 12 "Shore10" 13 "Shore11" 14 "Shore12" 15 "Shore13" 16 "Shore14" 17 "Shore15" 18 "Shore16" 19 "Gen1" 20 "Gen2" 21 "Gen3" 22 "Gen4" 23 "Gen5" 24 "Gen6" 25 "Gen7" 26 "Gen8" 27 "Gen9" 28 "Gen10" 29 "Gen11" 30 "Gen12" 31 "Gen13" 32 "Gen14" 33 "Gen15" 34 "Gen16" 35 "AC1" 36 "AC2" 37 "AC3" 38 "AC4" 39 "AC5" 40 "AC6" 41 "AC7" 42 "AC8" 43 "AC9" 44 "AC10" 45 "AC11" 46 "AC12" 47 "AC13" 48 "AC14" 49 "AC15" 50 "AC16" 51 "AC Load1" 52 "AC Load2" 53 "AC Load3" 54 "AC Load4" 55 "AC Load5" 56 "AC Load6" 57 "AC Load7" 58 "AC Load8" 59 "AC Load9" 60 "AC Load10" 61 "AC Load11" 62 "AC Load12" 63 "AC Load13" 64 "AC Load14" 65 "AC Load15" 66 "AC Load16" 67 "Grid1" 68 "Grid2" 69 "Grid3" 70 "Grid4" 71 "Grid5" 72 "Grid6" 73 "Grid7" 74 "Grid8" 75 "Grid9" 76 "Grid10" 77 "Grid11" 78 "Grid12" 79 "Grid13" 80 "Grid14" 81 "Grid15" 82 "Grid16" 252 "All" 253 "Reserved" 254 "Out Of Range" 255 "Data Not Available Do Not Change" ;
VAL_ 2147610628 Quality 0 "Invalid" 1 "Being Qualified" 2 "Bad Frequency" 3 "Bad Level" 4 "Good" 21 "Frequency Low" 22 "Frequency High" 31 "Voltage Low" 32 "Voltage High" 253 "Reserved" 254 "Out Of Range" 255 "Data Not Available Do Not Change" ;
VAL_ 2147610628 Line 0 "Invalid" 1 "Line 1" 2 "Line 2" 3 "Line 3" 253 "Reserved" 254 "Out Of Range" 255 "Data Not Available Do Not Change" ;
VAL_ 2147610628 AcSrcId 0 "Invalid" 1 "None" 2 "Anonymous" 3 "Shore1" 4 "Shore2" 5 "Shore3" 6 "Shore4" 7 "Shore5" 8 "Shore6" 9 "Shore7" 10 "Shore8" 11 "Shore9" 12 "Shore10" 13 "Shore11" 14 "Shore12" 15 "Shore13" 16 "Shore14" 17 "Shore15" 18 "Shore16" 19 "Gen1" 20 "Gen2" 21 "Gen3" 22 "Gen4" 23 "Gen5" 24 "Gen6" 25 "Gen7" 26 "Gen8" 27 "Gen9" 28 "Gen10" 29 "Gen11" 30 "Gen12" 31 "Gen13" 32 "Gen14" 33 "Gen15" 34 "Gen16" 35 "AC1" 36 "AC2" 37 "AC3" 38 "AC4" 39 "AC5" 40 "AC6" 41 "AC7" 42 "AC8" 43 "AC9" 44 "AC10" 45 "AC11" 46 "AC12" 47 "AC13" 48 "AC14" 49 "AC15" 50 "AC16" 51 "AC Load1" 52 "AC Load2" 53 "AC Load3" 54 "AC Load4" 55 "AC Load5" 56 "AC Load6" 57 "AC Load7" 58 "AC Load8" 59 "AC Load9" 60 "AC Load10" 61 "AC Load11" 62 "AC Load12" 63 "AC Load13" 64 "AC Load14" 65 "AC Load15" 66 "AC Load16" 67 "Grid1" 68 "Grid2" 69 "Grid3" 70 "Grid4" 71 "Grid5" 72 "Grid6" 73 "Grid7" 74 "Grid8" 75 "Grid9" 76 "Grid10" 77 "Grid11" 78 "Grid12" 79 "Grid13" 80 "Grid14" 81 "Grid15" 82 "Grid16" 252 "All" 253 "Reserved" 254 "Out Of Range" 255 "Data Not Available Do Not Change" ;
VAL_ 2147610629 Quality 0 "Invalid" 1 "Being Qualified" 2 "Bad Frequency" 3 "Bad Level" 4 "Good" 21 "Frequency Low" 22 "Frequency High" 31 "Voltage Low" 32 "Voltage High" 253 "Reserved" 254 "Out Of Range" 255 "Data Not Available Do Not Change" ;
VAL_ 2147610629 Line 0 "Invalid" 1 "Line 1" 2 "Line 2" 3 "Line 3" 253 "Reserved" 254 "Out Of Range" 255 "Data Not Available Do Not Change" ;
VAL_ 2147610629 AcSrcId 0 "Invalid" 1 "None" 2 "Anonymous" 3 "Shore1" 4 "Shore2" 5 "Shore3" 6 "Shore4" 7 "Shore5" 8 "Shore6" 9 "Shore7" 10 "Shore8" 11 "Shore9" 12 "Shore10" 13 "Shore11" 14 "Shore12" 15 "Shore13" 16 "Shore14" 17 "Shore15" 18 "Shore16" 19 "Gen1" 20 "Gen2" 21 "Gen3" 22 "Gen4" 23 "Gen5" 24 "Gen6" 25 "Gen7" 26 "Gen8" 27 "Gen9" 28 "Gen10" 29 "Gen11" 30 "Gen12" 31 "Gen13" 32 "Gen14" 33 "Gen15" 34 "Gen16" 35 "AC1" 36 "AC2" 37 "AC3" 38 "AC4" 39 "AC5" 40 "AC6" 41 "AC7" 42 "AC8" 43 "AC9" 44 "AC10" 45 "AC11" 46 "AC12" 47 "AC13" 48 "AC14" 49 "AC15" 50 "AC16" 51 "AC Load1" 52 "AC Load2" 53 "AC Load3" 54 "AC Load4" 55 "AC Load5" 56 "AC Load6" 57 "AC Load7" 58 "AC Load8" 59 "AC Load9" 60 "AC Load10" 61 "AC Load11" 62 "AC Load12" 63 "AC Load13" 64 "AC Load14" 65 "AC Load15" 66 "AC Load16" 67 "Grid1" 68 "Grid2" 69 "Grid3" 70 "Grid4" 71 "Grid5" 72 "Grid6" 73 "Grid7" 74 "Grid8" 75 "Grid9" 76 "Grid10" 77 "Grid11" 78 "Grid12" 79 "Grid13" 80 "Grid14" 81 "Grid15" 82 "Grid16" 252 "All" 253 "Reserved" 254 "Out Of Range" 255 "Data Not Available Do Not Change" ;
VAL_ 2147550976 RefEvtId 436 "SPS Auto Off Array V Low" 437 "SPS Auto On Array V Low" 438 "SPS Auto Off Ground Flt" 439 "SPS Auto On Ground Flt" 440 "SPS Auto Off External Shutdown Flt" 0 "None" 10 "Control Command Hibernate" 11 "Control Command Safe" 12 "Control Command Power Save" 13 "Control Command Operating" 14 "Control Command Diagnostic" 15 "Control Command Last Mode" 20 "Reset Command Reboot" 21 "Reset Command Download" 22 "Reset Command Oem" 23 "Reset Command Factory" 24 "Reset Command Reboot Clear Nv" 25 "Powered Up" 30 "Clear Command Active Faults" 31 "Clear Command Fault Log" 32 "Clear Command Active Warns" 33 "Clear Command Warn Log" 34 "Clear Command State Event Log" 35 "Clear Command Comm Stats" 36 "Clear Command Stats" 37 "Clear Command All" 40 "Date Time Configured" 50 "Warn Cleared" 51 "Fault Cleared" 52 "Fault Set" 60 "User Cfg Changed" 61 "Oem Cfg Changed" 70 "Triggered Fault" 250 "Shutdown Threshold" 251 "Shutdown Hysteresis" 252 "Warning Threshold" 253 "Warning Hysteresis" 254 "Transfer Threshold" 255 "Fan 0 Threshold" 256 "Fan 10 Threshold" 257 "Fan 20 Threshold" 258 "Fan 30 Threshold" 259 "Fan 40 Threshold" 260 "Fan 50 Threshold" 261 "Fan 60 Threshold" 262 "Fan 70 Threshold" 263 "Fan 80 Threshold" 264 "Fan 90 Threshold" 265 "Fan 100 Threshold" 266 "Relay Open Threshold" 267 "Relay Close Threshold" 268 "Charger Derating Ac In V" 269 "Charger Derating Ac In I" 270 "Charger Derating Ext Temp" 271 "Charger Derating Int Temp" 272 "Charger Derating Ripple V" 273 "Lost Ac Threshold" 274 "Lost Ac Hysteresis" 275 "Imm Shutdown Threshold" 276 "Imm Shutdown Hysteresis" 277 "Charger Shutdown Threshold" 278 "Charger Shutdown Hysteresis" 279 "Charger Warning Threshold" 280 "Charger Warning Hysteresis" 281 "Inverter Shutdown Threshold" 282 "Inverter Shutdown Hysteresis" 283 "Inverter Warning Threshold" 284 "Inverter Warning Hysteresis" 285 "Charger Derating Temp Start Point" 286 "Charger Derating Temp End Point" 287 "Charger Recharge Threshold" 300 "Ags Exercise Start" 301 "Ags Exercise Stop" 302 "Ags Quiet Time Begin" 303 "Ags Quiet Time End" 304 "Ags Battery Soc Start" 305 "Ags Battery Soc Stop" 306 "Ags Dc V Start" 307 "Ags Dc V Stop" 308 "Ags Ac I Start" 309 "Ags Ac I Stop" 310 "Ags Contact Start" 311 "Ags Contact Stop" 312 "Ags Float Stop" 313 "Ags Absorp Stop" 314 "Ags Manual On" 315 "Ags Manual Off" 316 "Ags Auto" 317 "Ags External On" 318 "Ags External Off" 319 "Gen External On" 320 "Gen External Off" 321 "Ags External Shutdown" 322 "Ags Auto Off" 323 "Ags Dc I Start" 324 "Ags Dc I Stop" 325 "Ags Ac Power Start" 326 "Ags Ac Power Stop" 400 "Sps Manual Off" 401 "Sps Manual On" 410 "Sps Auto Off" 411 "Sps Auto On" 420 "Sps Auto Off Batt V Low" 421 "Sps Auto On Batt V Low" 422 "Sps Auto Off Batt V High" 423 "Sps Auto On Batt V High" 424 "Sps Auto Off Array V High" 425 "Sps Auto On Array V High" 426 "Sps Auto Off Batt Temp Low" 427 "Sps Auto On Batt Temp Low" 428 "Sps Auto Off Batt Temp High" 429 "Sps Auto On Batt Temp High" 430 "Sps Auto Off Heat Sink Temp High" 431 "Sps Auto On Heat Sink Temp High" 432 "Sps Auto Off Fault" 433 "Sps Auto On Fault" 434 "Aps Check Timeout" 435 "Aps Qualify Timeout" 512 "Resume From Safe" 513 "AC Fault Set" 514 "Invert Fault Set" 515 "Charge Fault Set" 516 "Charger Enable" 517 "Charger Disable" 518 "Inverter Enable" 519 "Inverter Disable" 520 "Charge Suspend On" 521 "Charge Suspend Off" 522 "AC Good" 523 "AC Bad" 524 "Load Sense Enable" 525 "Load Sense Active" 526 "Invert Active" 527 "Bulk Exit" 528 "Absorption Exit" 529 "Float Exit" 530 "Float 3-Stage Set" 531 "Float 2-Stage Set" 532 "Equalize Enable" 533 "Equalize Disable" 534 "Equalize Exit" 535 "Load Sense Disable" 536 "Sell To Grid Enabled" 537 "Sell To Grid Disabled" 538 "Grid Support Enable" 539 "Grid Support Disable" 540 "Gen Support Enable" 541 "Gen Support Disable" 542 "Peak Load Shaving Enable" 543 "Peak Load Shaving Disable" 544 "Peak Load Shaving Tod Start" 545 "Peak Load Shaving Tod Stop" 546 "Unit Off" 547 "System Absorption Exit" 548 "System Inverter Enable" 549 "System AC Good" 550 "Anti Islanding Condition" 551 "Hibernate Timeout" 552 "External Sync Error" 553 "External Suspend Request" 554 "Engaging Charger" 555 "Engaging Gen Support" 556 "Grid Tie Engage Timeout" 557 "Gen Support Engage Timeout" 558 "Charge Engage Timeout" 559 "Inverter Engage Timeout" 560 "Charge Exit Timeout" 561 "Grid Support Entry Amps" 562 "Grid Support Exit Amps" 563 "Gen Support Entry Amps" 564 "Gen Support Exit Amps" 565 "Grid Support Entry Vdc" 566 "Grid Support Exit Vdc" 567 "Low Batt Cut Off Entry Vdc" 568 "Low Batt Recharge Vdc" 569 "Low Batt Cut Off Exit Vdc" 570 "Invert To Bypass Timeout" 571 "Force Charge" 572 "System Engage Bulk Charge" 441 "SPS Auto On External Shutdown Flt" 442 "SPS Auto Off Input Over Volt Flt" 443 "SPS Auto On Input Over Volt Flt" 444 "SPS Auto Off Input Over Volt Err" 445 "SPS Auto On Input Over Volt Err" 446 "SPS Auto Off Input Over Volt Wrn" 447 "SPS Auto On Input Over Volt Wrn" 448 "SPS Auto Off Output Over Volt Err" 449 "SPS Auto On Output Over Volt Err" 450 "SPS Auto Off Output Over Volt Wrn" 451 "SPS Auto On Output Over Volt Wrn" 452 "SPS Auto Off Output Under Volt Err" 453 "SPS Auto On Output Under Volt Err" 454 "SPS Auto Off Output Under Volt Wrn" 455 "SPS Auto On Output Under Volt Wrn" 456 "SPS Auto Off Output Over Curr Err" 457 "SPS Auto On Output Over Curr Err" 458 "SPS Auto Off Batt Over Temp Err" 459 "SPS Auto On Batt Over Temp Err" 460 "SPS Auto Off Batt Over Temp Wrn" 461 "SPS Auto On Batt Over Temp Wrn" 462 "SPS Auto Off Batt Under Temp Wrn" 463 "SPS Auto On Batt Under Temp Wrn" 464 "SPS Auto Off Heatsink Over Temp Err" 465 "SPS Auto On Heatsink Over Temp Err" 466 "SPS Auto Off Heatsink Over Temp Wrn" 467 "SPS Auto On Heatsink Over Temp Wrn" 468 "SPS Auto Off Ambient Over Temp Err" 469 "SPS Auto On Ambient Over Temp Err" 470 "SPS Auto Off Ambient Over Temp Wrn" 471 "SPS Auto On Ambient Over Temp Wrn" 472 "SPS Auto Off Capacitor Over Temp Err" 473 "SPS Auto On Capacitor Over Temp Err" 474 "SPS Auto Off Fan Flt" 475 "SPS Auto On Fan Flt" 476 "SPS Auto Off Fan Err" 477 "SPS Auto On Fan Err" 478 "SPS Auto Off Input Over Curr Err" 479 "SPS Auto On Input Over Curr Err" 480 "SPS Auto Off Output Over Curr Flt" 481 "SPS Auto On Output Over Curr Flt" 482 "SPS Auto Off Network PS Flt" 483 "SPS Auto On Network PS Flt" 484 "SPS Auto Off Setup Flt" 485 "SPS Auto On Setup Flt" 38 "Clear Command User Stats" 573 "AC Good Pending" 574 "Grid Safe" 585 "PLS Time In Float Ready" 575 "Power Conversion Fault" 576 "Low Battery Support Exit" 577 "Grid Support Exit" 578 "GFS Enable" 579 "GFS Disable" 580 "Force Sell" 486 "SPS Auto On Bulk Exit" 487 "SPS Auto Off Bulk Exit" 488 "SPS Auto On Absorption Exit" 489 "SPS Auto Off Absorption Exit" 490 "SPS Auto On State Of Charge Low" 491 "SPS Auto Off State Of Charge Low" 492 "SPS Auto On Time Of Day" 493 "SPS Auto Off Time Of Day" 581 "Sell Time Of Day Start" 582 "Sell Time Of Day Stop" 583 "Aux Port Time Of Day Start" 584 "Aux Port Time Of Day Stop" ;
VAL_ 2147550976 EvtId 436 "SPS Auto Off Array V Low" 437 "SPS Auto On Array V Low" 438 "SPS Auto Off Ground Flt" 439 "SPS Auto On Ground Flt" 440 "SPS Auto Off External Shutdown Flt" 0 "None" 10 "Control Command Hibernate" 11 "Control Command Safe" 12 "Control Command Power Save" 13 "Control Command Operating" 14 "Control Command Diagnostic" 15 "Control Command Last Mode" 20 "Reset Command Reboot" 21 "Reset Command Download" 22 "Reset Command Oem" 23 "Reset Command Factory" 24 "Reset Command Reboot Clear Nv" 25 "Powered Up" 30 "Clear Command Active Faults" 31 "Clear Command Fault Log" 32 "Clear Command Active Warns" 33 "Clear Command Warn Log" 34 "Clear Command State Event Log" 35 "Clear Command Comm Stats" 36 "Clear Command Stats" 37 "Clear Command All" 40 "Date Time Configured" 50 "Warn Cleared" 51 "Fault Cleared" 52 "Fault Set" 60 "User Cfg Changed" 61 "Oem Cfg Changed" 70 "Triggered Fault" 250 "Shutdown Threshold" 251 "Shutdown Hysteresis" 252 "Warning Threshold" 253 "Warning Hysteresis" 254 "Transfer Threshold" 255 "Fan 0 Threshold" 256 "Fan 10 Threshold" 257 "Fan 20 Threshold" 258 "Fan 30 Threshold" 259 "Fan 40 Threshold" 260 "Fan 50 Threshold" 261 "Fan 60 Threshold" 262 "Fan 70 Threshold" 263 "Fan 80 Threshold" 264 "Fan 90 Threshold" 265 "Fan 100 Threshold" 266 "Relay Open Threshold" 267 "Relay Close Threshold" 268 "Charger Derating Ac In V" 269 "Charger Derating Ac In I" 270 "Charger Derating Ext Temp" 271 "Charger Derating Int Temp" 272 "Charger Derating Ripple V" 273 "Lost Ac Threshold" 274 "Lost Ac Hysteresis" 275 "Imm Shutdown Threshold" 276 "Imm Shutdown Hysteresis" 277 "Charger Shutdown Threshold" 278 "Charger Shutdown Hysteresis" 279 "Charger Warning Threshold" 280 "Charger Warning Hysteresis" 281 "Inverter Shutdown Threshold" 282 "Inverter Shutdown Hysteresis" 283 "Inverter Warning Threshold" 284 "Inverter Warning Hysteresis" 285 "Charger Derating Temp Start Point" 286 "Charger Derating Temp End Point" 287 "Charger Recharge Threshold" 300 "Ags Exercise Start" 301 "Ags Exercise Stop" 302 "Ags Quiet Time Begin" 303 "Ags Quiet Time End" 304 "Ags Battery Soc Start" 305 "Ags Battery Soc Stop" 306 "Ags Dc V Start" 307 "Ags Dc V Stop" 308 "Ags Ac I Start" 309 "Ags Ac I Stop" 310 "Ags Contact Start" 311 "Ags Contact Stop" 312 "Ags Float Stop" 313 "Ags Absorp Stop" 314 "Ags Manual On" 315 "Ags Manual Off" 316 "Ags Auto" 317 "Ags External On" 318 "Ags External Off" 319 "Gen External On" 320 "Gen External Off" 321 "Ags External Shutdown" 322 "Ags Auto Off" 323 "Ags Dc I Start" 324 "Ags Dc I Stop" 325 "Ags Ac Power Start" 326 "Ags Ac Power Stop" 400 "Sps Manual Off" 401 "Sps Manual On" 410 "Sps Auto Off" 411 "Sps Auto On" 420 "Sps Auto Off Batt V Low" 421 "Sps Auto On Batt V Low" 422 "Sps Auto Off Batt V High" 423 "Sps Auto On Batt V High" 424 "Sps Auto Off Array V High" 425 "Sps Auto On Array V High" 426 "Sps Auto Off Batt Temp Low" 427 "Sps Auto On Batt Temp Low" 428 "Sps Auto Off Batt Temp High" 429 "Sps Auto On Batt Temp High" 430 "Sps Auto Off Heat Sink Temp High" 431 "Sps Auto On Heat Sink Temp High" 432 "Sps Auto Off Fault" 433 "Sps Auto On Fault" 434 "Aps Check Timeout" 435 "Aps Qualify Timeout" 512 "Resume From Safe" 513 "AC Fault Set" 514 "Invert Fault Set" 515 "Charge Fault Set" 516 "Charger Enable" 517 "Charger Disable" 518 "Inverter Enable" 519 "Inverter Disable" 520 "Charge Suspend On" 521 "Charge Suspend Off" 522 "AC Good" 523 "AC Bad" 524 "Load Sense Enable" 525 "Load Sense Active" 526 "Invert Active" 527 "Bulk Exit" 528 "Absorption Exit" 529 "Float Exit" 530 "Float 3-Stage Set" 531 "Float 2-Stage Set" 532 "Equalize Enable" 533 "Equalize Disable" 534 "Equalize Exit" 535 "Load Sense Disable" 536 "Sell To Grid Enabled" 537 "Sell To Grid Disabled" 538 "Grid Support Enable" 539 "Grid Support Disable" 540 "Gen Support Enable" 541 "Gen Support Disable" 542 "Peak Load Shaving Enable" 543 "Peak Load Shaving Disable" 544 "Peak Load Shaving Tod Start" 545 "Peak Load Shaving Tod Stop" 546 "Unit Off" 547 "System Absorption Exit" 548 "System Inverter Enable" 549 "System AC Good" 550 "Anti Islanding Condition" 551 "Hibernate Timeout" 552 "External Sync Error" 553 "External Suspend Request" 554 "Engaging Charger" 555 "Engaging Gen Support" 556 "Grid Tie Engage Timeout" 557 "Gen Support Engage Timeout" 558 "Charge Engage Timeout" 559 "Inverter Engage Timeout" 560 "Charge Exit Timeout" 561 "Grid Support Entry Amps" 562 "Grid Support Exit Amps" 563 "Gen Support Entry Amps" 564 "Gen Support Exit Amps" 565 "Grid Support Entry Vdc" 566 "Grid Support Exit Vdc" 567 "Low Batt Cut Off Entry Vdc" 568 "Low Batt Recharge Vdc" 569 "Low Batt Cut Off Exit Vdc" 570 "Invert To Bypass Timeout" 571 "Force Charge" 572 "System Engage Bulk Charge" 441 "SPS Auto On External Shutdown Flt" 442 "SPS Auto Off Input Over Volt Flt" 443 "SPS Auto On Input Over Volt Flt" 444 "SPS Auto Off Input Over Volt Err" 445 "SPS Auto On Input Over Volt Err" 446 "SPS Auto Off Input Over Volt Wrn" 447 "SPS Auto On Input Over Volt Wrn" 448 "SPS Auto Off Output Over Volt Err" 449 "SPS Auto On Output Over Volt Err" 450 "SPS Auto Off Output Over Volt Wrn" 451 "SPS Auto On Output Over Volt Wrn" 452 "SPS Auto Off Output Under Volt Err" 453 "SPS Auto On Output Under Volt Err" 454 "SPS Auto Off Output Under Volt Wrn" 455 "SPS Auto On Output Under Volt Wrn" 456 "SPS Auto Off Output Over Curr Err" 457 "SPS Auto On Output Over Curr Err" 458 "SPS Auto Off Batt Over Temp Err" 459 "SPS Auto On Batt Over Temp Err" 460 "SPS Auto Off Batt Over Temp Wrn" 461 "SPS Auto On Batt Over Temp Wrn" 462 "SPS Auto Off Batt Under Temp Wrn" 463 "SPS Auto On Batt Under Temp Wrn" 464 "SPS Auto Off Heatsink Over Temp Err" 465 "SPS Auto On Heatsink Over Temp Err" 466 "SPS Auto Off Heatsink Over Temp Wrn" 467 "SPS Auto On Heatsink Over Temp Wrn" 468 "SPS Auto Off Ambient Over Temp Err" 469 "SPS Auto On Ambient Over Temp Err" 470 "SPS Auto Off Ambient Over Temp Wrn" 471 "SPS Auto On Ambient Over Temp Wrn" 472 "SPS Auto Off Capacitor Over Temp Err" 473 "SPS Auto On Capacitor Over Temp Err" 474 "SPS Auto Off Fan Flt" 475 "SPS Auto On Fan Flt" 476 "SPS Auto Off Fan Err" 477 "SPS Auto On Fan Err" 478 "SPS Auto Off Input Over Curr Err" 479 "SPS Auto On Input Over Curr Err" 480 "SPS Auto Off Output Over Curr Flt" 481 "SPS Auto On Output Over Curr Flt" 482 "SPS Auto Off Network PS Flt" 483 "SPS Auto On Network PS Flt" 484 "SPS Auto Off Setup Flt" 485 "SPS Auto On Setup Flt" 38 "Clear Command User Stats" 573 "AC Good Pending" 574 "Grid Safe" 585 "PLS Time In Float Ready" 575 "Power Conversion Fault" 576 "Low Battery Support Exit" 577 "Grid Support Exit" 578 "GFS Enable" 579 "GFS Disable" 580 "Force Sell" 486 "SPS Auto On Bulk Exit" 487 "SPS Auto Off Bulk Exit" 488 "SPS Auto On Absorption Exit" 489 "SPS Auto Off Absorption Exit" 490 "SPS Auto On State Of Charge Low" 491 "SPS Auto Off State Of Charge Low" 492 "SPS Auto On Time Of Day" 493 "SPS Auto Off Time Of Day" 581 "Sell Time Of Day Start" 582 "Sell Time Of Day Stop" 583 "Aux Port Time Of Day Start" 584 "Aux Port Time Of Day Stop" ;
VAL_ 2147550976 CfgType 0 "User" 1 "OEM" 2 "Factory" 3 "Reserved" ;
VAL_ 2147550976 AcSrcId 0 "Invalid" 1 "None" 2 "Anonymous" 3 "Shore1" 4 "Shore2" 5 "Shore3" 6 "Shore4" 7 "Shore5" 8 "Shore6" 9 "Shore7" 10 "Shore8" 11 "Shore9" 12 "Shore10" 13 "Shore11" 14 "Shore12" 15 "Shore13" 16 "Shore14" 17 "Shore15" 18 "Shore16" 19 "Gen1" 20 "Gen2" 21 "Gen3" 22 "Gen4" 23 "Gen5" 24 "Gen6" 25 "Gen7" 26 "Gen8" 27 "Gen9" 28 "Gen10" 29 "Gen11" 30 "Gen12" 31 "Gen13" 32 "Gen14" 33 "Gen15" 34 "Gen16" 35 "AC1" 36 "AC2" 37 "AC3" 38 "AC4" 39 "AC5" 40 "AC6" 41 "AC7" 42 "AC8" 43 "AC9" 44 "AC10" 45 "AC11" 46 "AC12" 47 "AC13" 48 "AC14" 49 "AC15" 50 "AC16" 51 "AC Load1" 52 "AC Load2" 53 "AC Load3" 54 "AC Load4" 55 "AC Load5" 56 "AC Load6" 57 "AC Load7" 58 "AC Load8" 59 "AC Load9" 60 "AC Load10" 61 "AC Load11" 62 "AC Load12" 63 "AC Load13" 64 "AC Load14" 65 "AC Load15" 66 "AC Load16" 67 "Grid1" 68 "Grid2" 69 "Grid3" 70 "Grid4" 71 "Grid5" 72 "Grid6" 73 "Grid7" 74 "Grid8" 75 "Grid9" 76 "Grid10" 77 "Grid11" 78 "Grid12" 79 "Grid13" 80 "Grid14" 81 "Grid15" 82 "Grid16" 252 "All" 253 "Reserved" 254 "Out Of Range" 255 "Data Not Available Do Not Change" ;
VAL_ 2147551232 RefEvtId 436 "SPS Auto Off Array V Low" 437 "SPS Auto On Array V Low" 438 "SPS Auto Off Ground Flt" 439 "SPS Auto On Ground Flt" 440 "SPS Auto Off External Shutdown Flt" 0 "None" 10 "Control Command Hibernate" 11 "Control Command Safe" 12 "Control Command Power Save" 13 "Control Command Operating" 14 "Control Command Diagnostic" 15 "Control Command Last Mode" 20 "Reset Command Reboot" 21 "Reset Command Download" 22 "Reset Command Oem" 23 "Reset Command Factory" 24 "Reset Command Reboot Clear Nv" 25 "Powered Up" 30 "Clear Command Active Faults" 31 "Clear Command Fault Log" 32 "Clear Command Active Warns" 33 "Clear Command Warn Log" 34 "Clear Command State Event Log" 35 "Clear Command Comm Stats" 36 "Clear Command Stats" 37 "Clear Command All" 40 "Date Time Configured" 50 "Warn Cleared" 51 "Fault Cleared" 52 "Fault Set" 60 "User Cfg Changed" 61 "Oem Cfg Changed" 70 "Triggered Fault" 250 "Shutdown Threshold" 251 "Shutdown Hysteresis" 252 "Warning Threshold" 253 "Warning Hysteresis" 254 "Transfer Threshold" 255 "Fan 0 Threshold" 256 "Fan 10 Threshold" 257 "Fan 20 Threshold" 258 "Fan 30 Threshold" 259 "Fan 40 Threshold" 260 "Fan 50 Threshold" 261 "Fan 60 Threshold" 262 "Fan 70 Threshold" 263 "Fan 80 Threshold" 264 "Fan 90 Threshold" 265 "Fan 100 Threshold" 266 "Relay Open Threshold" 267 "Relay Close Threshold" 268 "Charger Derating Ac In V" 269 "Charger Derating Ac In I" 270 "Charger Derating Ext Temp" 271 "Charger Derating Int Temp" 272 "Charger Derating Ripple V" 273 "Lost Ac Threshold" 274 "Lost Ac Hysteresis" 275 "Imm Shutdown Threshold" 276 "Imm Shutdown Hysteresis" 277 "Charger Shutdown Threshold" 278 "Charger Shutdown Hysteresis" 279 "Charger Warning Threshold" 280 "Charger Warning Hysteresis" 281 "Inverter Shutdown Threshold" 282 "Inverter Shutdown Hysteresis" 283 "Inverter Warning Threshold" 284 "Inverter Warning Hysteresis" 285 "Charger Derating Temp Start Point" 286 "Charger Derating Temp End Point" 287 "Charger Recharge Threshold" 300 "Ags Exercise Start" 301 "Ags Exercise Stop" 302 "Ags Quiet Time Begin" 303 "Ags Quiet Time End" 304 "Ags Battery Soc Start" 305 "Ags Battery Soc Stop" 306 "Ags Dc V Start" 307 "Ags Dc V Stop" 308 "Ags Ac I Start" 309 "Ags Ac I Stop" 310 "Ags Contact Start" 311 "Ags Contact Stop" 312 "Ags Float Stop" 313 "Ags Absorp Stop" 314 "Ags Manual On" 315 "Ags Manual Off" 316 "Ags Auto" 317 "Ags External On" 318 "Ags External Off" 319 "Gen External On" 320 "Gen External Off" 321 "Ags External Shutdown" 322 "Ags Auto Off" 323 "Ags Dc I Start" 324 "Ags Dc I Stop" 325 "Ags Ac Power Start" 326 "Ags Ac Power Stop" 400 "Sps Manual Off" 401 "Sps Manual On" 410 "Sps Auto Off" 411 "Sps Auto On" 420 "Sps Auto Off Batt V Low" 421 "Sps Auto On Batt V Low" 422 "Sps Auto Off Batt V High" 423 "Sps Auto On Batt V High" 424 "Sps Auto Off Array V High" 425 "Sps Auto On Array V High" 426 "Sps Auto Off Batt Temp Low" 427 "Sps Auto On Batt Temp Low" 428 "Sps Auto Off Batt Temp High" 429 "Sps Auto On Batt Temp High" 430 "Sps Auto Off Heat Sink Temp High" 431 "Sps Auto On Heat Sink Temp High" 432 "Sps Auto Off Fault" 433 "Sps Auto On Fault" 434 "Aps Check Timeout" 435 "Aps Qualify Timeout" 512 "Resume From Safe" 513 "AC Fault Set" 514 "Invert Fault Set" 515 "Charge Fault Set" 516 "Charger Enable" 517 "Charger Disable" 518 "Inverter Enable" 519 "Inverter Disable" 520 "Charge Suspend On" 521 "Charge Suspend Off" 522 "AC Good" 523 "AC Bad" 524 "Load Sense Enable" 525 "Load Sense Active" 526 "Invert Active" 527 "Bulk Exit" 528 "Absorption Exit" 529 "Float Exit" 530 "Float 3-Stage Set" 531 "Float 2-Stage Set" 532 "Equalize Enable" 533 "Equalize Disable" 534 "Equalize Exit" 535 "Load Sense Disable" 536 "Sell To Grid Enabled" 537 "Sell To Grid Disabled" 538 "Grid Support Enable" 539 "Grid Support Disable" 540 "Gen Support Enable" 541 "Gen Support Disable" 542 "Peak Load Shaving Enable" 543 "Peak Load Shaving Disable" 544 "Peak Load Shaving Tod Start" 545 "Peak Load Shaving Tod Stop" 546 "Unit Off" 547 "System Absorption Exit" 548 "System Inverter Enable" 549 "System AC Good" 550 "Anti Islanding Condition" 551 "Hibernate Timeout" 552 "External Sync Error" 553 "External Suspend Request" 554 "Engaging Charger" 555 "Engaging Gen Support" 556 "Grid Tie Engage Timeout" 557 "Gen Support Engage Timeout" 558 "Charge Engage Timeout" 559 "Inverter Engage Timeout" 560 "Charge Exit Timeout" 561 "Grid Support Entry Amps" 562 "Grid Support Exit Amps" 563 "Gen Support Entry Amps" 564 "Gen Support Exit Amps" 565 "Grid Support Entry Vdc" 566 "Grid Support Exit Vdc" 567 "Low Batt Cut Off Entry Vdc" 568 "Low Batt Recharge Vdc" 569 "Low Batt Cut Off Exit Vdc" 570 "Invert To Bypass Timeout" 571 "Force Charge" 572 "System Engage Bulk Charge" 441 "SPS Auto On External Shutdown Flt" 442 "SPS Auto Off Input Over Volt Flt" 443 "SPS Auto On Input Over Volt Flt" 444 "SPS Auto Off Input Over Volt Err" 445 "SPS Auto On Input Over Volt Err" 446 "SPS Auto Off Input Over Volt Wrn" 447 "SPS Auto On Input Over Volt Wrn" 448 "SPS Auto Off Output Over Volt Err" 449 "SPS Auto On Output Over Volt Err" 450 "SPS Auto Off Output Over Volt Wrn" 451 "SPS Auto On Output Over Volt Wrn" 452 "SPS Auto Off Output Under Volt Err" 453 "SPS Auto On Output Under Volt Err" 454 "SPS Auto Off Output Under Volt Wrn" 455 "SPS Auto On Output Under Volt Wrn" 456 "SPS Auto Off Output Over Curr Err" 457 "SPS Auto On Output Over Curr Err" 458 "SPS Auto Off Batt Over Temp Err" 459 "SPS Auto On Batt Over Temp Err" 460 "SPS Auto Off Batt Over Temp Wrn" 461 "SPS Auto On Batt Over Temp Wrn" 462 "SPS Auto Off Batt Under Temp Wrn" 463 "SPS Auto On Batt Under Temp Wrn" 464 "SPS Auto Off Heatsink Over Temp Err" 465 "SPS Auto On Heatsink Over Temp Err" 466 "SPS Auto Off Heatsink Over Temp Wrn" 467 "SPS Auto On Heatsink Over Temp Wrn" 468 "SPS Auto Off Ambient Over Temp Err" 469 "SPS Auto On Ambient Over Temp Err" 470 "SPS Auto Off Ambient Over Temp Wrn" 471 "SPS Auto On Ambient Over Temp Wrn" 472 "SPS Auto Off Capacitor Over Temp Err" 473 "SPS Auto On Capacitor Over Temp Err" 474 "SPS Auto Off Fan Flt" 475 "SPS Auto On Fan Flt" 476 "SPS Auto Off Fan Err" 477 "SPS Auto On Fan Err" 478 "SPS Auto Off Input Over Curr Err" 479 "SPS Auto On Input Over Curr Err" 480 "SPS Auto Off Output Over Curr Flt" 481 "SPS Auto On Output Over Curr Flt" 482 "SPS Auto Off Network PS Flt" 483 "SPS Auto On Network PS Flt" 484 "SPS Auto Off Setup Flt" 485 "SPS Auto On Setup Flt" 38 "Clear Command User Stats" 573 "AC Good Pending" 574 "Grid Safe" 585 "PLS Time In Float Ready" 575 "Power Conversion Fault" 576 "Low Battery Support Exit" 577 "Grid Support Exit" 578 "GFS Enable" 579 "GFS Disable" 580 "Force Sell" 486 "SPS Auto On Bulk Exit" 487 "SPS Auto Off Bulk Exit" 488 "SPS Auto On Absorption Exit" 489 "SPS Auto Off Absorption Exit" 490 "SPS Auto On State Of Charge Low" 491 "SPS Auto Off State Of Charge Low" 492 "SPS Auto On Time Of Day" 493 "SPS Auto Off Time Of Day" 581 "Sell Time Of Day Start" 582 "Sell Time Of Day Stop" 583 "Aux Port Time Of Day Start" 584 "Aux Port Time Of Day Stop" ;
VAL_ 2147551232 EvtId 436 "SPS Auto Off Array V Low" 437 "SPS Auto On Array V Low" 438 "SPS Auto Off Ground Flt" 439 "SPS Auto On Ground Flt" 440 "SPS Auto Off External Shutdown Flt" 0 "None" 10 "Control Command Hibernate" 11 "Control Command Safe" 12 "Control Command Power Save" 13 "Control Command Operating" 14 "Control Command Diagnostic" 15 "Control Command Last Mode" 20 "Reset Command Reboot" 21 "Reset Command Download" 22 "Reset Command Oem" 23 "Reset Command Factory" 24 "Reset Command Reboot Clear Nv" 25 "Powered Up" 30 "Clear Command Active Faults" 31 "Clear Command Fault Log" 32 "Clear Command Active Warns" 33 "Clear Command Warn Log" 34 "Clear Command State Event Log" 35 "Clear Command Comm Stats" 36 "Clear Command Stats" 37 "Clear Command All" 40 "Date Time Configured" 50 "Warn Cleared" 51 "Fault Cleared" 52 "Fault Set" 60 "User Cfg Changed" 61 "Oem Cfg Changed" 70 "Triggered Fault" 250 "Shutdown Threshold" 251 "Shutdown Hysteresis" 252 "Warning Threshold" 253 "Warning Hysteresis" 254 "Transfer Threshold" 255 "Fan 0 Threshold" 256 "Fan 10 Threshold" 257 "Fan 20 Threshold" 258 "Fan 30 Threshold" 259 "Fan 40 Threshold" 260 "Fan 50 Threshold" 261 "Fan 60 Threshold" 262 "Fan 70 Threshold" 263 "Fan 80 Threshold" 264 "Fan 90 Threshold" 265 "Fan 100 Threshold" 266 "Relay Open Threshold" 267 "Relay Close Threshold" 268 "Charger Derating Ac In V" 269 "Charger Derating Ac In I" 270 "Charger Derating Ext Temp" 271 "Charger Derating Int Temp" 272 "Charger Derating Ripple V" 273 "Lost Ac Threshold" 274 "Lost Ac Hysteresis" 275 "Imm Shutdown Threshold" 276 "Imm Shutdown Hysteresis" 277 "Charger Shutdown Threshold" 278 "Charger Shutdown Hysteresis" 279 "Charger Warning Threshold" 280 "Charger Warning Hysteresis" 281 "Inverter Shutdown Threshold" 282 "Inverter Shutdown Hysteresis" 283 "Inverter Warning Threshold" 284 "Inverter Warning Hysteresis" 285 "Charger Derating Temp Start Point" 286 "Charger Derating Temp End Point" 287 "Charger Recharge Threshold" 300 "Ags Exercise Start" 301 "Ags Exercise Stop" 302 "Ags Quiet Time Begin" 303 "Ags Quiet Time End" 304 "Ags Battery Soc Start" 305 "Ags Battery Soc Stop" 306 "Ags Dc V Start" 307 "Ags Dc V Stop" 308 "Ags Ac I Start" 309 "Ags Ac I Stop" 310 "Ags Contact Start" 311 "Ags Contact Stop" 312 "Ags Float Stop" 313 "Ags Absorp Stop" 314 "Ags Manual On" 315 "Ags Manual Off" 316 "Ags Auto" 317 "Ags External On" 318 "Ags External Off" 319 "Gen External On" 320 "Gen External Off" 321 "Ags External Shutdown" 322 "Ags Auto Off" 323 "Ags Dc I Start" 324 "Ags Dc I Stop" 325 "Ags Ac Power Start" 326 "Ags Ac Power Stop" 400 "Sps Manual Off" 401 "Sps Manual On" 410 "Sps Auto Off" 411 "Sps Auto On" 420 "Sps Auto Off Batt V Low" 421 "Sps Auto On Batt V Low" 422 "Sps Auto Off Batt V High" 423 "Sps Auto On Batt V High" 424 "Sps Auto Off Array V High" 425 "Sps Auto On Array V High" 426 "Sps Auto Off Batt Temp Low" 427 "Sps Auto On Batt Temp Low" 428 "Sps Auto Off Batt Temp High" 429 "Sps Auto On Batt Temp High" 430 "Sps Auto Off Heat Sink Temp High" 431 "Sps Auto On Heat Sink Temp High" 432 "Sps Auto Off Fault" 433 "Sps Auto On Fault" 434 "Aps Check Timeout" 435 "Aps Qualify Timeout" 512 "Resume From Safe" 513 "AC Fault Set" 514 "Invert Fault Set" 515 "Charge Fault Set" 516 "Charger Enable" 517 "Charger Disable" 518 "Inverter Enable" 519 "Inverter Disable" 520 "Charge Suspend On" 521 "Charge Suspend Off" 522 "AC Good" 523 "AC Bad" 524 "Load Sense Enable" 525 "Load Sense Active" 526 "Invert Active" 527 "Bulk Exit" 528 "Absorption Exit" 529 "Float Exit" 530 "Float 3-Stage Set" 531 "Float 2-Stage Set" 532 "Equalize Enable" 533 "Equalize Disable" 534 "Equalize Exit" 535 "Load Sense Disable" 536 "Sell To Grid Enabled" 537 "Sell To Grid Disabled" 538 "Grid Support Enable" 539 "Grid Support Disable" 540 "Gen Support Enable" 541 "Gen Support Disable" 542 "Peak Load Shaving Enable" 543 "Peak Load Shaving Disable" 544 "Peak Load Shaving Tod Start" 545 "Peak Load Shaving Tod Stop" 546 "Unit Off" 547 "System Absorption Exit" 548 "System Inverter Enable" 549 "System AC Good" 550 "Anti Islanding Condition" 551 "Hibernate Timeout" 552 "External Sync Error" 553 "External Suspend Request" 554 "Engaging Charger" 555 "Engaging Gen Support" 556 "Grid Tie Engage Timeout" 557 "Gen Support Engage Timeout" 558 "Charge Engage Timeout" 559 "Inverter Engage Timeout" 560 "Charge Exit Timeout" 561 "Grid Support Entry Amps" 562 "Grid Support Exit Amps" 563 "Gen Support Entry Amps" 564 "Gen Support Exit Amps" 565 "Grid Support Entry Vdc" 566 "Grid Support Exit Vdc" 567 "Low Batt Cut Off Entry Vdc" 568 "Low Batt Recharge Vdc" 569 "Low Batt Cut Off Exit Vdc" 570 "Invert To Bypass Timeout" 571 "Force Charge" 572 "System Engage Bulk Charge" 441 "SPS Auto On External Shutdown Flt" 442 "SPS Auto Off Input Over Volt Flt" 443 "SPS Auto On Input Over Volt Flt" 444 "SPS Auto Off Input Over Volt Err" 445 "SPS Auto On Input Over Volt Err" 446 "SPS Auto Off Input Over Volt Wrn" 447 "SPS Auto On Input Over Volt Wrn" 448 "SPS Auto Off Output Over Volt Err" 449 "SPS Auto On Output Over Volt Err" 450 "SPS Auto Off Output Over Volt Wrn" 451 "SPS Auto On Output Over Volt Wrn" 452 "SPS Auto Off Output Under Volt Err" 453 "SPS Auto On Output Under Volt Err" 454 "SPS Auto Off Output Under Volt Wrn" 455 "SPS Auto On Output Under Volt Wrn" 456 "SPS Auto Off Output Over Curr Err" 457 "SPS Auto On Output Over Curr Err" 458 "SPS Auto Off Batt Over Temp Err" 459 "SPS Auto On Batt Over Temp Err" 460 "SPS Auto Off Batt Over Temp Wrn" 461 "SPS Auto On Batt Over Temp Wrn" 462 "SPS Auto Off Batt Under Temp Wrn" 463 "SPS Auto On Batt Under Temp Wrn" 464 "SPS Auto Off Heatsink Over Temp Err" 465 "SPS Auto On Heatsink Over Temp Err" 466 "SPS Auto Off Heatsink Over Temp Wrn" 467 "SPS Auto On Heatsink Over Temp Wrn" 468 "SPS Auto Off Ambient Over Temp Err" 469 "SPS Auto On Ambient Over Temp Err" 470 "SPS Auto Off Ambient Over Temp Wrn" 471 "SPS Auto On Ambient Over Temp Wrn" 472 "SPS Auto Off Capacitor Over Temp Err" 473 "SPS Auto On Capacitor Over Temp Err" 474 "SPS Auto Off Fan Flt" 475 "SPS Auto On Fan Flt" 476 "SPS Auto Off Fan Err" 477 "SPS Auto On Fan Err" 478 "SPS Auto Off Input Over Curr Err" 479 "SPS Auto On Input Over Curr Err" 480 "SPS Auto Off Output Over Curr Flt" 481 "SPS Auto On Output Over Curr Flt" 482 "SPS Auto Off Network PS Flt" 483 "SPS Auto On Network PS Flt" 484 "SPS Auto Off Setup Flt" 485 "SPS Auto On Setup Flt" 38 "Clear Command User Stats" 573 "AC Good Pending" 574 "Grid Safe" 585 "PLS Time In Float Ready" 575 "Power Conversion Fault" 576 "Low Battery Support Exit" 577 "Grid Support Exit" 578 "GFS Enable" 579 "GFS Disable" 580 "Force Sell" 486 "SPS Auto On Bulk Exit" 487 "SPS Auto Off Bulk Exit" 488 "SPS Auto On Absorption Exit" 489 "SPS Auto Off Absorption Exit" 490 "SPS Auto On State Of Charge Low" 491 "SPS Auto Off State Of Charge Low" 492 "SPS Auto On Time Of Day" 493 "SPS Auto Off Time Of Day" 581 "Sell Time Of Day Start" 582 "Sell Time Of Day Stop" 583 "Aux Port Time Of Day Start" 584 "Aux Port Time Of Day Stop" ;
VAL_ 2147551232 CfgType 0 "User" 1 "OEM" 2 "Factory" 3 "Reserved" ;
VAL_ 2147551232 AcSrcId 0 "Invalid" 1 "None" 2 "Anonymous" 3 "Shore1" 4 "Shore2" 5 "Shore3" 6 "Shore4" 7 "Shore5" 8 "Shore6" 9 "Shore7" 10 "Shore8" 11 "Shore9" 12 "Shore10" 13 "Shore11" 14 "Shore12" 15 "Shore13" 16 "Shore14" 17 "Shore15" 18 "Shore16" 19 "Gen1" 20 "Gen2" 21 "Gen3" 22 "Gen4" 23 "Gen5" 24 "Gen6" 25 "Gen7" 26 "Gen8" 27 "Gen9" 28 "Gen10" 29 "Gen11" 30 "Gen12" 31 "Gen13" 32 "Gen14" 33 "Gen15" 34 "Gen16" 35 "AC1" 36 "AC2" 37 "AC3" 38 "AC4" 39 "AC5" 40 "AC6" 41 "AC7" 42 "AC8" 43 "AC9" 44 "AC10" 45 "AC11" 46 "AC12" 47 "AC13" 48 "AC14" 49 "AC15" 50 "AC16" 51 "AC Load1" 52 "AC Load2" 53 "AC Load3" 54 "AC Load4" 55 "AC Load5" 56 "AC Load6" 57 "AC Load7" 58 "AC Load8" 59 "AC Load9" 60 "AC Load10" 61 "AC Load11" 62 "AC Load12" 63 "AC Load13" 64 "AC Load14" 65 "AC Load15" 66 "AC Load16" 67 "Grid1" 68 "Grid2" 69 "Grid3" 70 "Grid4" 71 "Grid5" 72 "Grid6" 73 "Grid7" 74 "Grid8" 75 "Grid9" 76 "Grid10" 77 "Grid11" 78 "Grid12" 79 "Grid13" 80 "Grid14" 81 "Grid15" 82 "Grid16" 252 "All" 253 "Reserved" 254 "Out Of Range" 255 "Data Not Available Do Not Change" ;
VAL_ 2147551488 RefEvtId 436 "SPS Auto Off Array V Low" 437 "SPS Auto On Array V Low" 438 "SPS Auto Off Ground Flt" 439 "SPS Auto On Ground Flt" 440 "SPS Auto Off External Shutdown Flt" 0 "None" 10 "Control Command Hibernate" 11 "Control Command Safe" 12 "Control Command Power Save" 13 "Control Command Operating" 14 "Control Command Diagnostic" 15 "Control Command Last Mode" 20 "Reset Command Reboot" 21 "Reset Command Download" 22 "Reset Command Oem" 23 "Reset Command Factory" 24 "Reset Command Reboot Clear Nv" 25 "Powered Up" 30 "Clear Command Active Faults" 31 "Clear Command Fault Log" 32 "Clear Command Active Warns" 33 "Clear Command Warn Log" 34 "Clear Command State Event Log" 35 "Clear Command Comm Stats" 36 "Clear Command Stats" 37 "Clear Command All" 40 "Date Time Configured" 50 "Warn Cleared" 51 "Fault Cleared" 52 "Fault Set" 60 "User Cfg Changed" 61 "Oem Cfg Changed" 70 "Triggered Fault" 250 "Shutdown Threshold" 251 "Shutdown Hysteresis" 252 "Warning Threshold" 253 "Warning Hysteresis" 254 "Transfer Threshold" 255 "Fan 0 Threshold" 256 "Fan 10 Threshold" 257 "Fan 20 Threshold" 258 "Fan 30 Threshold" 259 "Fan 40 Threshold" 260 "Fan 50 Threshold" 261 "Fan 60 Threshold" 262 "Fan 70 Threshold" 263 "Fan 80 Threshold" 264 "Fan 90 Threshold" 265 "Fan 100 Threshold" 266 "Relay Open Threshold" 267 "Relay Close Threshold" 268 "Charger Derating Ac In V" 269 "Charger Derating Ac In I" 270 "Charger Derating Ext Temp" 271 "Charger Derating Int Temp" 272 "Charger Derating Ripple V" 273 "Lost Ac Threshold" 274 "Lost Ac Hysteresis" 275 "Imm Shutdown Threshold" 276 "Imm Shutdown Hysteresis" 277 "Charger Shutdown Threshold" 278 "Charger Shutdown Hysteresis" 279 "Charger Warning Threshold" 280 "Charger Warning Hysteresis" 281 "Inverter Shutdown Threshold" 282 "Inverter Shutdown Hysteresis" 283 "Inverter Warning Threshold" 284 "Inverter Warning Hysteresis" 285 "Charger Derating Temp Start Point" 286 "Charger Derating Temp End Point" 287 "Charger Recharge Threshold" 300 "Ags Exercise Start" 301 "Ags Exercise Stop" 302 "Ags Quiet Time Begin" 303 "Ags Quiet Time End" 304 "Ags Battery Soc Start" 305 "Ags Battery Soc Stop" 306 "Ags Dc V Start" 307 "Ags Dc V Stop" 308 "Ags Ac I Start" 309 "Ags Ac I Stop" 310 "Ags Contact Start" 311 "Ags Contact Stop" 312 "Ags Float Stop" 313 "Ags Absorp Stop" 314 "Ags Manual On" 315 "Ags Manual Off" 316 "Ags Auto" 317 "Ags External On" 318 "Ags External Off" 319 "Gen External On" 320 "Gen External Off" 321 "Ags External Shutdown" 322 "Ags Auto Off" 323 "Ags Dc I Start" 324 "Ags Dc I Stop" 325 "Ags Ac Power Start" 326 "Ags Ac Power Stop" 400 "Sps Manual Off" 401 "Sps Manual On" 410 "Sps Auto Off" 411 "Sps Auto On" 420 "Sps Auto Off Batt V Low" 421 "Sps Auto On Batt V Low" 422 "Sps Auto Off Batt V High" 423 "Sps Auto On Batt V High" 424 "Sps Auto Off Array V High" 425 "Sps Auto On Array V High" 426 "Sps Auto Off Batt Temp Low" 427 "Sps Auto On Batt Temp Low" 428 "Sps Auto Off Batt Temp High" 429 "Sps Auto On Batt Temp High" 430 "Sps Auto Off Heat Sink Temp High" 431 "Sps Auto On Heat Sink Temp High" 432 "Sps Auto Off Fault" 433 "Sps Auto On Fault" 434 "Aps Check Timeout" 435 "Aps Qualify Timeout" 512 "Resume From Safe" 513 "AC Fault Set" 514 "Invert Fault Set" 515 "Charge Fault Set" 516 "Charger Enable" 517 "Charger Disable" 518 "Inverter Enable" 519 "Inverter Disable" 520 "Charge Suspend On" 521 "Charge Suspend Off" 522 "AC Good" 523 "AC Bad" 524 "Load Sense Enable" 525 "Load Sense Active" 526 "Invert Active" 527 "Bulk Exit" 528 "Absorption Exit" 529 "Float Exit" 530 "Float 3-Stage Set" 531 "Float 2-Stage Set" 532 "Equalize Enable" 533 "Equalize Disable" 534 "Equalize Exit" 535 "Load Sense Disable" 536 "Sell To Grid Enabled" 537 "Sell To Grid Disabled" 538 "Grid Support Enable" 539 "Grid Support Disable" 540 "Gen Support Enable" 541 "Gen Support Disable" 542 "Peak Load Shaving Enable" 543 "Peak Load Shaving Disable" 544 "Peak Load Shaving Tod Start" 545 "Peak Load Shaving Tod Stop" 546 "Unit Off" 547 "System Absorption Exit" 548 "System Inverter Enable" 549 "System AC Good" 550 "Anti Islanding Condition" 551 "Hibernate Timeout" 552 "External Sync Error" 553 "External Suspend Request" 554 "Engaging Charger" 555 "Engaging Gen Support" 556 "Grid Tie Engage Timeout" 557 "Gen Support Engage Timeout" 558 "Charge Engage Timeout" 559 "Inverter Engage Timeout" 560 "Charge Exit Timeout" 561 "Grid Support Entry Amps" 562 "Grid Support Exit Amps" 563 "Gen Support Entry Amps" 564 "Gen Support Exit Amps" 565 "Grid Support Entry Vdc" 566 "Grid Support Exit Vdc" 567 "Low Batt Cut Off Entry Vdc" 568 "Low Batt Recharge Vdc" 569 "Low Batt Cut Off Exit Vdc" 570 "Invert To Bypass Timeout" 571 "Force Charge" 572 "System Engage Bulk Charge" 441 "SPS Auto On External Shutdown Flt" 442 "SPS Auto Off Input Over Volt Flt" 443 "SPS Auto On Input Over Volt Flt" 444 "SPS Auto Off Input Over Volt Err" 445 "SPS Auto On Input Over Volt Err" 446 "SPS Auto Off Input Over Volt Wrn" 447 "SPS Auto On Input Over Volt Wrn" 448 "SPS Auto Off Output Over Volt Err" 449 "SPS Auto On Output Over Volt Err" 450 "SPS Auto Off Output Over Volt Wrn" 451 "SPS Auto On Output Over Volt Wrn" 452 "SPS Auto Off Output Under Volt Err" 453 "SPS Auto On Output Under Volt Err" 454 "SPS Auto Off Output Under Volt Wrn" 455 "SPS Auto On Output Under Volt Wrn" 456 "SPS Auto Off Output Over Curr Err" 457 "SPS Auto On Output Over Curr Err" 458 "SPS Auto Off Batt Over Temp Err" 459 "SPS Auto On Batt Over Temp Err" 460 "SPS Auto Off Batt Over Temp Wrn" 461 "SPS Auto On Batt Over Temp Wrn" 462 "SPS Auto Off Batt Under Temp Wrn" 463 "SPS Auto On Batt Under Temp Wrn" 464 "SPS Auto Off Heatsink Over Temp Err" 465 "SPS Auto On Heatsink Over Temp Err" 466 "SPS Auto Off Heatsink Over Temp Wrn" 467 "SPS Auto On Heatsink Over Temp Wrn" 468 "SPS Auto Off Ambient Over Temp Err" 469 "SPS Auto On Ambient Over Temp Err" 470 "SPS Auto Off Ambient Over Temp Wrn" 471 "SPS Auto On Ambient Over Temp Wrn" 472 "SPS Auto Off Capacitor Over Temp Err" 473 "SPS Auto On Capacitor Over Temp Err" 474 "SPS Auto Off Fan Flt" 475 "SPS Auto On Fan Flt" 476 "SPS Auto Off Fan Err" 477 "SPS Auto On Fan Err" 478 "SPS Auto Off Input Over Curr Err" 479 "SPS Auto On Input Over Curr Err" 480 "SPS Auto Off Output Over Curr Flt" 481 "SPS Auto On Output Over Curr Flt" 482 "SPS Auto Off Network PS Flt" 483 "SPS Auto On Network PS Flt" 484 "SPS Auto Off Setup Flt" 485 "SPS Auto On Setup Flt" 38 "Clear Command User Stats" 573 "AC Good Pending" 574 "Grid Safe" 585 "PLS Time In Float Ready" 575 "Power Conversion Fault" 576 "Low Battery Support Exit" 577 "Grid Support Exit" 578 "GFS Enable" 579 "GFS Disable" 580 "Force Sell" 486 "SPS Auto On Bulk Exit" 487 "SPS Auto Off Bulk Exit" 488 "SPS Auto On Absorption Exit" 489 "SPS Auto Off Absorption Exit" 490 "SPS Auto On State Of Charge Low" 491 "SPS Auto Off State Of Charge Low" 492 "SPS Auto On Time Of Day" 493 "SPS Auto Off Time Of Day" 581 "Sell Time Of Day Start" 582 "Sell Time Of Day Stop" 583 "Aux Port Time Of Day Start" 584 "Aux Port Time Of Day Stop" ;
VAL_ 2147551488 EvtId 436 "SPS Auto Off Array V Low" 437 "SPS Auto On Array V Low" 438 "SPS Auto Off Ground Flt" 439 "SPS Auto On Ground Flt" 440 "SPS Auto Off External Shutdown Flt" 0 "None" 10 "Control Command Hibernate" 11 "Control Command Safe" 12 "Control Command Power Save" 13 "Control Command Operating" 14 "Control Command Diagnostic" 15 "Control Command Last Mode" 20 "Reset Command Reboot" 21 "Reset Command Download" 22 "Reset Command Oem" 23 "Reset Command Factory" 24 "Reset Command Reboot Clear Nv" 25 "Powered Up" 30 "Clear Command Active Faults" 31 "Clear Command Fault Log" 32 "Clear Command Active Warns" 33 "Clear Command Warn Log" 34 "Clear Command State Event Log" 35 "Clear Command Comm Stats" 36 "Clear Command Stats" 37 "Clear Command All" 40 "Date Time Configured" 50 "Warn Cleared" 51 "Fault Cleared" 52 "Fault Set" 60 "User Cfg Changed" 61 "Oem Cfg Changed" 70 "Triggered Fault" 250 "Shutdown Threshold" 251 "Shutdown Hysteresis" 252 "Warning Threshold" 253 "Warning Hysteresis" 254 "Transfer Threshold" 255 "Fan 0 Threshold" 256 "Fan 10 Threshold" 257 "Fan 20 Threshold" 258 "Fan 30 Threshold" 259 "Fan 40 Threshold" 260 "Fan 50 Threshold" 261 "Fan 60 Threshold" 262 "Fan 70 Threshold" 263 "Fan 80 Threshold" 264 "Fan 90 Threshold" 265 "Fan 100 Threshold" 266 "Relay Open Threshold" 267 "Relay Close Threshold" 268 "Charger Derating Ac In V" 269 "Charger Derating Ac In I" 270 "Charger Derating Ext Temp" 271 "Charger Derating Int Temp" 272 "Charger Derating Ripple V" 273 "Lost Ac Threshold" 274 "Lost Ac Hysteresis" 275 "Imm Shutdown Threshold" 276 "Imm Shutdown Hysteresis" 277 "Charger Shutdown Threshold" 278 "Charger Shutdown Hysteresis" 279 "Charger Warning Threshold" 280 "Charger Warning Hysteresis" 281 "Inverter Shutdown Threshold" 282 "Inverter Shutdown Hysteresis" 283 "Inverter Warning Threshold" 284 "Inverter Warning Hysteresis" 285 "Charger Derating Temp Start Point" 286 "Charger Derating Temp End Point" 287 "Charger Recharge Threshold" 300 "Ags Exercise Start" 301 "Ags Exercise Stop" 302 "Ags Quiet Time Begin" 303 "Ags Quiet Time End" 304 "Ags Battery Soc Start" 305 "Ags Battery Soc Stop" 306 "Ags Dc V Start" 307 "Ags Dc V Stop" 308 "Ags Ac I Start" 309 "Ags Ac I Stop" 310 "Ags Contact Start" 311 "Ags Contact Stop" 312 "Ags Float Stop" 313 "Ags Absorp Stop" 314 "Ags Manual On" 315 "Ags Manual Off" 316 "Ags Auto" 317 "Ags External On" 318 "Ags External Off" 319 "Gen External On" 320 "Gen External Off" 321 "Ags External Shutdown" 322 "Ags Auto Off" 323 "Ags Dc I Start" 324 "Ags Dc I Stop" 325 "Ags Ac Power Start" 326 "Ags Ac Power Stop" 400 "Sps Manual Off" 401 "Sps Manual On" 410 "Sps Auto Off" 411 "Sps Auto On" 420 "Sps Auto Off Batt V Low" 421 "Sps Auto On Batt V Low" 422 "Sps Auto Off Batt V High" 423 "Sps Auto On Batt V High" 424 "Sps Auto Off Array V High" 425 "Sps Auto On Array V High" 426 "Sps Auto Off Batt Temp Low" 427 "Sps Auto On Batt Temp Low" 428 "Sps Auto Off Batt Temp High" 429 "Sps Auto On Batt Temp High" 430 "Sps Auto Off Heat Sink Temp High" 431 "Sps Auto On Heat Sink Temp High" 432 "Sps Auto Off Fault" 433 "Sps Auto On Fault" 434 "Aps Check Timeout" 435 "Aps Qualify Timeout" 512 "Resume From Safe" 513 "AC Fault Set" 514 "Invert Fault Set" 515 "Charge Fault Set" 516 "Charger Enable" 517 "Charger Disable" 518 "Inverter Enable" 519 "Inverter Disable" 520 "Charge Suspend On" 521 "Charge Suspend Off" 522 "AC Good" 523 "AC Bad" 524 "Load Sense Enable" 525 "Load Sense Active" 526 "Invert Active" 527 "Bulk Exit" 528 "Absorption Exit" 529 "Float Exit" 530 "Float 3-Stage Set" 531 "Float 2-Stage Set" 532 "Equalize Enable" 533 "Equalize Disable" 534 "Equalize Exit" 535 "Load Sense Disable" 536 "Sell To Grid Enabled" 537 "Sell To Grid Disabled" 538 "Grid Support Enable" 539 "Grid Support Disable" 540 "Gen Support Enable" 541 "Gen Support Disable" 542 "Peak Load Shaving Enable" 543 "Peak Load Shaving Disable" 544 "Peak Load Shaving Tod Start" 545 "Peak Load Shaving Tod Stop" 546 "Unit Off" 547 "System Absorption Exit" 548 "System Inverter Enable" 549 "System AC Good" 550 "Anti Islanding Condition" 551 "Hibernate Timeout" 552 "External Sync Error" 553 "External Suspend Request" 554 "Engaging Charger" 555 "Engaging Gen Support" 556 "Grid Tie Engage Timeout" 557 "Gen Support Engage Timeout" 558 "Charge Engage Timeout" 559 "Inverter Engage Timeout" 560 "Charge Exit Timeout" 561 "Grid Support Entry Amps" 562 "Grid Support Exit Amps" 563 "Gen Support Entry Amps" 564 "Gen Support Exit Amps" 565 "Grid Support Entry Vdc" 566 "Grid Support Exit Vdc" 567 "Low Batt Cut Off Entry Vdc" 568 "Low Batt Recharge Vdc" 569 "Low Batt Cut Off Exit Vdc" 570 "Invert To Bypass Timeout" 571 "Force Charge" 572 "System Engage Bulk Charge" 441 "SPS Auto On External Shutdown Flt" 442 "SPS Auto Off Input Over Volt Flt" 443 "SPS Auto On Input Over Volt Flt" 444 "SPS Auto Off Input Over Volt Err" 445 "SPS Auto On Input Over Volt Err" 446 "SPS Auto Off Input Over Volt Wrn" 447 "SPS Auto On Input Over Volt Wrn" 448 "SPS Auto Off Output Over Volt Err" 449 "SPS Auto On Output Over Volt Err" 450 "SPS Auto Off Output Over Volt Wrn" 451 "SPS Auto On Output Over Volt Wrn" 452 "SPS Auto Off Output Under Volt Err" 453 "SPS Auto On Output Under Volt Err" 454 "SPS Auto Off Output Under Volt Wrn" 455 "SPS Auto On Output Under Volt Wrn" 456 "SPS Auto Off Output Over Curr Err" 457 "SPS Auto On Output Over Curr Err" 458 "SPS Auto Off Batt Over Temp Err" 459 "SPS Auto On Batt Over Temp Err" 460 "SPS Auto Off Batt Over Temp Wrn" 461 "SPS Auto On Batt Over Temp Wrn" 462 "SPS Auto Off Batt Under Temp Wrn" 463 "SPS Auto On Batt Under Temp Wrn" 464 "SPS Auto Off Heatsink Over Temp Err" 465 "SPS Auto On Heatsink Over Temp Err" 466 "SPS Auto Off Heatsink Over Temp Wrn" 467 "SPS Auto On Heatsink Over Temp Wrn" 468 "SPS Auto Off Ambient Over Temp Err" 469 "SPS Auto On Ambient Over Temp Err" 470 "SPS Auto Off Ambient Over Temp Wrn" 471 "SPS Auto On Ambient Over Temp Wrn" 472 "SPS Auto Off Capacitor Over Temp Err" 473 "SPS Auto On Capacitor Over Temp Err" 474 "SPS Auto Off Fan Flt" 475 "SPS Auto On Fan Flt" 476 "SPS Auto Off Fan Err" 477 "SPS Auto On Fan Err" 478 "SPS Auto Off Input Over Curr Err" 479 "SPS Auto On Input Over Curr Err" 480 "SPS Auto Off Output Over Curr Flt" 481 "SPS Auto On Output Over Curr Flt" 482 "SPS Auto Off Network PS Flt" 483 "SPS Auto On Network PS Flt" 484 "SPS Auto Off Setup Flt" 485 "SPS Auto On Setup Flt" 38 "Clear Command User Stats" 573 "AC Good Pending" 574 "Grid Safe" 585 "PLS Time In Float Ready" 575 "Power Conversion Fault" 576 "Low Battery Support Exit" 577 "Grid Support Exit" 578 "GFS Enable" 579 "GFS Disable" 580 "Force Sell" 486 "SPS Auto On Bulk Exit" 487 "SPS Auto Off Bulk Exit" 488 "SPS Auto On Absorption Exit" 489 "SPS Auto Off Absorption Exit" 490 "SPS Auto On State Of Charge Low" 491 "SPS Auto Off State Of Charge Low" 492 "SPS Auto On Time Of Day" 493 "SPS Auto Off Time Of Day" 581 "Sell Time Of Day Start" 582 "Sell Time Of Day Stop" 583 "Aux Port Time Of Day Start" 584 "Aux Port Time Of Day Stop" ;
VAL_ 2147551488 CfgType 0 "User" 1 "OEM" 2 "Factory" 3 "Reserved" ;
VAL_ 2147551488 AcSrcId 0 "Invalid" 1 "None" 2 "Anonymous" 3 "Shore1" 4 "Shore2" 5 "Shore3" 6 "Shore4" 7 "Shore5" 8 "Shore6" 9 "Shore7" 10 "Shore8" 11 "Shore9" 12 "Shore10" 13 "Shore11" 14 "Shore12" 15 "Shore13" 16 "Shore14" 17 "Shore15" 18 "Shore16" 19 "Gen1" 20 "Gen2" 21 "Gen3" 22 "Gen4" 23 "Gen5" 24 "Gen6" 25 "Gen7" 26 "Gen8" 27 "Gen9" 28 "Gen10" 29 "Gen11" 30 "Gen12" 31 "Gen13" 32 "Gen14" 33 "Gen15" 34 "Gen16" 35 "AC1" 36 "AC2" 37 "AC3" 38 "AC4" 39 "AC5" 40 "AC6" 41 "AC7" 42 "AC8" 43 "AC9" 44 "AC10" 45 "AC11" 46 "AC12" 47 "AC13" 48 "AC14" 49 "AC15" 50 "AC16" 51 "AC Load1" 52 "AC Load2" 53 "AC Load3" 54 "AC Load4" 55 "AC Load5" 56 "AC Load6" 57 "AC Load7" 58 "AC Load8" 59 "AC Load9" 60 "AC Load10" 61 "AC Load11" 62 "AC Load12" 63 "AC Load13" 64 "AC Load14" 65 "AC Load15" 66 "AC Load16" 67 "Grid1" 68 "Grid2" 69 "Grid3" 70 "Grid4" 71 "Grid5" 72 "Grid6" 73 "Grid7" 74 "Grid8" 75 "Grid9" 76 "Grid10" 77 "Grid11" 78 "Grid12" 79 "Grid13" 80 "Grid14" 81 "Grid15" 82 "Grid16" 252 "All" 253 "Reserved" 254 "Out Of Range" 255 "Data Not Available Do Not Change" ;
VAL_ 2147569408 RefEvtId 436 "SPS Auto Off Array V Low" 437 "SPS Auto On Array V Low" 438 "SPS Auto Off Ground Flt" 439 "SPS Auto On Ground Flt" 440 "SPS Auto Off External Shutdown Flt" 0 "None" 10 "Control Command Hibernate" 11 "Control Command Safe" 12 "Control Command Power Save" 13 "Control Command Operating" 14 "Control Command Diagnostic" 15 "Control Command Last Mode" 20 "Reset Command Reboot" 21 "Reset Command Download" 22 "Reset Command Oem" 23 "Reset Command Factory" 24 "Reset Command Reboot Clear Nv" 25 "Powered Up" 30 "Clear Command Active Faults" 31 "Clear Command Fault Log" 32 "Clear Command Active Warns" 33 "Clear Command Warn Log" 34 "Clear Command State Event Log" 35 "Clear Command Comm Stats" 36 "Clear Command Stats" 37 "Clear Command All" 40 "Date Time Configured" 50 "Warn Cleared" 51 "Fault Cleared" 52 "Fault Set" 60 "User Cfg Changed" 61 "Oem Cfg Changed" 70 "Triggered Fault" 250 "Shutdown Threshold" 251 "Shutdown Hysteresis" 252 "Warning Threshold" 253 "Warning Hysteresis" 254 "Transfer Threshold" 255 "Fan 0 Threshold" 256 "Fan 10 Threshold" 257 "Fan 20 Threshold" 258 "Fan 30 Threshold" 259 "Fan 40 Threshold" 260 "Fan 50 Threshold" 261 "Fan 60 Threshold" 262 "Fan 70 Threshold" 263 "Fan 80 Threshold" 264 "Fan 90 Threshold" 265 "Fan 100 Threshold" 266 "Relay Open Threshold" 267 "Relay Close Threshold" 268 "Charger Derating Ac In V" 269 "Charger Derating Ac In I" 270 "Charger Derating Ext Temp" 271 "Charger Derating Int Temp" 272 "Charger Derating Ripple V" 273 "Lost Ac Threshold" 274 "Lost Ac Hysteresis" 275 "Imm Shutdown Threshold" 276 "Imm Shutdown Hysteresis" 277 "Charger Shutdown Threshold" 278 "Charger Shutdown Hysteresis" 279 "Charger Warning Threshold" 280 "Charger Warning Hysteresis" 281 "Inverter Shutdown Threshold" 282 "Inverter Shutdown Hysteresis" 283 "Inverter Warning Threshold" 284 "Inverter Warning Hysteresis" 285 "Charger Derating Temp Start Point" 286 "Charger Derating Temp End Point" 287 "Charger Recharge Threshold" 300 "Ags Exercise Start" 301 "Ags Exercise Stop" 302 "Ags Quiet Time Begin" 303 "Ags Quiet Time End" 304 "Ags Battery Soc Start" 305 "Ags Battery Soc Stop" 306 "Ags Dc V Start" 307 "Ags Dc V Stop" 308 "Ags Ac I Start" 309 "Ags Ac I Stop" 310 "Ags Contact Start" 311 "Ags Contact Stop" 312 "Ags Float Stop" 313 "Ags Absorp Stop" 314 "Ags Manual On" 315 "Ags Manual Off" 316 "Ags Auto" 317 "Ags External On" 318 "Ags External Off" 319 "Gen External On" 320 "Gen External Off" 321 "Ags External Shutdown" 322 "Ags Auto Off" 323 "Ags Dc I Start" 324 "Ags Dc I Stop" 325 "Ags Ac Power Start" 326 "Ags Ac Power Stop" 400 "Sps Manual Off" 401 "Sps Manual On" 410 "Sps Auto Off" 411 "Sps Auto On" 420 "Sps Auto Off Batt V Low" 421 "Sps Auto On Batt V Low" 422 "Sps Auto Off Batt V High" 423 "Sps Auto On Batt V High" 424 "Sps Auto Off Array V High" 425 "Sps Auto On Array V High" 426 "Sps Auto Off Batt Temp Low" 427 "Sps Auto On Batt Temp Low" 428 "Sps Auto Off Batt Temp High" 429 "Sps Auto On Batt Temp High" 430 "Sps Auto Off Heat Sink Temp High" 431 "Sps Auto On Heat Sink Temp High" 432 "Sps Auto Off Fault" 433 "Sps Auto On Fault" 434 "Aps Check Timeout" 435 "Aps Qualify Timeout" 512 "Resume From Safe" 513 "AC Fault Set" 514 "Invert Fault Set" 515 "Charge Fault Set" 516 "Charger Enable" 517 "Charger Disable" 518 "Inverter Enable" 519 "Inverter Disable" 520 "Charge Suspend On" 521 "Charge Suspend Off" 522 "AC Good" 523 "AC Bad" 524 "Load Sense Enable" 525 "Load Sense Active" 526 "Invert Active" 527 "Bulk Exit" 528 "Absorption Exit" 529 "Float Exit" 530 "Float 3-Stage Set" 531 "Float 2-Stage Set" 532 "Equalize Enable" 533 "Equalize Disable" 534 "Equalize Exit" 535 "Load Sense Disable" 536 "Sell To Grid Enabled" 537 "Sell To Grid Disabled" 538 "Grid Support Enable" 539 "Grid Support Disable" 540 "Gen Support Enable" 541 "Gen Support Disable" 542 "Peak Load Shaving Enable" 543 "Peak Load Shaving Disable" 544 "Peak Load Shaving Tod Start" 545 "Peak Load Shaving Tod Stop" 546 "Unit Off" 547 "System Absorption Exit" 548 "System Inverter Enable" 549 "System AC Good" 550 "Anti Islanding Condition" 551 "Hibernate Timeout" 552 "External Sync Error" 553 "External Suspend Request" 554 "Engaging Charger" 555 "Engaging Gen Support" 556 "Grid Tie Engage Timeout" 557 "Gen Support Engage Timeout" 558 "Charge Engage Timeout" 559 "Inverter Engage Timeout" 560 "Charge Exit Timeout" 561 "Grid Support Entry Amps" 562 "Grid Support Exit Amps" 563 "Gen Support Entry Amps" 564 "Gen Support Exit Amps" 565 "Grid Support Entry Vdc" 566 "Grid Support Exit Vdc" 567 "Low Batt Cut Off Entry Vdc" 568 "Low Batt Recharge Vdc" 569 "Low Batt Cut Off Exit Vdc" 570 "Invert To Bypass Timeout" 571 "Force Charge" 572 "System Engage Bulk Charge" 441 "SPS Auto On External Shutdown Flt" 442 "SPS Auto Off Input Over Volt Flt" 443 "SPS Auto On Input Over Volt Flt" 444 "SPS Auto Off Input Over Volt Err" 445 "SPS Auto On Input Over Volt Err" 446 "SPS Auto Off Input Over Volt Wrn" 447 "SPS Auto On Input Over Volt Wrn" 448 "SPS Auto Off Output Over Volt Err" 449 "SPS Auto On Output Over Volt Err" 450 "SPS Auto Off Output Over Volt Wrn" 451 "SPS Auto On Output Over Volt Wrn" 452 "SPS Auto Off Output Under Volt Err" 453 "SPS Auto On Output Under Volt Err" 454 "SPS Auto Off Output Under Volt Wrn" 455 "SPS Auto On Output Under Volt Wrn" 456 "SPS Auto Off Output Over Curr Err" 457 "SPS Auto On Output Over Curr Err" 458 "SPS Auto Off Batt Over Temp Err" 459 "SPS Auto On Batt Over Temp Err" 460 "SPS Auto Off Batt Over Temp Wrn" 461 "SPS Auto On Batt Over Temp Wrn" 462 "SPS Auto Off Batt Under Temp Wrn" 463 "SPS Auto On Batt Under Temp Wrn" 464 "SPS Auto Off Heatsink Over Temp Err" 465 "SPS Auto On Heatsink Over Temp Err" 466 "SPS Auto Off Heatsink Over Temp Wrn" 467 "SPS Auto On Heatsink Over Temp Wrn" 468 "SPS Auto Off Ambient Over Temp Err" 469 "SPS Auto On Ambient Over Temp Err" 470 "SPS Auto Off Ambient Over Temp Wrn" 471 "SPS Auto On Ambient Over Temp Wrn" 472 "SPS Auto Off Capacitor Over Temp Err" 473 "SPS Auto On Capacitor Over Temp Err" 474 "SPS Auto Off Fan Flt" 475 "SPS Auto On Fan Flt" 476 "SPS Auto Off Fan Err" 477 "SPS Auto On Fan Err" 478 "SPS Auto Off Input Over Curr Err" 479 "SPS Auto On Input Over Curr Err" 480 "SPS Auto Off Output Over Curr Flt" 481 "SPS Auto On Output Over Curr Flt" 482 "SPS Auto Off Network PS Flt" 483 "SPS Auto On Network PS Flt" 484 "SPS Auto Off Setup Flt" 485 "SPS Auto On Setup Flt" 38 "Clear Command User Stats" 573 "AC Good Pending" 574 "Grid Safe" 585 "PLS Time In Float Ready" 575 "Power Conversion Fault" 576 "Low Battery Support Exit" 577 "Grid Support Exit" 578 "GFS Enable" 579 "GFS Disable" 580 "Force Sell" 486 "SPS Auto On Bulk Exit" 487 "SPS Auto Off Bulk Exit" 488 "SPS Auto On Absorption Exit" 489 "SPS Auto Off Absorption Exit" 490 "SPS Auto On State Of Charge Low" 491 "SPS Auto Off State Of Charge Low" 492 "SPS Auto On Time Of Day" 493 "SPS Auto Off Time Of Day" 581 "Sell Time Of Day Start" 582 "Sell Time Of Day Stop" 583 "Aux Port Time Of Day Start" 584 "Aux Port Time Of Day Stop" ;
VAL_ 2147569408 EvtId 436 "SPS Auto Off Array V Low" 437 "SPS Auto On Array V Low" 438 "SPS Auto Off Ground Flt" 439 "SPS Auto On Ground Flt" 440 "SPS Auto Off External Shutdown Flt" 0 "None" 10 "Control Command Hibernate" 11 "Control Command Safe" 12 "Control Command Power Save" 13 "Control Command Operating" 14 "Control Command Diagnostic" 15 "Control Command Last Mode" 20 "Reset Command Reboot" 21 "Reset Command Download" 22 "Reset Command Oem" 23 "Reset Command Factory" 24 "Reset Command Reboot Clear Nv" 25 "Powered Up" 30 "Clear Command Active Faults" 31 "Clear Command Fault Log" 32 "Clear Command Active Warns" 33 "Clear Command Warn Log" 34 "Clear Command State Event Log" 35 "Clear Command Comm Stats" 36 "Clear Command Stats" 37 "Clear Command All" 40 "Date Time Configured" 50 "Warn Cleared" 51 "Fault Cleared" 52 "Fault Set" 60 "User Cfg Changed" 61 "Oem Cfg Changed" 70 "Triggered Fault" 250 "Shutdown Threshold" 251 "Shutdown Hysteresis" 252 "Warning Threshold" 253 "Warning Hysteresis" 254 "Transfer Threshold" 255 "Fan 0 Threshold" 256 "Fan 10 Threshold" 257 "Fan 20 Threshold" 258 "Fan 30 Threshold" 259 "Fan 40 Threshold" 260 "Fan 50 Threshold" 261 "Fan 60 Threshold" 262 "Fan 70 Threshold" 263 "Fan 80 Threshold" 264 "Fan 90 Threshold" 265 "Fan 100 Threshold" 266 "Relay Open Threshold" 267 "Relay Close Threshold" 268 "Charger Derating Ac In V" 269 "Charger Derating Ac In I" 270 "Charger Derating Ext Temp" 271 "Charger Derating Int Temp" 272 "Charger Derating Ripple V" 273 "Lost Ac Threshold" 274 "Lost Ac Hysteresis" 275 "Imm Shutdown Threshold" 276 "Imm Shutdown Hysteresis" 277 "Charger Shutdown Threshold" 278 "Charger Shutdown Hysteresis" 279 "Charger Warning Threshold" 280 "Charger Warning Hysteresis" 281 "Inverter Shutdown Threshold" 282 "Inverter Shutdown Hysteresis" 283 "Inverter Warning Threshold" 284 "Inverter Warning Hysteresis" 285 "Charger Derating Temp Start Point" 286 "Charger Derating Temp End Point" 287 "Charger Recharge Threshold" 300 "Ags Exercise Start" 301 "Ags Exercise Stop" 302 "Ags Quiet Time Begin" 303 "Ags Quiet Time End" 304 "Ags Battery Soc Start" 305 "Ags Battery Soc Stop" 306 "Ags Dc V Start" 307 "Ags Dc V Stop" 308 "Ags Ac I Start" 309 "Ags Ac I Stop" 310 "Ags Contact Start" 311 "Ags Contact Stop" 312 "Ags Float Stop" 313 "Ags Absorp Stop" 314 "Ags Manual On" 315 "Ags Manual Off" 316 "Ags Auto" 317 "Ags External On" 318 "Ags External Off" 319 "Gen External On" 320 "Gen External Off" 321 "Ags External Shutdown" 322 "Ags Auto Off" 323 "Ags Dc I Start" 324 "Ags Dc I Stop" 325 "Ags Ac Power Start" 326 "Ags Ac Power Stop" 400 "Sps Manual Off" 401 "Sps Manual On" 410 "Sps Auto Off" 411 "Sps Auto On" 420 "Sps Auto Off Batt V Low" 421 "Sps Auto On Batt V Low" 422 "Sps Auto Off Batt V High" 423 "Sps Auto On Batt V High" 424 "Sps Auto Off Array V High" 425 "Sps Auto On Array V High" 426 "Sps Auto Off Batt Temp Low" 427 "Sps Auto On Batt Temp Low" 428 "Sps Auto Off Batt Temp High" 429 "Sps Auto On Batt Temp High" 430 "Sps Auto Off Heat Sink Temp High" 431 "Sps Auto On Heat Sink Temp High" 432 "Sps Auto Off Fault" 433 "Sps Auto On Fault" 434 "Aps Check Timeout" 435 "Aps Qualify Timeout" 512 "Resume From Safe" 513 "AC Fault Set" 514 "Invert Fault Set" 515 "Charge Fault Set" 516 "Charger Enable" 517 "Charger Disable" 518 "Inverter Enable" 519 "Inverter Disable" 520 "Charge Suspend On" 521 "Charge Suspend Off" 522 "AC Good" 523 "AC Bad" 524 "Load Sense Enable" 525 "Load Sense Active" 526 "Invert Active" 527 "Bulk Exit" 528 "Absorption Exit" 529 "Float Exit" 530 "Float 3-Stage Set" 531 "Float 2-Stage Set" 532 "Equalize Enable" 533 "Equalize Disable" 534 "Equalize Exit" 535 "Load Sense Disable" 536 "Sell To Grid Enabled" 537 "Sell To Grid Disabled" 538 "Grid Support Enable" 539 "Grid Support Disable" 540 "Gen Support Enable" 541 "Gen Support Disable" 542 "Peak Load Shaving Enable" 543 "Peak Load Shaving Disable" 544 "Peak Load Shaving Tod Start" 545 "Peak Load Shaving Tod Stop" 546 "Unit Off" 547 "System Absorption Exit" 548 "System Inverter Enable" 549 "System AC Good" 550 "Anti Islanding Condition" 551 "Hibernate Timeout" 552 "External Sync Error" 553 "External Suspend Request" 554 "Engaging Charger" 555 "Engaging Gen Support" 556 "Grid Tie Engage Timeout" 557 "Gen Support Engage Timeout" 558 "Charge Engage Timeout" 559 "Inverter Engage Timeout" 560 "Charge Exit Timeout" 561 "Grid Support Entry Amps" 562 "Grid Support Exit Amps" 563 "Gen Support Entry Amps" 564 "Gen Support Exit Amps" 565 "Grid Support Entry Vdc" 566 "Grid Support Exit Vdc" 567 "Low Batt Cut Off Entry Vdc" 568 "Low Batt Recharge Vdc" 569 "Low Batt Cut Off Exit Vdc" 570 "Invert To Bypass Timeout" 571 "Force Charge" 572 "System Engage Bulk Charge" 441 "SPS Auto On External Shutdown Flt" 442 "SPS Auto Off Input Over Volt Flt" 443 "SPS Auto On Input Over Volt Flt" 444 "SPS Auto Off Input Over Volt Err" 445 "SPS Auto On Input Over Volt Err" 446 "SPS Auto Off Input Over Volt Wrn" 447 "SPS Auto On Input Over Volt Wrn" 448 "SPS Auto Off Output Over Volt Err" 449 "SPS Auto On Output Over Volt Err" 450 "SPS Auto Off Output Over Volt Wrn" 451 "SPS Auto On Output Over Volt Wrn" 452 "SPS Auto Off Output Under Volt Err" 453 "SPS Auto On Output Under Volt Err" 454 "SPS Auto Off Output Under Volt Wrn" 455 "SPS Auto On Output Under Volt Wrn" 456 "SPS Auto Off Output Over Curr Err" 457 "SPS Auto On Output Over Curr Err" 458 "SPS Auto Off Batt Over Temp Err" 459 "SPS Auto On Batt Over Temp Err" 460 "SPS Auto Off Batt Over Temp Wrn" 461 "SPS Auto On Batt Over Temp Wrn" 462 "SPS Auto Off Batt Under Temp Wrn" 463 "SPS Auto On Batt Under Temp Wrn" 464 "SPS Auto Off Heatsink Over Temp Err" 465 "SPS Auto On Heatsink Over Temp Err" 466 "SPS Auto Off Heatsink Over Temp Wrn" 467 "SPS Auto On Heatsink Over Temp Wrn" 468 "SPS Auto Off Ambient Over Temp Err" 469 "SPS Auto On Ambient Over Temp Err" 470 "SPS Auto Off Ambient Over Temp Wrn" 471 "SPS Auto On Ambient Over Temp Wrn" 472 "SPS Auto Off Capacitor Over Temp Err" 473 "SPS Auto On Capacitor Over Temp Err" 474 "SPS Auto Off Fan Flt" 475 "SPS Auto On Fan Flt" 476 "SPS Auto Off Fan Err" 477 "SPS Auto On Fan Err" 478 "SPS Auto Off Input Over Curr Err" 479 "SPS Auto On Input Over Curr Err" 480 "SPS Auto Off Output Over Curr Flt" 481 "SPS Auto On Output Over Curr Flt" 482 "SPS Auto Off Network PS Flt" 483 "SPS Auto On Network PS Flt" 484 "SPS Auto Off Setup Flt" 485 "SPS Auto On Setup Flt" 38 "Clear Command User Stats" 573 "AC Good Pending" 574 "Grid Safe" 585 "PLS Time In Float Ready" 575 "Power Conversion Fault" 576 "Low Battery Support Exit" 577 "Grid Support Exit" 578 "GFS Enable" 579 "GFS Disable" 580 "Force Sell" 486 "SPS Auto On Bulk Exit" 487 "SPS Auto Off Bulk Exit" 488 "SPS Auto On Absorption Exit" 489 "SPS Auto Off Absorption Exit" 490 "SPS Auto On State Of Charge Low" 491 "SPS Auto Off State Of Charge Low" 492 "SPS Auto On Time Of Day" 493 "SPS Auto Off Time Of Day" 581 "Sell Time Of Day Start" 582 "Sell Time Of Day Stop" 583 "Aux Port Time Of Day Start" 584 "Aux Port Time Of Day Stop" ;
VAL_ 2147569408 CfgType 0 "User" 1 "OEM" 2 "Factory" 3 "Reserved" ;
VAL_ 2147569408 AcSrcId 0 "Invalid" 1 "None" 2 "Anonymous" 3 "Shore1" 4 "Shore2" 5 "Shore3" 6 "Shore4" 7 "Shore5" 8 "Shore6" 9 "Shore7" 10 "Shore8" 11 "Shore9" 12 "Shore10" 13 "Shore11" 14 "Shore12" 15 "Shore13" 16 "Shore14" 17 "Shore15" 18 "Shore16" 19 "Gen1" 20 "Gen2" 21 "Gen3" 22 "Gen4" 23 "Gen5" 24 "Gen6" 25 "Gen7" 26 "Gen8" 27 "Gen9" 28 "Gen10" 29 "Gen11" 30 "Gen12" 31 "Gen13" 32 "Gen14" 33 "Gen15" 34 "Gen16" 35 "AC1" 36 "AC2" 37 "AC3" 38 "AC4" 39 "AC5" 40 "AC6" 41 "AC7" 42 "AC8" 43 "AC9" 44 "AC10" 45 "AC11" 46 "AC12" 47 "AC13" 48 "AC14" 49 "AC15" 50 "AC16" 51 "AC Load1" 52 "AC Load2" 53 "AC Load3" 54 "AC Load4" 55 "AC Load5" 56 "AC Load6" 57 "AC Load7" 58 "AC Load8" 59 "AC Load9" 60 "AC Load10" 61 "AC Load11" 62 "AC Load12" 63 "AC Load13" 64 "AC Load14" 65 "AC Load15" 66 "AC Load16" 67 "Grid1" 68 "Grid2" 69 "Grid3" 70 "Grid4" 71 "Grid5" 72 "Grid6" 73 "Grid7" 74 "Grid8" 75 "Grid9" 76 "Grid10" 77 "Grid11" 78 "Grid12" 79 "Grid13" 80 "Grid14" 81 "Grid15" 82 "Grid16" 252 "All" 253 "Reserved" 254 "Out Of Range" 255 "Data Not Available Do Not Change" ;
VAL_ 2147551744 RefEvtId 436 "SPS Auto Off Array V Low" 437 "SPS Auto On Array V Low" 438 "SPS Auto Off Ground Flt" 439 "SPS Auto On Ground Flt" 440 "SPS Auto Off External Shutdown Flt" 0 "None" 10 "Control Command Hibernate" 11 "Control Command Safe" 12 "Control Command Power Save" 13 "Control Command Operating" 14 "Control Command Diagnostic" 15 "Control Command Last Mode" 20 "Reset Command Reboot" 21 "Reset Command Download" 22 "Reset Command Oem" 23 "Reset Command Factory" 24 "Reset Command Reboot Clear Nv" 25 "Powered Up" 30 "Clear Command Active Faults" 31 "Clear Command Fault Log" 32 "Clear Command Active Warns" 33 "Clear Command Warn Log" 34 "Clear Command State Event Log" 35 "Clear Command Comm Stats" 36 "Clear Command Stats" 37 "Clear Command All" 40 "Date Time Configured" 50 "Warn Cleared" 51 "Fault Cleared" 52 "Fault Set" 60 "User Cfg Changed" 61 "Oem Cfg Changed" 70 "Triggered Fault" 250 "Shutdown Threshold" 251 "Shutdown Hysteresis" 252 "Warning Threshold" 253 "Warning Hysteresis" 254 "Transfer Threshold" 255 "Fan 0 Threshold" 256 "Fan 10 Threshold" 257 "Fan 20 Threshold" 258 "Fan 30 Threshold" 259 "Fan 40 Threshold" 260 "Fan 50 Threshold" 261 "Fan 60 Threshold" 262 "Fan 70 Threshold" 263 "Fan 80 Threshold" 264 "Fan 90 Threshold" 265 "Fan 100 Threshold" 266 "Relay Open Threshold" 267 "Relay Close Threshold" 268 "Charger Derating Ac In V" 269 "Charger Derating Ac In I" 270 "Charger Derating Ext Temp" 271 "Charger Derating Int Temp" 272 "Charger Derating Ripple V" 273 "Lost Ac Threshold" 274 "Lost Ac Hysteresis" 275 "Imm Shutdown Threshold" 276 "Imm Shutdown Hysteresis" 277 "Charger Shutdown Threshold" 278 "Charger Shutdown Hysteresis" 279 "Charger Warning Threshold" 280 "Charger Warning Hysteresis" 281 "Inverter Shutdown Threshold" 282 "Inverter Shutdown Hysteresis" 283 "Inverter Warning Threshold" 284 "Inverter Warning Hysteresis" 285 "Charger Derating Temp Start Point" 286 "Charger Derating Temp End Point" 287 "Charger Recharge Threshold" 300 "Ags Exercise Start" 301 "Ags Exercise Stop" 302 "Ags Quiet Time Begin" 303 "Ags Quiet Time End" 304 "Ags Battery Soc Start" 305 "Ags Battery Soc Stop" 306 "Ags Dc V Start" 307 "Ags Dc V Stop" 308 "Ags Ac I Start" 309 "Ags Ac I Stop" 310 "Ags Contact Start" 311 "Ags Contact Stop" 312 "Ags Float Stop" 313 "Ags Absorp Stop" 314 "Ags Manual On" 315 "Ags Manual Off" 316 "Ags Auto" 317 "Ags External On" 318 "Ags External Off" 319 "Gen External On" 320 "Gen External Off" 321 "Ags External Shutdown" 322 "Ags Auto Off" 323 "Ags Dc I Start" 324 "Ags Dc I Stop" 325 "Ags Ac Power Start" 326 "Ags Ac Power Stop" 400 "Sps Manual Off" 401 "Sps Manual On" 410 "Sps Auto Off" 411 "Sps Auto On" 420 "Sps Auto Off Batt V Low" 421 "Sps Auto On Batt V Low" 422 "Sps Auto Off Batt V High" 423 "Sps Auto On Batt V High" 424 "Sps Auto Off Array V High" 425 "Sps Auto On Array V High" 426 "Sps Auto Off Batt Temp Low" 427 "Sps Auto On Batt Temp Low" 428 "Sps Auto Off Batt Temp High" 429 "Sps Auto On Batt Temp High" 430 "Sps Auto Off Heat Sink Temp High" 431 "Sps Auto On Heat Sink Temp High" 432 "Sps Auto Off Fault" 433 "Sps Auto On Fault" 434 "Aps Check Timeout" 435 "Aps Qualify Timeout" 512 "Resume From Safe" 513 "AC Fault Set" 514 "Invert Fault Set" 515 "Charge Fault Set" 516 "Charger Enable" 517 "Charger Disable" 518 "Inverter Enable" 519 "Inverter Disable" 520 "Charge Suspend On" 521 "Charge Suspend Off" 522 "AC Good" 523 "AC Bad" 524 "Load Sense Enable" 525 "Load Sense Active" 526 "Invert Active" 527 "Bulk Exit" 528 "Absorption Exit" 529 "Float Exit" 530 "Float 3-Stage Set" 531 "Float 2-Stage Set" 532 "Equalize Enable" 533 "Equalize Disable" 534 "Equalize Exit" 535 "Load Sense Disable" 536 "Sell To Grid Enabled" 537 "Sell To Grid Disabled" 538 "Grid Support Enable" 539 "Grid Support Disable" 540 "Gen Support Enable" 541 "Gen Support Disable" 542 "Peak Load Shaving Enable" 543 "Peak Load Shaving Disable" 544 "Peak Load Shaving Tod Start" 545 "Peak Load Shaving Tod Stop" 546 "Unit Off" 547 "System Absorption Exit" 548 "System Inverter Enable" 549 "System AC Good" 550 "Anti Islanding Condition" 551 "Hibernate Timeout" 552 "External Sync Error" 553 "External Suspend Request" 554 "Engaging Charger" 555 "Engaging Gen Support" 556 "Grid Tie Engage Timeout" 557 "Gen Support Engage Timeout" 558 "Charge Engage Timeout" 559 "Inverter Engage Timeout" 560 "Charge Exit Timeout" 561 "Grid Support Entry Amps" 562 "Grid Support Exit Amps" 563 "Gen Support Entry Amps" 564 "Gen Support Exit Amps" 565 "Grid Support Entry Vdc" 566 "Grid Support Exit Vdc" 567 "Low Batt Cut Off Entry Vdc" 568 "Low Batt Recharge Vdc" 569 "Low Batt Cut Off Exit Vdc" 570 "Invert To Bypass Timeout" 571 "Force Charge" 572 "System Engage Bulk Charge" 441 "SPS Auto On External Shutdown Flt" 442 "SPS Auto Off Input Over Volt Flt" 443 "SPS Auto On Input Over Volt Flt" 444 "SPS Auto Off Input Over Volt Err" 445 "SPS Auto On Input Over Volt Err" 446 "SPS Auto Off Input Over Volt Wrn" 447 "SPS Auto On Input Over Volt Wrn" 448 "SPS Auto Off Output Over Volt Err" 449 "SPS Auto On Output Over Volt Err" 450 "SPS Auto Off Output Over Volt Wrn" 451 "SPS Auto On Output Over Volt Wrn" 452 "SPS Auto Off Output Under Volt Err" 453 "SPS Auto On Output Under Volt Err" 454 "SPS Auto Off Output Under Volt Wrn" 455 "SPS Auto On Output Under Volt Wrn" 456 "SPS Auto Off Output Over Curr Err" 457 "SPS Auto On Output Over Curr Err" 458 "SPS Auto Off Batt Over Temp Err" 459 "SPS Auto On Batt Over Temp Err" 460 "SPS Auto Off Batt Over Temp Wrn" 461 "SPS Auto On Batt Over Temp Wrn" 462 "SPS Auto Off Batt Under Temp Wrn" 463 "SPS Auto On Batt Under Temp Wrn" 464 "SPS Auto Off Heatsink Over Temp Err" 465 "SPS Auto On Heatsink Over Temp Err" 466 "SPS Auto Off Heatsink Over Temp Wrn" 467 "SPS Auto On Heatsink Over Temp Wrn" 468 "SPS Auto Off Ambient Over Temp Err" 469 "SPS Auto On Ambient Over Temp Err" 470 "SPS Auto Off Ambient Over Temp Wrn" 471 "SPS Auto On Ambient Over Temp Wrn" 472 "SPS Auto Off Capacitor Over Temp Err" 473 "SPS Auto On Capacitor Over Temp Err" 474 "SPS Auto Off Fan Flt" 475 "SPS Auto On Fan Flt" 476 "SPS Auto Off Fan Err" 477 "SPS Auto On Fan Err" 478 "SPS Auto Off Input Over Curr Err" 479 "SPS Auto On Input Over Curr Err" 480 "SPS Auto Off Output Over Curr Flt" 481 "SPS Auto On Output Over Curr Flt" 482 "SPS Auto Off Network PS Flt" 483 "SPS Auto On Network PS Flt" 484 "SPS Auto Off Setup Flt" 485 "SPS Auto On Setup Flt" 38 "Clear Command User Stats" 573 "AC Good Pending" 574 "Grid Safe" 585 "PLS Time In Float Ready" 575 "Power Conversion Fault" 576 "Low Battery Support Exit" 577 "Grid Support Exit" 578 "GFS Enable" 579 "GFS Disable" 580 "Force Sell" 486 "SPS Auto On Bulk Exit" 487 "SPS Auto Off Bulk Exit" 488 "SPS Auto On Absorption Exit" 489 "SPS Auto Off Absorption Exit" 490 "SPS Auto On State Of Charge Low" 491 "SPS Auto Off State Of Charge Low" 492 "SPS Auto On Time Of Day" 493 "SPS Auto Off Time Of Day" 581 "Sell Time Of Day Start" 582 "Sell Time Of Day Stop" 583 "Aux Port Time Of Day Start" 584 "Aux Port Time Of Day Stop" ;
VAL_ 2147551744 EvtId 436 "SPS Auto Off Array V Low" 437 "SPS Auto On Array V Low" 438 "SPS Auto Off Ground Flt" 439 "SPS Auto On Ground Flt" 440 "SPS Auto Off External Shutdown Flt" 0 "None" 10 "Control Command Hibernate" 11 "Control Command Safe" 12 "Control Command Power Save" 13 "Control Command Operating" 14 "Control Command Diagnostic" 15 "Control Command Last Mode" 20 "Reset Command Reboot" 21 "Reset Command Download" 22 "Reset Command Oem" 23 "Reset Command Factory" 24 "Reset Command Reboot Clear Nv" 25 "Powered Up" 30 "Clear Command Active Faults" 31 "Clear Command Fault Log" 32 "Clear Command Active Warns" 33 "Clear Command Warn Log" 34 "Clear Command State Event Log" 35 "Clear Command Comm Stats" 36 "Clear Command Stats" 37 "Clear Command All" 40 "Date Time Configured" 50 "Warn Cleared" 51 "Fault Cleared" 52 "Fault Set" 60 "User Cfg Changed" 61 "Oem Cfg Changed" 70 "Triggered Fault" 250 "Shutdown Threshold" 251 "Shutdown Hysteresis" 252 "Warning Threshold" 253 "Warning Hysteresis" 254 "Transfer Threshold" 255 "Fan 0 Threshold" 256 "Fan 10 Threshold" 257 "Fan 20 Threshold" 258 "Fan 30 Threshold" 259 "Fan 40 Threshold" 260 "Fan 50 Threshold" 261 "Fan 60 Threshold" 262 "Fan 70 Threshold" 263 "Fan 80 Threshold" 264 "Fan 90 Threshold" 265 "Fan 100 Threshold" 266 "Relay Open Threshold" 267 "Relay Close Threshold" 268 "Charger Derating Ac In V" 269 "Charger Derating Ac In I" 270 "Charger Derating Ext Temp" 271 "Charger Derating Int Temp" 272 "Charger Derating Ripple V" 273 "Lost Ac Threshold" 274 "Lost Ac Hysteresis" 275 "Imm Shutdown Threshold" 276 "Imm Shutdown Hysteresis" 277 "Charger Shutdown Threshold" 278 "Charger Shutdown Hysteresis" 279 "Charger Warning Threshold" 280 "Charger Warning Hysteresis" 281 "Inverter Shutdown Threshold" 282 "Inverter Shutdown Hysteresis" 283 "Inverter Warning Threshold" 284 "Inverter Warning Hysteresis" 285 "Charger Derating Temp Start Point" 286 "Charger Derating Temp End Point" 287 "Charger Recharge Threshold" 300 "Ags Exercise Start" 301 "Ags Exercise Stop" 302 "Ags Quiet Time Begin" 303 "Ags Quiet Time End" 304 "Ags Battery Soc Start" 305 "Ags Battery Soc Stop" 306 "Ags Dc V Start" 307 "Ags Dc V Stop" 308 "Ags Ac I Start" 309 "Ags Ac I Stop" 310 "Ags Contact Start" 311 "Ags Contact Stop" 312 "Ags Float Stop" 313 "Ags Absorp Stop" 314 "Ags Manual On" 315 "Ags Manual Off" 316 "Ags Auto" 317 "Ags External On" 318 "Ags External Off" 319 "Gen External On" 320 "Gen External Off" 321 "Ags External Shutdown" 322 "Ags Auto Off" 323 "Ags Dc I Start" 324 "Ags Dc I Stop" 325 "Ags Ac Power Start" 326 "Ags Ac Power Stop" 400 "Sps Manual Off" 401 "Sps Manual On" 410 "Sps Auto Off" 411 "Sps Auto On" 420 "Sps Auto Off Batt V Low" 421 "Sps Auto On Batt V Low" 422 "Sps Auto Off Batt V High" 423 "Sps Auto On Batt V High" 424 "Sps Auto Off Array V High" 425 "Sps Auto On Array V High" 426 "Sps Auto Off Batt Temp Low" 427 "Sps Auto On Batt Temp Low" 428 "Sps Auto Off Batt Temp High" 429 "Sps Auto On Batt Temp High" 430 "Sps Auto Off Heat Sink Temp High" 431 "Sps Auto On Heat Sink Temp High" 432 "Sps Auto Off Fault" 433 "Sps Auto On Fault" 434 "Aps Check Timeout" 435 "Aps Qualify Timeout" 512 "Resume From Safe" 513 "AC Fault Set" 514 "Invert Fault Set" 515 "Charge Fault Set" 516 "Charger Enable" 517 "Charger Disable" 518 "Inverter Enable" 519 "Inverter Disable" 520 "Charge Suspend On" 521 "Charge Suspend Off" 522 "AC Good" 523 "AC Bad" 524 "Load Sense Enable" 525 "Load Sense Active" 526 "Invert Active" 527 "Bulk Exit" 528 "Absorption Exit" 529 "Float Exit" 530 "Float 3-Stage Set" 531 "Float 2-Stage Set" 532 "Equalize Enable" 533 "Equalize Disable" 534 "Equalize Exit" 535 "Load Sense Disable" 536 "Sell To Grid Enabled" 537 "Sell To Grid Disabled" 538 "Grid Support Enable" 539 "Grid Support Disable" 540 "Gen Support Enable" 541 "Gen Support Disable" 542 "Peak Load Shaving Enable" 543 "Peak Load Shaving Disable" 544 "Peak Load Shaving Tod Start" 545 "Peak Load Shaving Tod Stop" 546 "Unit Off" 547 "System Absorption Exit" 548 "System Inverter Enable" 549 "System AC Good" 550 "Anti Islanding Condition" 551 "Hibernate Timeout" 552 "External Sync Error" 553 "External Suspend Request" 554 "Engaging Charger" 555 "Engaging Gen Support" 556 "Grid Tie Engage Timeout" 557 "Gen Support Engage Timeout" 558 "Charge Engage Timeout" 559 "Inverter Engage Timeout" 560 "Charge Exit Timeout" 561 "Grid Support Entry Amps" 562 "Grid Support Exit Amps" 563 "Gen Support Entry Amps" 564 "Gen Support Exit Amps" 565 "Grid Support Entry Vdc" 566 "Grid Support Exit Vdc" 567 "Low Batt Cut Off Entry Vdc" 568 "Low Batt Recharge Vdc" 569 "Low Batt Cut Off Exit Vdc" 570 "Invert To Bypass Timeout" 571 "Force Charge" 572 "System Engage Bulk Charge" 441 "SPS Auto On External Shutdown Flt" 442 "SPS Auto Off Input Over Volt Flt" 443 "SPS Auto On Input Over Volt Flt" 444 "SPS Auto Off Input Over Volt Err" 445 "SPS Auto On Input Over Volt Err" 446 "SPS Auto Off Input Over Volt Wrn" 447 "SPS Auto On Input Over Volt Wrn" 448 "SPS Auto Off Output Over Volt Err" 449 "SPS Auto On Output Over Volt Err" 450 "SPS Auto Off Output Over Volt Wrn" 451 "SPS Auto On Output Over Volt Wrn" 452 "SPS Auto Off Output Under Volt Err" 453 "SPS Auto On Output Under Volt Err" 454 "SPS Auto Off Output Under Volt Wrn" 455 "SPS Auto On Output Under Volt Wrn" 456 "SPS Auto Off Output Over Curr Err" 457 "SPS Auto On Output Over Curr Err" 458 "SPS Auto Off Batt Over Temp Err" 459 "SPS Auto On Batt Over Temp Err" 460 "SPS Auto Off Batt Over Temp Wrn" 461 "SPS Auto On Batt Over Temp Wrn" 462 "SPS Auto Off Batt Under Temp Wrn" 463 "SPS Auto On Batt Under Temp Wrn" 464 "SPS Auto Off Heatsink Over Temp Err" 465 "SPS Auto On Heatsink Over Temp Err" 466 "SPS Auto Off Heatsink Over Temp Wrn" 467 "SPS Auto On Heatsink Over Temp Wrn" 468 "SPS Auto Off Ambient Over Temp Err" 469 "SPS Auto On Ambient Over Temp Err" 470 "SPS Auto Off Ambient Over Temp Wrn" 471 "SPS Auto On Ambient Over Temp Wrn" 472 "SPS Auto Off Capacitor Over Temp Err" 473 "SPS Auto On Capacitor Over Temp Err" 474 "SPS Auto Off Fan Flt" 475 "SPS Auto On Fan Flt" 476 "SPS Auto Off Fan Err" 477 "SPS Auto On Fan Err" 478 "SPS Auto Off Input Over Curr Err" 479 "SPS Auto On Input Over Curr Err" 480 "SPS Auto Off Output Over Curr Flt" 481 "SPS Auto On Output Over Curr Flt" 482 "SPS Auto Off Network PS Flt" 483 "SPS Auto On Network PS Flt" 484 "SPS Auto Off Setup Flt" 485 "SPS Auto On Setup Flt" 38 "Clear Command User Stats" 573 "AC Good Pending" 574 "Grid Safe" 585 "PLS Time In Float Ready" 575 "Power Conversion Fault" 576 "Low Battery Support Exit" 577 "Grid Support Exit" 578 "GFS Enable" 579 "GFS Disable" 580 "Force Sell" 486 "SPS Auto On Bulk Exit" 487 "SPS Auto Off Bulk Exit" 488 "SPS Auto On Absorption Exit" 489 "SPS Auto Off Absorption Exit" 490 "SPS Auto On State Of Charge Low" 491 "SPS Auto Off State Of Charge Low" 492 "SPS Auto On Time Of Day" 493 "SPS Auto Off Time Of Day" 581 "Sell Time Of Day Start" 582 "Sell Time Of Day Stop" 583 "Aux Port Time Of Day Start" 584 "Aux Port Time Of Day Stop" ;
VAL_ 2147551744 CfgType 0 "User" 1 "OEM" 2 "Factory" 3 "Reserved" ;
VAL_ 2147551744 AcSrcId 0 "Invalid" 1 "None" 2 "Anonymous" 3 "Shore1" 4 "Shore2" 5 "Shore3" 6 "Shore4" 7 "Shore5" 8 "Shore6" 9 "Shore7" 10 "Shore8" 11 "Shore9" 12 "Shore10" 13 "Shore11" 14 "Shore12" 15 "Shore13" 16 "Shore14" 17 "Shore15" 18 "Shore16" 19 "Gen1" 20 "Gen2" 21 "Gen3" 22 "Gen4" 23 "Gen5" 24 "Gen6" 25 "Gen7" 26 "Gen8" 27 "Gen9" 28 "Gen10" 29 "Gen11" 30 "Gen12" 31 "Gen13" 32 "Gen14" 33 "Gen15" 34 "Gen16" 35 "AC1" 36 "AC2" 37 "AC3" 38 "AC4" 39 "AC5" 40 "AC6" 41 "AC7" 42 "AC8" 43 "AC9" 44 "AC10" 45 "AC11" 46 "AC12" 47 "AC13" 48 "AC14" 49 "AC15" 50 "AC16" 51 "AC Load1" 52 "AC Load2" 53 "AC Load3" 54 "AC Load4" 55 "AC Load5" 56 "AC Load6" 57 "AC Load7" 58 "AC Load8" 59 "AC Load9" 60 "AC Load10" 61 "AC Load11" 62 "AC Load12" 63 "AC Load13" 64 "AC Load14" 65 "AC Load15" 66 "AC Load16" 67 "Grid1" 68 "Grid2" 69 "Grid3" 70 "Grid4" 71 "Grid5" 72 "Grid6" 73 "Grid7" 74 "Grid8" 75 "Grid9" 76 "Grid10" 77 "Grid11" 78 "Grid12" 79 "Grid13" 80 "Grid14" 81 "Grid15" 82 "Grid16" 252 "All" 253 "Reserved" 254 "Out Of Range" 255 "Data Not Available Do Not Change" ;
VAL_ 2147552000 RefEvtId 436 "SPS Auto Off Array V Low" 437 "SPS Auto On Array V Low" 438 "SPS Auto Off Ground Flt" 439 "SPS Auto On Ground Flt" 440 "SPS Auto Off External Shutdown Flt" 0 "None" 10 "Control Command Hibernate" 11 "Control Command Safe" 12 "Control Command Power Save" 13 "Control Command Operating" 14 "Control Command Diagnostic" 15 "Control Command Last Mode" 20 "Reset Command Reboot" 21 "Reset Command Download" 22 "Reset Command Oem" 23 "Reset Command Factory" 24 "Reset Command Reboot Clear Nv" 25 "Powered Up" 30 "Clear Command Active Faults" 31 "Clear Command Fault Log" 32 "Clear Command Active Warns" 33 "Clear Command Warn Log" 34 "Clear Command State Event Log" 35 "Clear Command Comm Stats" 36 "Clear Command Stats" 37 "Clear Command All" 40 "Date Time Configured" 50 "Warn Cleared" 51 "Fault Cleared" 52 "Fault Set" 60 "User Cfg Changed" 61 "Oem Cfg Changed" 70 "Triggered Fault" 250 "Shutdown Threshold" 251 "Shutdown Hysteresis" 252 "Warning Threshold" 253 "Warning Hysteresis" 254 "Transfer Threshold" 255 "Fan 0 Threshold" 256 "Fan 10 Threshold" 257 "Fan 20 Threshold" 258 "Fan 30 Threshold" 259 "Fan 40 Threshold" 260 "Fan 50 Threshold" 261 "Fan 60 Threshold" 262 "Fan 70 Threshold" 263 "Fan 80 Threshold" 264 "Fan 90 Threshold" 265 "Fan 100 Threshold" 266 "Relay Open Threshold" 267 "Relay Close Threshold" 268 "Charger Derating Ac In V" 269 "Charger Derating Ac In I" 270 "Charger Derating Ext Temp" 271 "Charger Derating Int Temp" 272 "Charger Derating Ripple V" 273 "Lost Ac Threshold" 274 "Lost Ac Hysteresis" 275 "Imm Shutdown Threshold" 276 "Imm Shutdown Hysteresis" 277 "Charger Shutdown Threshold" 278 "Charger Shutdown Hysteresis" 279 "Charger Warning Threshold" 280 "Charger Warning Hysteresis" 281 "Inverter Shutdown Threshold" 282 "Inverter Shutdown Hysteresis" 283 "Inverter Warning Threshold" 284 "Inverter Warning Hysteresis" 285 "Charger Derating Temp Start Point" 286 "Charger Derating Temp End Point" 287 "Charger Recharge Threshold" 300 "Ags Exercise Start" 301 "Ags Exercise Stop" 302 "Ags Quiet Time Begin" 303 "Ags Quiet Time End" 304 "Ags Battery Soc Start" 305 "Ags Battery Soc Stop" 306 "Ags Dc V Start" 307 "Ags Dc V Stop" 308 "Ags Ac I Start" 309 "Ags Ac I Stop" 310 "Ags Contact Start" 311 "Ags Contact Stop" 312 "Ags Float Stop" 313 "Ags Absorp Stop" 314 "Ags Manual On" 315 "Ags Manual Off" 316 "Ags Auto" 317 "Ags External On" 318 "Ags External Off" 319 "Gen External On" 320 "Gen External Off" 321 "Ags External Shutdown" 322 "Ags Auto Off" 323 "Ags Dc I Start" 324 "Ags Dc I Stop" 325 "Ags Ac Power Start" 326 "Ags Ac Power Stop" 400 "Sps Manual Off" 401 "Sps Manual On" 410 "Sps Auto Off" 411 "Sps Auto On" 420 "Sps Auto Off Batt V Low" 421 "Sps Auto On Batt V Low" 422 "Sps Auto Off Batt V High" 423 "Sps Auto On Batt V High" 424 "Sps Auto Off Array V High" 425 "Sps Auto On Array V High" 426 "Sps Auto Off Batt Temp Low" 427 "Sps Auto On Batt Temp Low" 428 "Sps Auto Off Batt Temp High" 429 "Sps Auto On Batt Temp High" 430 "Sps Auto Off Heat Sink Temp High" 431 "Sps Auto On Heat Sink Temp High" 432 "Sps Auto Off Fault" 433 "Sps Auto On Fault" 434 "Aps Check Timeout" 435 "Aps Qualify Timeout" 512 "Resume From Safe" 513 "AC Fault Set" 514 "Invert Fault Set" 515 "Charge Fault Set" 516 "Charger Enable" 517 "Charger Disable" 518 "Inverter Enable" 519 "Inverter Disable" 520 "Charge Suspend On" 521 "Charge Suspend Off" 522 "AC Good" 523 "AC Bad" 524 "Load Sense Enable" 525 "Load Sense Active" 526 "Invert Active" 527 "Bulk Exit" 528 "Absorption Exit" 529 "Float Exit" 530 "Float 3-Stage Set" 531 "Float 2-Stage Set" 532 "Equalize Enable" 533 "Equalize Disable" 534 "Equalize Exit" 535 "Load Sense Disable" 536 "Sell To Grid Enabled" 537 "Sell To Grid Disabled" 538 "Grid Support Enable" 539 "Grid Support Disable" 540 "Gen Support Enable" 541 "Gen Support Disable" 542 "Peak Load Shaving Enable" 543 "Peak Load Shaving Disable" 544 "Peak Load Shaving Tod Start" 545 "Peak Load Shaving Tod Stop" 546 "Unit Off" 547 "System Absorption Exit" 548 "System Inverter Enable" 549 "System AC Good" 550 "Anti Islanding Condition" 551 "Hibernate Timeout" 552 "External Sync Error" 553 "External Suspend Request" 554 "Engaging Charger" 555 "Engaging Gen Support" 556 "Grid Tie Engage Timeout" 557 "Gen Support Engage Timeout" 558 "Charge Engage Timeout" 559 "Inverter Engage Timeout" 560 "Charge Exit Timeout" 561 "Grid Support Entry Amps" 562 "Grid Support Exit Amps" 563 "Gen Support Entry Amps" 564 "Gen Support Exit Amps" 565 "Grid Support Entry Vdc" 566 "Grid Support Exit Vdc" 567 "Low Batt Cut Off Entry Vdc" 568 "Low Batt Recharge Vdc" 569 "Low Batt Cut Off Exit Vdc" 570 "Invert To Bypass Timeout" 571 "Force Charge" 572 "System Engage Bulk Charge" 441 "SPS Auto On External Shutdown Flt" 442 "SPS Auto Off Input Over Volt Flt" 443 "SPS Auto On Input Over Volt Flt" 444 "SPS Auto Off Input Over Volt Err" 445 "SPS Auto On Input Over Volt Err" 446 "SPS Auto Off Input Over Volt Wrn" 447 "SPS Auto On Input Over Volt Wrn" 448 "SPS Auto Off Output Over Volt Err" 449 "SPS Auto On Output Over Volt Err" 450 "SPS Auto Off Output Over Volt Wrn" 451 "SPS Auto On Output Over Volt Wrn" 452 "SPS Auto Off Output Under Volt Err" 453 "SPS Auto On Output Under Volt Err" 454 "SPS Auto Off Output Under Volt Wrn" 455 "SPS Auto On Output Under Volt Wrn" 456 "SPS Auto Off Output Over Curr Err" 457 "SPS Auto On Output Over Curr Err" 458 "SPS Auto Off Batt Over Temp Err" 459 "SPS Auto On Batt Over Temp Err" 460 "SPS Auto Off Batt Over Temp Wrn" 461 "SPS Auto On Batt Over Temp Wrn" 462 "SPS Auto Off Batt Under Temp Wrn" 463 "SPS Auto On Batt Under Temp Wrn" 464 "SPS Auto Off Heatsink Over Temp Err" 465 "SPS Auto On Heatsink Over Temp Err" 466 "SPS Auto Off Heatsink Over Temp Wrn" 467 "SPS Auto On Heatsink Over Temp Wrn" 468 "SPS Auto Off Ambient Over Temp Err" 469 "SPS Auto On Ambient Over Temp Err" 470 "SPS Auto Off Ambient Over Temp Wrn" 471 "SPS Auto On Ambient Over Temp Wrn" 472 "SPS Auto Off Capacitor Over Temp Err" 473 "SPS Auto On Capacitor Over Temp Err" 474 "SPS Auto Off Fan Flt" 475 "SPS Auto On Fan Flt" 476 "SPS Auto Off Fan Err" 477 "SPS Auto On Fan Err" 478 "SPS Auto Off Input Over Curr Err" 479 "SPS Auto On Input Over Curr Err" 480 "SPS Auto Off Output Over Curr Flt" 481 "SPS Auto On Output Over Curr Flt" 482 "SPS Auto Off Network PS Flt" 483 "SPS Auto On Network PS Flt" 484 "SPS Auto Off Setup Flt" 485 "SPS Auto On Setup Flt" 38 "Clear Command User Stats" 573 "AC Good Pending" 574 "Grid Safe" 585 "PLS Time In Float Ready" 575 "Power Conversion Fault" 576 "Low Battery Support Exit" 577 "Grid Support Exit" 578 "GFS Enable" 579 "GFS Disable" 580 "Force Sell" 486 "SPS Auto On Bulk Exit" 487 "SPS Auto Off Bulk Exit" 488 "SPS Auto On Absorption Exit" 489 "SPS Auto Off Absorption Exit" 490 "SPS Auto On State Of Charge Low" 491 "SPS Auto Off State Of Charge Low" 492 "SPS Auto On Time Of Day" 493 "SPS Auto Off Time Of Day" 581 "Sell Time Of Day Start" 582 "Sell Time Of Day Stop" 583 "Aux Port Time Of Day Start" 584 "Aux Port Time Of Day Stop" ;
VAL_ 2147552000 EvtId 436 "SPS Auto Off Array V Low" 437 "SPS Auto On Array V Low" 438 "SPS Auto Off Ground Flt" 439 "SPS Auto On Ground Flt" 440 "SPS Auto Off External Shutdown Flt" 0 "None" 10 "Control Command Hibernate" 11 "Control Command Safe" 12 "Control Command Power Save" 13 "Control Command Operating" 14 "Control Command Diagnostic" 15 "Control Command Last Mode" 20 "Reset Command Reboot" 21 "Reset Command Download" 22 "Reset Command Oem" 23 "Reset Command Factory" 24 "Reset Command Reboot Clear Nv" 25 "Powered Up" 30 "Clear Command Active Faults" 31 "Clear Command Fault Log" 32 "Clear Command Active Warns" 33 "Clear Command Warn Log" 34 "Clear Command State Event Log" 35 "Clear Command Comm Stats" 36 "Clear Command Stats" 37 "Clear Command All" 40 "Date Time Configured" 50 "Warn Cleared" 51 "Fault Cleared" 52 "Fault Set" 60 "User Cfg Changed" 61 "Oem Cfg Changed" 70 "Triggered Fault" 250 "Shutdown Threshold" 251 "Shutdown Hysteresis" 252 "Warning Threshold" 253 "Warning Hysteresis" 254 "Transfer Threshold" 255 "Fan 0 Threshold" 256 "Fan 10 Threshold" 257 "Fan 20 Threshold" 258 "Fan 30 Threshold" 259 "Fan 40 Threshold" 260 "Fan 50 Threshold" 261 "Fan 60 Threshold" 262 "Fan 70 Threshold" 263 "Fan 80 Threshold" 264 "Fan 90 Threshold" 265 "Fan 100 Threshold" 266 "Relay Open Threshold" 267 "Relay Close Threshold" 268 "Charger Derating Ac In V" 269 "Charger Derating Ac In I" 270 "Charger Derating Ext Temp" 271 "Charger Derating Int Temp" 272 "Charger Derating Ripple V" 273 "Lost Ac Threshold" 274 "Lost Ac Hysteresis" 275 "Imm Shutdown Threshold" 276 "Imm Shutdown Hysteresis" 277 "Charger Shutdown Threshold" 278 "Charger Shutdown Hysteresis" 279 "Charger Warning Threshold" 280 "Charger Warning Hysteresis" 281 "Inverter Shutdown Threshold" 282 "Inverter Shutdown Hysteresis" 283 "Inverter Warning Threshold" 284 "Inverter Warning Hysteresis" 285 "Charger Derating Temp Start Point" 286 "Charger Derating Temp End Point" 287 "Charger Recharge Threshold" 300 "Ags Exercise Start" 301 "Ags Exercise Stop" 302 "Ags Quiet Time Begin" 303 "Ags Quiet Time End" 304 "Ags Battery Soc Start" 305 "Ags Battery Soc Stop" 306 "Ags Dc V Start" 307 "Ags Dc V Stop" 308 "Ags Ac I Start" 309 "Ags Ac I Stop" 310 "Ags Contact Start" 311 "Ags Contact Stop" 312 "Ags Float Stop" 313 "Ags Absorp Stop" 314 "Ags Manual On" 315 "Ags Manual Off" 316 "Ags Auto" 317 "Ags External On" 318 "Ags External Off" 319 "Gen External On" 320 "Gen External Off" 321 "Ags External Shutdown" 322 "Ags Auto Off" 323 "Ags Dc I Start" 324 "Ags Dc I Stop" 325 "Ags Ac Power Start" 326 "Ags Ac Power Stop" 400 "Sps Manual Off" 401 "Sps Manual On" 410 "Sps Auto Off" 411 "Sps Auto On" 420 "Sps Auto Off Batt V Low" 421 "Sps Auto On Batt V Low" 422 "Sps Auto Off Batt V High" 423 "Sps Auto On Batt V High" 424 "Sps Auto Off Array V High" 425 "Sps Auto On Array V High" 426 "Sps Auto Off Batt Temp Low" 427 "Sps Auto On Batt Temp Low" 428 "Sps Auto Off Batt Temp High" 429 "Sps Auto On Batt Temp High" 430 "Sps Auto Off Heat Sink Temp High" 431 "Sps Auto On Heat Sink Temp High" 432 "Sps Auto Off Fault" 433 "Sps Auto On Fault" 434 "Aps Check Timeout" 435 "Aps Qualify Timeout" 512 "Resume From Safe" 513 "AC Fault Set" 514 "Invert Fault Set" 515 "Charge Fault Set" 516 "Charger Enable" 517 "Charger Disable" 518 "Inverter Enable" 519 "Inverter Disable" 520 "Charge Suspend On" 521 "Charge Suspend Off" 522 "AC Good" 523 "AC Bad" 524 "Load Sense Enable" 525 "Load Sense Active" 526 "Invert Active" 527 "Bulk Exit" 528 "Absorption Exit" 529 "Float Exit" 530 "Float 3-Stage Set" 531 "Float 2-Stage Set" 532 "Equalize Enable" 533 "Equalize Disable" 534 "Equalize Exit" 535 "Load Sense Disable" 536 "Sell To Grid Enabled" 537 "Sell To Grid Disabled" 538 "Grid Support Enable" 539 "Grid Support Disable" 540 "Gen Support Enable" 541 "Gen Support Disable" 542 "Peak Load Shaving Enable" 543 "Peak Load Shaving Disable" 544 "Peak Load Shaving Tod Start" 545 "Peak Load Shaving Tod Stop" 546 "Unit Off" 547 "System Absorption Exit" 548 "System Inverter Enable" 549 "System AC Good" 550 "Anti Islanding Condition" 551 "Hibernate Timeout" 552 "External Sync Error" 553 "External Suspend Request" 554 "Engaging Charger" 555 "Engaging Gen Support" 556 "Grid Tie Engage Timeout" 557 "Gen Support Engage Timeout" 558 "Charge Engage Timeout" 559 "Inverter Engage Timeout" 560 "Charge Exit Timeout" 561 "Grid Support Entry Amps" 562 "Grid Support Exit Amps" 563 "Gen Support Entry Amps" 564 "Gen Support Exit Amps" 565 "Grid Support Entry Vdc" 566 "Grid Support Exit Vdc" 567 "Low Batt Cut Off Entry Vdc" 568 "Low Batt Recharge Vdc" 569 "Low Batt Cut Off Exit Vdc" 570 "Invert To Bypass Timeout" 571 "Force Charge" 572 "System Engage Bulk Charge" 441 "SPS Auto On External Shutdown Flt" 442 "SPS Auto Off Input Over Volt Flt" 443 "SPS Auto On Input Over Volt Flt" 444 "SPS Auto Off Input Over Volt Err" 445 "SPS Auto On Input Over Volt Err" 446 "SPS Auto Off Input Over Volt Wrn" 447 "SPS Auto On Input Over Volt Wrn" 448 "SPS Auto Off Output Over Volt Err" 449 "SPS Auto On Output Over Volt Err" 450 "SPS Auto Off Output Over Volt Wrn" 451 "SPS Auto On Output Over Volt Wrn" 452 "SPS Auto Off Output Under Volt Err" 453 "SPS Auto On Output Under Volt Err" 454 "SPS Auto Off Output Under Volt Wrn" 455 "SPS Auto On Output Under Volt Wrn" 456 "SPS Auto Off Output Over Curr Err" 457 "SPS Auto On Output Over Curr Err" 458 "SPS Auto Off Batt Over Temp Err" 459 "SPS Auto On Batt Over Temp Err" 460 "SPS Auto Off Batt Over Temp Wrn" 461 "SPS Auto On Batt Over Temp Wrn" 462 "SPS Auto Off Batt Under Temp Wrn" 463 "SPS Auto On Batt Under Temp Wrn" 464 "SPS Auto Off Heatsink Over Temp Err" 465 "SPS Auto On Heatsink Over Temp Err" 466 "SPS Auto Off Heatsink Over Temp Wrn" 467 "SPS Auto On Heatsink Over Temp Wrn" 468 "SPS Auto Off Ambient Over Temp Err" 469 "SPS Auto On Ambient Over Temp Err" 470 "SPS Auto Off Ambient Over Temp Wrn" 471 "SPS Auto On Ambient Over Temp Wrn" 472 "SPS Auto Off Capacitor Over Temp Err" 473 "SPS Auto On Capacitor Over Temp Err" 474 "SPS Auto Off Fan Flt" 475 "SPS Auto On Fan Flt" 476 "SPS Auto Off Fan Err" 477 "SPS Auto On Fan Err" 478 "SPS Auto Off Input Over Curr Err" 479 "SPS Auto On Input Over Curr Err" 480 "SPS Auto Off Output Over Curr Flt" 481 "SPS Auto On Output Over Curr Flt" 482 "SPS Auto Off Network PS Flt" 483 "SPS Auto On Network PS Flt" 484 "SPS Auto Off Setup Flt" 485 "SPS Auto On Setup Flt" 38 "Clear Command User Stats" 573 "AC Good Pending" 574 "Grid Safe" 585 "PLS Time In Float Ready" 575 "Power Conversion Fault" 576 "Low Battery Support Exit" 577 "Grid Support Exit" 578 "GFS Enable" 579 "GFS Disable" 580 "Force Sell" 486 "SPS Auto On Bulk Exit" 487 "SPS Auto Off Bulk Exit" 488 "SPS Auto On Absorption Exit" 489 "SPS Auto Off Absorption Exit" 490 "SPS Auto On State Of Charge Low" 491 "SPS Auto Off State Of Charge Low" 492 "SPS Auto On Time Of Day" 493 "SPS Auto Off Time Of Day" 581 "Sell Time Of Day Start" 582 "Sell Time Of Day Stop" 583 "Aux Port Time Of Day Start" 584 "Aux Port Time Of Day Stop" ;
VAL_ 2147552000 CfgType 0 "User" 1 "OEM" 2 "Factory" 3 "Reserved" ;
VAL_ 2147552000 AcSrcId 0 "Invalid" 1 "None" 2 "Anonymous" 3 "Shore1" 4 "Shore2" 5 "Shore3" 6 "Shore4" 7 "Shore5" 8 "Shore6" 9 "Shore7" 10 "Shore8" 11 "Shore9" 12 "Shore10" 13 "Shore11" 14 "Shore12" 15 "Shore13" 16 "Shore14" 17 "Shore15" 18 "Shore16" 19 "Gen1" 20 "Gen2" 21 "Gen3" 22 "Gen4" 23 "Gen5" 24 "Gen6" 25 "Gen7" 26 "Gen8" 27 "Gen9" 28 "Gen10" 29 "Gen11" 30 "Gen12" 31 "Gen13" 32 "Gen14" 33 "Gen15" 34 "Gen16" 35 "AC1" 36 "AC2" 37 "AC3" 38 "AC4" 39 "AC5" 40 "AC6" 41 "AC7" 42 "AC8" 43 "AC9" 44 "AC10" 45 "AC11" 46 "AC12" 47 "AC13" 48 "AC14" 49 "AC15" 50 "AC16" 51 "AC Load1" 52 "AC Load2" 53 "AC Load3" 54 "AC Load4" 55 "AC Load5" 56 "AC Load6" 57 "AC Load7" 58 "AC Load8" 59 "AC Load9" 60 "AC Load10" 61 "AC Load11" 62 "AC Load12" 63 "AC Load13" 64 "AC Load14" 65 "AC Load15" 66 "AC Load16" 67 "Grid1" 68 "Grid2" 69 "Grid3" 70 "Grid4" 71 "Grid5" 72 "Grid6" 73 "Grid7" 74 "Grid8" 75 "Grid9" 76 "Grid10" 77 "Grid11" 78 "Grid12" 79 "Grid13" 80 "Grid14" 81 "Grid15" 82 "Grid16" 252 "All" 253 "Reserved" 254 "Out Of Range" 255 "Data Not Available Do Not Change" ;
VAL_ 2147552256 RefEvtId 436 "SPS Auto Off Array V Low" 437 "SPS Auto On Array V Low" 438 "SPS Auto Off Ground Flt" 439 "SPS Auto On Ground Flt" 440 "SPS Auto Off External Shutdown Flt" 0 "None" 10 "Control Command Hibernate" 11 "Control Command Safe" 12 "Control Command Power Save" 13 "Control Command Operating" 14 "Control Command Diagnostic" 15 "Control Command Last Mode" 20 "Reset Command Reboot" 21 "Reset Command Download" 22 "Reset Command Oem" 23 "Reset Command Factory" 24 "Reset Command Reboot Clear Nv" 25 "Powered Up" 30 "Clear Command Active Faults" 31 "Clear Command Fault Log" 32 "Clear Command Active Warns" 33 "Clear Command Warn Log" 34 "Clear Command State Event Log" 35 "Clear Command Comm Stats" 36 "Clear Command Stats" 37 "Clear Command All" 40 "Date Time Configured" 50 "Warn Cleared" 51 "Fault Cleared" 52 "Fault Set" 60 "User Cfg Changed" 61 "Oem Cfg Changed" 70 "Triggered Fault" 250 "Shutdown Threshold" 251 "Shutdown Hysteresis" 252 "Warning Threshold" 253 "Warning Hysteresis" 254 "Transfer Threshold" 255 "Fan 0 Threshold" 256 "Fan 10 Threshold" 257 "Fan 20 Threshold" 258 "Fan 30 Threshold" 259 "Fan 40 Threshold" 260 "Fan 50 Threshold" 261 "Fan 60 Threshold" 262 "Fan 70 Threshold" 263 "Fan 80 Threshold" 264 "Fan 90 Threshold" 265 "Fan 100 Threshold" 266 "Relay Open Threshold" 267 "Relay Close Threshold" 268 "Charger Derating Ac In V" 269 "Charger Derating Ac In I" 270 "Charger Derating Ext Temp" 271 "Charger Derating Int Temp" 272 "Charger Derating Ripple V" 273 "Lost Ac Threshold" 274 "Lost Ac Hysteresis" 275 "Imm Shutdown Threshold" 276 "Imm Shutdown Hysteresis" 277 "Charger Shutdown Threshold" 278 "Charger Shutdown Hysteresis" 279 "Charger Warning Threshold" 280 "Charger Warning Hysteresis" 281 "Inverter Shutdown Threshold" 282 "Inverter Shutdown Hysteresis" 283 "Inverter Warning Threshold" 284 "Inverter Warning Hysteresis" 285 "Charger Derating Temp Start Point" 286 "Charger Derating Temp End Point" 287 "Charger Recharge Threshold" 300 "Ags Exercise Start" 301 "Ags Exercise Stop" 302 "Ags Quiet Time Begin" 303 "Ags Quiet Time End" 304 "Ags Battery Soc Start" 305 "Ags Battery Soc Stop" 306 "Ags Dc V Start" 307 "Ags Dc V Stop" 308 "Ags Ac I Start" 309 "Ags Ac I Stop" 310 "Ags Contact Start" 311 "Ags Contact Stop" 312 "Ags Float Stop" 313 "Ags Absorp Stop" 314 "Ags Manual On" 315 "Ags Manual Off" 316 "Ags Auto" 317 "Ags External On" 318 "Ags External Off" 319 "Gen External On" 320 "Gen External Off" 321 "Ags External Shutdown" 322 "Ags Auto Off" 323 "Ags Dc I Start" 324 "Ags Dc I Stop" 325 "Ags Ac Power Start" 326 "Ags Ac Power Stop" 400 "Sps Manual Off" 401 "Sps Manual On" 410 "Sps Auto Off" 411 "Sps Auto On" 420 "Sps Auto Off Batt V Low" 421 "Sps Auto On Batt V Low" 422 "Sps Auto Off Batt V High" 423 "Sps Auto On Batt V High" 424 "Sps Auto Off Array V High" 425 "Sps Auto On Array V High" 426 "Sps Auto Off Batt Temp Low" 427 "Sps Auto On Batt Temp Low" 428 "Sps Auto Off Batt Temp High" 429 "Sps Auto On Batt Temp High" 430 "Sps Auto Off Heat Sink Temp High" 431 "Sps Auto On Heat Sink Temp High" 432 "Sps Auto Off Fault" 433 "Sps Auto On Fault" 434 "Aps Check Timeout" 435 "Aps Qualify Timeout" 512 "Resume From Safe" 513 "AC Fault Set" 514 "Invert Fault Set" 515 "Charge Fault Set" 516 "Charger Enable" 517 "Charger Disable" 518 "Inverter Enable" 519 "Inverter Disable" 520 "Charge Suspend On" 521 "Charge Suspend Off" 522 "AC Good" 523 "AC Bad" 524 "Load Sense Enable" 525 "Load Sense Active" 526 "Invert Active" 527 "Bulk Exit" 528 "Absorption Exit" 529 "Float Exit" 530 "Float 3-Stage Set" 531 "Float 2-Stage Set" 532 "Equalize Enable" 533 "Equalize Disable" 534 "Equalize Exit" 535 "Load Sense Disable" 536 "Sell To Grid Enabled" 537 "Sell To Grid Disabled" 538 "Grid Support Enable" 539 "Grid Support Disable" 540 "Gen Support Enable" 541 "Gen Support Disable" 542 "Peak Load Shaving Enable" 543 "Peak Load Shaving Disable" 544 "Peak Load Shaving Tod Start" 545 "Peak Load Shaving Tod Stop" 546 "Unit Off" 547 "System Absorption Exit" 548 "System Inverter Enable" 549 "System AC Good" 550 "Anti Islanding Condition" 551 "Hibernate Timeout" 552 "External Sync Error" 553 "External Suspend Request" 554 "Engaging Charger" 555 "Engaging Gen Support" 556 "Grid Tie Engage Timeout" 557 "Gen Support Engage Timeout" 558 "Charge Engage Timeout" 559 "Inverter Engage Timeout" 560 "Charge Exit Timeout" 561 "Grid Support Entry Amps" 562 "Grid Support Exit Amps" 563 "Gen Support Entry Amps" 564 "Gen Support Exit Amps" 565 "Grid Support Entry Vdc" 566 "Grid Support Exit Vdc" 567 "Low Batt Cut Off Entry Vdc" 568 "Low Batt Recharge Vdc" 569 "Low Batt Cut Off Exit Vdc" 570 "Invert To Bypass Timeout" 571 "Force Charge" 572 "System Engage Bulk Charge" 441 "SPS Auto On External Shutdown Flt" 442 "SPS Auto Off Input Over Volt Flt" 443 "SPS Auto On Input Over Volt Flt" 444 "SPS Auto Off Input Over Volt Err" 445 "SPS Auto On Input Over Volt Err" 446 "SPS Auto Off Input Over Volt Wrn" 447 "SPS Auto On Input Over Volt Wrn" 448 "SPS Auto Off Output Over Volt Err" 449 "SPS Auto On Output Over Volt Err" 450 "SPS Auto Off Output Over Volt Wrn" 451 "SPS Auto On Output Over Volt Wrn" 452 "SPS Auto Off Output Under Volt Err" 453 "SPS Auto On Output Under Volt Err" 454 "SPS Auto Off Output Under Volt Wrn" 455 "SPS Auto On Output Under Volt Wrn" 456 "SPS Auto Off Output Over Curr Err" 457 "SPS Auto On Output Over Curr Err" 458 "SPS Auto Off Batt Over Temp Err" 459 "SPS Auto On Batt Over Temp Err" 460 "SPS Auto Off Batt Over Temp Wrn" 461 "SPS Auto On Batt Over Temp Wrn" 462 "SPS Auto Off Batt Under Temp Wrn" 463 "SPS Auto On Batt Under Temp Wrn" 464 "SPS Auto Off Heatsink Over Temp Err" 465 "SPS Auto On Heatsink Over Temp Err" 466 "SPS Auto Off Heatsink Over Temp Wrn" 467 "SPS Auto On Heatsink Over Temp Wrn" 468 "SPS Auto Off Ambient Over Temp Err" 469 "SPS Auto On Ambient Over Temp Err" 470 "SPS Auto Off Ambient Over Temp Wrn" 471 "SPS Auto On Ambient Over Temp Wrn" 472 "SPS Auto Off Capacitor Over Temp Err" 473 "SPS Auto On Capacitor Over Temp Err" 474 "SPS Auto Off Fan Flt" 475 "SPS Auto On Fan Flt" 476 "SPS Auto Off Fan Err" 477 "SPS Auto On Fan Err" 478 "SPS Auto Off Input Over Curr Err" 479 "SPS Auto On Input Over Curr Err" 480 "SPS Auto Off Output Over Curr Flt" 481 "SPS Auto On Output Over Curr Flt" 482 "SPS Auto Off Network PS Flt" 483 "SPS Auto On Network PS Flt" 484 "SPS Auto Off Setup Flt" 485 "SPS Auto On Setup Flt" 38 "Clear Command User Stats" 573 "AC Good Pending" 574 "Grid Safe" 585 "PLS Time In Float Ready" 575 "Power Conversion Fault" 576 "Low Battery Support Exit" 577 "Grid Support Exit" 578 "GFS Enable" 579 "GFS Disable" 580 "Force Sell" 486 "SPS Auto On Bulk Exit" 487 "SPS Auto Off Bulk Exit" 488 "SPS Auto On Absorption Exit" 489 "SPS Auto Off Absorption Exit" 490 "SPS Auto On State Of Charge Low" 491 "SPS Auto Off State Of Charge Low" 492 "SPS Auto On Time Of Day" 493 "SPS Auto Off Time Of Day" 581 "Sell Time Of Day Start" 582 "Sell Time Of Day Stop" 583 "Aux Port Time Of Day Start" 584 "Aux Port Time Of Day Stop" ;
VAL_ 2147552256 EvtId 436 "SPS Auto Off Array V Low" 437 "SPS Auto On Array V Low" 438 "SPS Auto Off Ground Flt" 439 "SPS Auto On Ground Flt" 440 "SPS Auto Off External Shutdown Flt" 0 "None" 10 "Control Command Hibernate" 11 "Control Command Safe" 12 "Control Command Power Save" 13 "Control Command Operating" 14 "Control Command Diagnostic" 15 "Control Command Last Mode" 20 "Reset Command Reboot" 21 "Reset Command Download" 22 "Reset Command Oem" 23 "Reset Command Factory" 24 "Reset Command Reboot Clear Nv" 25 "Powered Up" 30 "Clear Command Active Faults" 31 "Clear Command Fault Log" 32 "Clear Command Active Warns" 33 "Clear Command Warn Log" 34 "Clear Command State Event Log" 35 "Clear Command Comm Stats" 36 "Clear Command Stats" 37 "Clear Command All" 40 "Date Time Configured" 50 "Warn Cleared" 51 "Fault Cleared" 52 "Fault Set" 60 "User Cfg Changed" 61 "Oem Cfg Changed" 70 "Triggered Fault" 250 "Shutdown Threshold" 251 "Shutdown Hysteresis" 252 "Warning Threshold" 253 "Warning Hysteresis" 254 "Transfer Threshold" 255 "Fan 0 Threshold" 256 "Fan 10 Threshold" 257 "Fan 20 Threshold" 258 "Fan 30 Threshold" 259 "Fan 40 Threshold" 260 "Fan 50 Threshold" 261 "Fan 60 Threshold" 262 "Fan 70 Threshold" 263 "Fan 80 Threshold" 264 "Fan 90 Threshold" 265 "Fan 100 Threshold" 266 "Relay Open Threshold" 267 "Relay Close Threshold" 268 "Charger Derating Ac In V" 269 "Charger Derating Ac In I" 270 "Charger Derating Ext Temp" 271 "Charger Derating Int Temp" 272 "Charger Derating Ripple V" 273 "Lost Ac Threshold" 274 "Lost Ac Hysteresis" 275 "Imm Shutdown Threshold" 276 "Imm Shutdown Hysteresis" 277 "Charger Shutdown Threshold" 278 "Charger Shutdown Hysteresis" 279 "Charger Warning Threshold" 280 "Charger Warning Hysteresis" 281 "Inverter Shutdown Threshold" 282 "Inverter Shutdown Hysteresis" 283 "Inverter Warning Threshold" 284 "Inverter Warning Hysteresis" 285 "Charger Derating Temp Start Point" 286 "Charger Derating Temp End Point" 287 "Charger Recharge Threshold" 300 "Ags Exercise Start" 301 "Ags Exercise Stop" 302 "Ags Quiet Time Begin" 303 "Ags Quiet Time End" 304 "Ags Battery Soc Start" 305 "Ags Battery Soc Stop" 306 "Ags Dc V Start" 307 "Ags Dc V Stop" 308 "Ags Ac I Start" 309 "Ags Ac I Stop" 310 "Ags Contact Start" 311 "Ags Contact Stop" 312 "Ags Float Stop" 313 "Ags Absorp Stop" 314 "Ags Manual On" 315 "Ags Manual Off" 316 "Ags Auto" 317 "Ags External On" 318 "Ags External Off" 319 "Gen External On" 320 "Gen External Off" 321 "Ags External Shutdown" 322 "Ags Auto Off" 323 "Ags Dc I Start" 324 "Ags Dc I Stop" 325 "Ags Ac Power Start" 326 "Ags Ac Power Stop" 400 "Sps Manual Off" 401 "Sps Manual On" 410 "Sps Auto Off" 411 "Sps Auto On" 420 "Sps Auto Off Batt V Low" 421 "Sps Auto On Batt V Low" 422 "Sps Auto Off Batt V High" 423 "Sps Auto On Batt V High" 424 "Sps Auto Off Array V High" 425 "Sps Auto On Array V High" 426 "Sps Auto Off Batt Temp Low" 427 "Sps Auto On Batt Temp Low" 428 "Sps Auto Off Batt Temp High" 429 "Sps Auto On Batt Temp High" 430 "Sps Auto Off Heat Sink Temp High" 431 "Sps Auto On Heat Sink Temp High" 432 "Sps Auto Off Fault" 433 "Sps Auto On Fault" 434 "Aps Check Timeout" 435 "Aps Qualify Timeout" 512 "Resume From Safe" 513 "AC Fault Set" 514 "Invert Fault Set" 515 "Charge Fault Set" 516 "Charger Enable" 517 "Charger Disable" 518 "Inverter Enable" 519 "Inverter Disable" 520 "Charge Suspend On" 521 "Charge Suspend Off" 522 "AC Good" 523 "AC Bad" 524 "Load Sense Enable" 525 "Load Sense Active" 526 "Invert Active" 527 "Bulk Exit" 528 "Absorption Exit" 529 "Float Exit" 530 "Float 3-Stage Set" 531 "Float 2-Stage Set" 532 "Equalize Enable" 533 "Equalize Disable" 534 "Equalize Exit" 535 "Load Sense Disable" 536 "Sell To Grid Enabled" 537 "Sell To Grid Disabled" 538 "Grid Support Enable" 539 "Grid Support Disable" 540 "Gen Support Enable" 541 "Gen Support Disable" 542 "Peak Load Shaving Enable" 543 "Peak Load Shaving Disable" 544 "Peak Load Shaving Tod Start" 545 "Peak Load Shaving Tod Stop" 546 "Unit Off" 547 "System Absorption Exit" 548 "System Inverter Enable" 549 "System AC Good" 550 "Anti Islanding Condition" 551 "Hibernate Timeout" 552 "External Sync Error" 553 "External Suspend Request" 554 "Engaging Charger" 555 "Engaging Gen Support" 556 "Grid Tie Engage Timeout" 557 "Gen Support Engage Timeout" 558 "Charge Engage Timeout" 559 "Inverter Engage Timeout" 560 "Charge Exit Timeout" 561 "Grid Support Entry Amps" 562 "Grid Support Exit Amps" 563 "Gen Support Entry Amps" 564 "Gen Support Exit Amps" 565 "Grid Support Entry Vdc" 566 "Grid Support Exit Vdc" 567 "Low Batt Cut Off Entry Vdc" 568 "Low Batt Recharge Vdc" 569 "Low Batt Cut Off Exit Vdc" 570 "Invert To Bypass Timeout" 571 "Force Charge" 572 "System Engage Bulk Charge" 441 "SPS Auto On External Shutdown Flt" 442 "SPS Auto Off Input Over Volt Flt" 443 "SPS Auto On Input Over Volt Flt" 444 "SPS Auto Off Input Over Volt Err" 445 "SPS Auto On Input Over Volt Err" 446 "SPS Auto Off Input Over Volt Wrn" 447 "SPS Auto On Input Over Volt Wrn" 448 "SPS Auto Off Output Over Volt Err" 449 "SPS Auto On Output Over Volt Err" 450 "SPS Auto Off Output Over Volt Wrn" 451 "SPS Auto On Output Over Volt Wrn" 452 "SPS Auto Off Output Under Volt Err" 453 "SPS Auto On Output Under Volt Err" 454 "SPS Auto Off Output Under Volt Wrn" 455 "SPS Auto On Output Under Volt Wrn" 456 "SPS Auto Off Output Over Curr Err" 457 "SPS Auto On Output Over Curr Err" 458 "SPS Auto Off Batt Over Temp Err" 459 "SPS Auto On Batt Over Temp Err" 460 "SPS Auto Off Batt Over Temp Wrn" 461 "SPS Auto On Batt Over Temp Wrn" 462 "SPS Auto Off Batt Under Temp Wrn" 463 "SPS Auto On Batt Under Temp Wrn" 464 "SPS Auto Off Heatsink Over Temp Err" 465 "SPS Auto On Heatsink Over Temp Err" 466 "SPS Auto Off Heatsink Over Temp Wrn" 467 "SPS Auto On Heatsink Over Temp Wrn" 468 "SPS Auto Off Ambient Over Temp Err" 469 "SPS Auto On Ambient Over Temp Err" 470 "SPS Auto Off Ambient Over Temp Wrn" 471 "SPS Auto On Ambient Over Temp Wrn" 472 "SPS Auto Off Capacitor Over Temp Err" 473 "SPS Auto On Capacitor Over Temp Err" 474 "SPS Auto Off Fan Flt" 475 "SPS Auto On Fan Flt" 476 "SPS Auto Off Fan Err" 477 "SPS Auto On Fan Err" 478 "SPS Auto Off Input Over Curr Err" 479 "SPS Auto On Input Over Curr Err" 480 "SPS Auto Off Output Over Curr Flt" 481 "SPS Auto On Output Over Curr Flt" 482 "SPS Auto Off Network PS Flt" 483 "SPS Auto On Network PS Flt" 484 "SPS Auto Off Setup Flt" 485 "SPS Auto On Setup Flt" 38 "Clear Command User Stats" 573 "AC Good Pending" 574 "Grid Safe" 585 "PLS Time In Float Ready" 575 "Power Conversion Fault" 576 "Low Battery Support Exit" 577 "Grid Support Exit" 578 "GFS Enable" 579 "GFS Disable" 580 "Force Sell" 486 "SPS Auto On Bulk Exit" 487 "SPS Auto Off Bulk Exit" 488 "SPS Auto On Absorption Exit" 489 "SPS Auto Off Absorption Exit" 490 "SPS Auto On State Of Charge Low" 491 "SPS Auto Off State Of Charge Low" 492 "SPS Auto On Time Of Day" 493 "SPS Auto Off Time Of Day" 581 "Sell Time Of Day Start" 582 "Sell Time Of Day Stop" 583 "Aux Port Time Of Day Start" 584 "Aux Port Time Of Day Stop" ;
VAL_ 2147552256 CfgType 0 "User" 1 "OEM" 2 "Factory" 3 "Reserved" ;
VAL_ 2147552256 AcSrcId 0 "Invalid" 1 "None" 2 "Anonymous" 3 "Shore1" 4 "Shore2" 5 "Shore3" 6 "Shore4" 7 "Shore5" 8 "Shore6" 9 "Shore7" 10 "Shore8" 11 "Shore9" 12 "Shore10" 13 "Shore11" 14 "Shore12" 15 "Shore13" 16 "Shore14" 17 "Shore15" 18 "Shore16" 19 "Gen1" 20 "Gen2" 21 "Gen3" 22 "Gen4" 23 "Gen5" 24 "Gen6" 25 "Gen7" 26 "Gen8" 27 "Gen9" 28 "Gen10" 29 "Gen11" 30 "Gen12" 31 "Gen13" 32 "Gen14" 33 "Gen15" 34 "Gen16" 35 "AC1" 36 "AC2" 37 "AC3" 38 "AC4" 39 "AC5" 40 "AC6" 41 "AC7" 42 "AC8" 43 "AC9" 44 "AC10" 45 "AC11" 46 "AC12" 47 "AC13" 48 "AC14" 49 "AC15" 50 "AC16" 51 "AC Load1" 52 "AC Load2" 53 "AC Load3" 54 "AC Load4" 55 "AC Load5" 56 "AC Load6" 57 "AC Load7" 58 "AC Load8" 59 "AC Load9" 60 "AC Load10" 61 "AC Load11" 62 "AC Load12" 63 "AC Load13" 64 "AC Load14" 65 "AC Load15" 66 "AC Load16" 67 "Grid1" 68 "Grid2" 69 "Grid3" 70 "Grid4" 71 "Grid5" 72 "Grid6" 73 "Grid7" 74 "Grid8" 75 "Grid9" 76 "Grid10" 77 "Grid11" 78 "Grid12" 79 "Grid13" 80 "Grid14" 81 "Grid15" 82 "Grid16" 252 "All" 253 "Reserved" 254 "Out Of Range" 255 "Data Not Available Do Not Change" ;
VAL_ 2147569152 RefEvtId 436 "SPS Auto Off Array V Low" 437 "SPS Auto On Array V Low" 438 "SPS Auto Off Ground Flt" 439 "SPS Auto On Ground Flt" 440 "SPS Auto Off External Shutdown Flt" 0 "None" 10 "Control Command Hibernate" 11 "Control Command Safe" 12 "Control Command Power Save" 13 "Control Command Operating" 14 "Control Command Diagnostic" 15 "Control Command Last Mode" 20 "Reset Command Reboot" 21 "Reset Command Download" 22 "Reset Command Oem" 23 "Reset Command Factory" 24 "Reset Command Reboot Clear Nv" 25 "Powered Up" 30 "Clear Command Active Faults" 31 "Clear Command Fault Log" 32 "Clear Command Active Warns" 33 "Clear Command Warn Log" 34 "Clear Command State Event Log" 35 "Clear Command Comm Stats" 36 "Clear Command Stats" 37 "Clear Command All" 40 "Date Time Configured" 50 "Warn Cleared" 51 "Fault Cleared" 52 "Fault Set" 60 "User Cfg Changed" 61 "Oem Cfg Changed" 70 "Triggered Fault" 250 "Shutdown Threshold" 251 "Shutdown Hysteresis" 252 "Warning Threshold" 253 "Warning Hysteresis" 254 "Transfer Threshold" 255 "Fan 0 Threshold" 256 "Fan 10 Threshold" 257 "Fan 20 Threshold" 258 "Fan 30 Threshold" 259 "Fan 40 Threshold" 260 "Fan 50 Threshold" 261 "Fan 60 Threshold" 262 "Fan 70 Threshold" 263 "Fan 80 Threshold" 264 "Fan 90 Threshold" 265 "Fan 100 Threshold" 266 "Relay Open Threshold" 267 "Relay Close Threshold" 268 "Charger Derating Ac In V" 269 "Charger Derating Ac In I" 270 "Charger Derating Ext Temp" 271 "Charger Derating Int Temp" 272 "Charger Derating Ripple V" 273 "Lost Ac Threshold" 274 "Lost Ac Hysteresis" 275 "Imm Shutdown Threshold" 276 "Imm Shutdown Hysteresis" 277 "Charger Shutdown Threshold" 278 "Charger Shutdown Hysteresis" 279 "Charger Warning Threshold" 280 "Charger Warning Hysteresis" 281 "Inverter Shutdown Threshold" 282 "Inverter Shutdown Hysteresis" 283 "Inverter Warning Threshold" 284 "Inverter Warning Hysteresis" 285 "Charger Derating Temp Start Point" 286 "Charger Derating Temp End Point" 287 "Charger Recharge Threshold" 300 "Ags Exercise Start" 301 "Ags Exercise Stop" 302 "Ags Quiet Time Begin" 303 "Ags Quiet Time End" 304 "Ags Battery Soc Start" 305 "Ags Battery Soc Stop" 306 "Ags Dc V Start" 307 "Ags Dc V Stop" 308 "Ags Ac I Start" 309 "Ags Ac I Stop" 310 "Ags Contact Start" 311 "Ags Contact Stop" 312 "Ags Float Stop" 313 "Ags Absorp Stop" 314 "Ags Manual On" 315 "Ags Manual Off" 316 "Ags Auto" 317 "Ags External On" 318 "Ags External Off" 319 "Gen External On" 320 "Gen External Off" 321 "Ags External Shutdown" 322 "Ags Auto Off" 323 "Ags Dc I Start" 324 "Ags Dc I Stop" 325 "Ags Ac Power Start" 326 "Ags Ac Power Stop" 400 "Sps Manual Off" 401 "Sps Manual On" 410 "Sps Auto Off" 411 "Sps Auto On" 420 "Sps Auto Off Batt V Low" 421 "Sps Auto On Batt V Low" 422 "Sps Auto Off Batt V High" 423 "Sps Auto On Batt V High" 424 "Sps Auto Off Array V High" 425 "Sps Auto On Array V High" 426 "Sps Auto Off Batt Temp Low" 427 "Sps Auto On Batt Temp Low" 428 "Sps Auto Off Batt Temp High" 429 "Sps Auto On Batt Temp High" 430 "Sps Auto Off Heat Sink Temp High" 431 "Sps Auto On Heat Sink Temp High" 432 "Sps Auto Off Fault" 433 "Sps Auto On Fault" 434 "Aps Check Timeout" 435 "Aps Qualify Timeout" 512 "Resume From Safe" 513 "AC Fault Set" 514 "Invert Fault Set" 515 "Charge Fault Set" 516 "Charger Enable" 517 "Charger Disable" 518 "Inverter Enable" 519 "Inverter Disable" 520 "Charge Suspend On" 521 "Charge Suspend Off" 522 "AC Good" 523 "AC Bad" 524 "Load Sense Enable" 525 "Load Sense Active" 526 "Invert Active" 527 "Bulk Exit" 528 "Absorption Exit" 529 "Float Exit" 530 "Float 3-Stage Set" 531 "Float 2-Stage Set" 532 "Equalize Enable" 533 "Equalize Disable" 534 "Equalize Exit" 535 "Load Sense Disable" 536 "Sell To Grid Enabled" 537 "Sell To Grid Disabled" 538 "Grid Support Enable" 539 "Grid Support Disable" 540 "Gen Support Enable" 541 "Gen Support Disable" 542 "Peak Load Shaving Enable" 543 "Peak Load Shaving Disable" 544 "Peak Load Shaving Tod Start" 545 "Peak Load Shaving Tod Stop" 546 "Unit Off" 547 "System Absorption Exit" 548 "System Inverter Enable" 549 "System AC Good" 550 "Anti Islanding Condition" 551 "Hibernate Timeout" 552 "External Sync Error" 553 "External Suspend Request" 554 "Engaging Charger" 555 "Engaging Gen Support" 556 "Grid Tie Engage Timeout" 557 "Gen Support Engage Timeout" 558 "Charge Engage Timeout" 559 "Inverter Engage Timeout" 560 "Charge Exit Timeout" 561 "Grid Support Entry Amps" 562 "Grid Support Exit Amps" 563 "Gen Support Entry Amps" 564 "Gen Support Exit Amps" 565 "Grid Support Entry Vdc" 566 "Grid Support Exit Vdc" 567 "Low Batt Cut Off Entry Vdc" 568 "Low Batt Recharge Vdc" 569 "Low Batt Cut Off Exit Vdc" 570 "Invert To Bypass Timeout" 571 "Force Charge" 572 "System Engage Bulk Charge" 441 "SPS Auto On External Shutdown Flt" 442 "SPS Auto Off Input Over Volt Flt" 443 "SPS Auto On Input Over Volt Flt" 444 "SPS Auto Off Input Over Volt Err" 445 "SPS Auto On Input Over Volt Err" 446 "SPS Auto Off Input Over Volt Wrn" 447 "SPS Auto On Input Over Volt Wrn" 448 "SPS Auto Off Output Over Volt Err" 449 "SPS Auto On Output Over Volt Err" 450 "SPS Auto Off Output Over Volt Wrn" 451 "SPS Auto On Output Over Volt Wrn" 452 "SPS Auto Off Output Under Volt Err" 453 "SPS Auto On Output Under Volt Err" 454 "SPS Auto Off Output Under Volt Wrn" 455 "SPS Auto On Output Under Volt Wrn" 456 "SPS Auto Off Output Over Curr Err" 457 "SPS Auto On Output Over Curr Err" 458 "SPS Auto Off Batt Over Temp Err" 459 "SPS Auto On Batt Over Temp Err" 460 "SPS Auto Off Batt Over Temp Wrn" 461 "SPS Auto On Batt Over Temp Wrn" 462 "SPS Auto Off Batt Under Temp Wrn" 463 "SPS Auto On Batt Under Temp Wrn" 464 "SPS Auto Off Heatsink Over Temp Err" 465 "SPS Auto On Heatsink Over Temp Err" 466 "SPS Auto Off Heatsink Over Temp Wrn" 467 "SPS Auto On Heatsink Over Temp Wrn" 468 "SPS Auto Off Ambient Over Temp Err" 469 "SPS Auto On Ambient Over Temp Err" 470 "SPS Auto Off Ambient Over Temp Wrn" 471 "SPS Auto On Ambient Over Temp Wrn" 472 "SPS Auto Off Capacitor Over Temp Err" 473 "SPS Auto On Capacitor Over Temp Err" 474 "SPS Auto Off Fan Flt" 475 "SPS Auto On Fan Flt" 476 "SPS Auto Off Fan Err" 477 "SPS Auto On Fan Err" 478 "SPS Auto Off Input Over Curr Err" 479 "SPS Auto On Input Over Curr Err" 480 "SPS Auto Off Output Over Curr Flt" 481 "SPS Auto On Output Over Curr Flt" 482 "SPS Auto Off Network PS Flt" 483 "SPS Auto On Network PS Flt" 484 "SPS Auto Off Setup Flt" 485 "SPS Auto On Setup Flt" 38 "Clear Command User Stats" 573 "AC Good Pending" 574 "Grid Safe" 585 "PLS Time In Float Ready" 575 "Power Conversion Fault" 576 "Low Battery Support Exit" 577 "Grid Support Exit" 578 "GFS Enable" 579 "GFS Disable" 580 "Force Sell" 486 "SPS Auto On Bulk Exit" 487 "SPS Auto Off Bulk Exit" 488 "SPS Auto On Absorption Exit" 489 "SPS Auto Off Absorption Exit" 490 "SPS Auto On State Of Charge Low" 491 "SPS Auto Off State Of Charge Low" 492 "SPS Auto On Time Of Day" 493 "SPS Auto Off Time Of Day" 581 "Sell Time Of Day Start" 582 "Sell Time Of Day Stop" 583 "Aux Port Time Of Day Start" 584 "Aux Port Time Of Day Stop" ;
VAL_ 2147569152 EvtId 436 "SPS Auto Off Array V Low" 437 "SPS Auto On Array V Low" 438 "SPS Auto Off Ground Flt" 439 "SPS Auto On Ground Flt" 440 "SPS Auto Off External Shutdown Flt" 0 "None" 10 "Control Command Hibernate" 11 "Control Command Safe" 12 "Control Command Power Save" 13 "Control Command Operating" 14 "Control Command Diagnostic" 15 "Control Command Last Mode" 20 "Reset Command Reboot" 21 "Reset Command Download" 22 "Reset Command Oem" 23 "Reset Command Factory" 24 "Reset Command Reboot Clear Nv" 25 "Powered Up" 30 "Clear Command Active Faults" 31 "Clear Command Fault Log" 32 "Clear Command Active Warns" 33 "Clear Command Warn Log" 34 "Clear Command State Event Log" 35 "Clear Command Comm Stats" 36 "Clear Command Stats" 37 "Clear Command All" 40 "Date Time Configured" 50 "Warn Cleared" 51 "Fault Cleared" 52 "Fault Set" 60 "User Cfg Changed" 61 "Oem Cfg Changed" 70 "Triggered Fault" 250 "Shutdown Threshold" 251 "Shutdown Hysteresis" 252 "Warning Threshold" 253 "Warning Hysteresis" 254 "Transfer Threshold" 255 "Fan 0 Threshold" 256 "Fan 10 Threshold" 257 "Fan 20 Threshold" 258 "Fan 30 Threshold" 259 "Fan 40 Threshold" 260 "Fan 50 Threshold" 261 "Fan 60 Threshold" 262 "Fan 70 Threshold" 263 "Fan 80 Threshold" 264 "Fan 90 Threshold" 265 "Fan 100 Threshold" 266 "Relay Open Threshold" 267 "Relay Close Threshold" 268 "Charger Derating Ac In V" 269 "Charger Derating Ac In I" 270 "Charger Derating Ext Temp" 271 "Charger Derating Int Temp" 272 "Charger Derating Ripple V" 273 "Lost Ac Threshold" 274 "Lost Ac Hysteresis" 275 "Imm Shutdown Threshold" 276 "Imm Shutdown Hysteresis" 277 "Charger Shutdown Threshold" 278 "Charger Shutdown Hysteresis" 279 "Charger Warning Threshold" 280 "Charger Warning Hysteresis" 281 "Inverter Shutdown Threshold" 282 "Inverter Shutdown Hysteresis" 283 "Inverter Warning Threshold" 284 "Inverter Warning Hysteresis" 285 "Charger Derating Temp Start Point" 286 "Charger Derating Temp End Point" 287 "Charger Recharge Threshold" 300 "Ags Exercise Start" 301 "Ags Exercise Stop" 302 "Ags Quiet Time Begin" 303 "Ags Quiet Time End" 304 "Ags Battery Soc Start" 305 "Ags Battery Soc Stop" 306 "Ags Dc V Start" 307 "Ags Dc V Stop" 308 "Ags Ac I Start" 309 "Ags Ac I Stop" 310 "Ags Contact Start" 311 "Ags Contact Stop" 312 "Ags Float Stop" 313 "Ags Absorp Stop" 314 "Ags Manual On" 315 "Ags Manual Off" 316 "Ags Auto" 317 "Ags External On" 318 "Ags External Off" 319 "Gen External On" 320 "Gen External Off" 321 "Ags External Shutdown" 322 "Ags Auto Off" 323 "Ags Dc I Start" 324 "Ags Dc I Stop" 325 "Ags Ac Power Start" 326 "Ags Ac Power Stop" 400 "Sps Manual Off" 401 "Sps Manual On" 410 "Sps Auto Off" 411 "Sps Auto On" 420 "Sps Auto Off Batt V Low" 421 "Sps Auto On Batt V Low" 422 "Sps Auto Off Batt V High" 423 "Sps Auto On Batt V High" 424 "Sps Auto Off Array V High" 425 "Sps Auto On Array V High" 426 "Sps Auto Off Batt Temp Low" 427 "Sps Auto On Batt Temp Low" 428 "Sps Auto Off Batt Temp High" 429 "Sps Auto On Batt Temp High" 430 "Sps Auto Off Heat Sink Temp High" 431 "Sps Auto On Heat Sink Temp High" 432 "Sps Auto Off Fault" 433 "Sps Auto On Fault" 434 "Aps Check Timeout" 435 "Aps Qualify Timeout" 512 "Resume From Safe" 513 "AC Fault Set" 514 "Invert Fault Set" 515 "Charge Fault Set" 516 "Charger Enable" 517 "Charger Disable" 518 "Inverter Enable" 519 "Inverter Disable" 520 "Charge Suspend On" 521 "Charge Suspend Off" 522 "AC Good" 523 "AC Bad" 524 "Load Sense Enable" 525 "Load Sense Active" 526 "Invert Active" 527 "Bulk Exit" 528 "Absorption Exit" 529 "Float Exit" 530 "Float 3-Stage Set" 531 "Float 2-Stage Set" 532 "Equalize Enable" 533 "Equalize Disable" 534 "Equalize Exit" 535 "Load Sense Disable" 536 "Sell To Grid Enabled" 537 "Sell To Grid Disabled" 538 "Grid Support Enable" 539 "Grid Support Disable" 540 "Gen Support Enable" 541 "Gen Support Disable" 542 "Peak Load Shaving Enable" 543 "Peak Load Shaving Disable" 544 "Peak Load Shaving Tod Start" 545 "Peak Load Shaving Tod Stop" 546 "Unit Off" 547 "System Absorption Exit" 548 "System Inverter Enable" 549 "System AC Good" 550 "Anti Islanding Condition" 551 "Hibernate Timeout" 552 "External Sync Error" 553 "External Suspend Request" 554 "Engaging Charger" 555 "Engaging Gen Support" 556 "Grid Tie Engage Timeout" 557 "Gen Support Engage Timeout" 558 "Charge Engage Timeout" 559 "Inverter Engage Timeout" 560 "Charge Exit Timeout" 561 "Grid Support Entry Amps" 562 "Grid Support Exit Amps" 563 "Gen Support Entry Amps" 564 "Gen Support Exit Amps" 565 "Grid Support Entry Vdc" 566 "Grid Support Exit Vdc" 567 "Low Batt Cut Off Entry Vdc" 568 "Low Batt Recharge Vdc" 569 "Low Batt Cut Off Exit Vdc" 570 "Invert To Bypass Timeout" 571 "Force Charge" 572 "System Engage Bulk Charge" 441 "SPS Auto On External Shutdown Flt" 442 "SPS Auto Off Input Over Volt Flt" 443 "SPS Auto On Input Over Volt Flt" 444 "SPS Auto Off Input Over Volt Err" 445 "SPS Auto On Input Over Volt Err" 446 "SPS Auto Off Input Over Volt Wrn" 447 "SPS Auto On Input Over Volt Wrn" 448 "SPS Auto Off Output Over Volt Err" 449 "SPS Auto On Output Over Volt Err" 450 "SPS Auto Off Output Over Volt Wrn" 451 "SPS Auto On Output Over Volt Wrn" 452 "SPS Auto Off Output Under Volt Err" 453 "SPS Auto On Output Under Volt Err" 454 "SPS Auto Off Output Under Volt Wrn" 455 "SPS Auto On Output Under Volt Wrn" 456 "SPS Auto Off Output Over Curr Err" 457 "SPS Auto On Output Over Curr Err" 458 "SPS Auto Off Batt Over Temp Err" 459 "SPS Auto On Batt Over Temp Err" 460 "SPS Auto Off Batt Over Temp Wrn" 461 "SPS Auto On Batt Over Temp Wrn" 462 "SPS Auto Off Batt Under Temp Wrn" 463 "SPS Auto On Batt Under Temp Wrn" 464 "SPS Auto Off Heatsink Over Temp Err" 465 "SPS Auto On Heatsink Over Temp Err" 466 "SPS Auto Off Heatsink Over Temp Wrn" 467 "SPS Auto On Heatsink Over Temp Wrn" 468 "SPS Auto Off Ambient Over Temp Err" 469 "SPS Auto On Ambient Over Temp Err" 470 "SPS Auto Off Ambient Over Temp Wrn" 471 "SPS Auto On Ambient Over Temp Wrn" 472 "SPS Auto Off Capacitor Over Temp Err" 473 "SPS Auto On Capacitor Over Temp Err" 474 "SPS Auto Off Fan Flt" 475 "SPS Auto On Fan Flt" 476 "SPS Auto Off Fan Err" 477 "SPS Auto On Fan Err" 478 "SPS Auto Off Input Over Curr Err" 479 "SPS Auto On Input Over Curr Err" 480 "SPS Auto Off Output Over Curr Flt" 481 "SPS Auto On Output Over Curr Flt" 482 "SPS Auto Off Network PS Flt" 483 "SPS Auto On Network PS Flt" 484 "SPS Auto Off Setup Flt" 485 "SPS Auto On Setup Flt" 38 "Clear Command User Stats" 573 "AC Good Pending" 574 "Grid Safe" 585 "PLS Time In Float Ready" 575 "Power Conversion Fault" 576 "Low Battery Support Exit" 577 "Grid Support Exit" 578 "GFS Enable" 579 "GFS Disable" 580 "Force Sell" 486 "SPS Auto On Bulk Exit" 487 "SPS Auto Off Bulk Exit" 488 "SPS Auto On Absorption Exit" 489 "SPS Auto Off Absorption Exit" 490 "SPS Auto On State Of Charge Low" 491 "SPS Auto Off State Of Charge Low" 492 "SPS Auto On Time Of Day" 493 "SPS Auto Off Time Of Day" 581 "Sell Time Of Day Start" 582 "Sell Time Of Day Stop" 583 "Aux Port Time Of Day Start" 584 "Aux Port Time Of Day Stop" ;
VAL_ 2147569152 CfgType 0 "User" 1 "OEM" 2 "Factory" 3 "Reserved" ;
VAL_ 2147569152 AcSrcId 0 "Invalid" 1 "None" 2 "Anonymous" 3 "Shore1" 4 "Shore2" 5 "Shore3" 6 "Shore4" 7 "Shore5" 8 "Shore6" 9 "Shore7" 10 "Shore8" 11 "Shore9" 12 "Shore10" 13 "Shore11" 14 "Shore12" 15 "Shore13" 16 "Shore14" 17 "Shore15" 18 "Shore16" 19 "Gen1" 20 "Gen2" 21 "Gen3" 22 "Gen4" 23 "Gen5" 24 "Gen6" 25 "Gen7" 26 "Gen8" 27 "Gen9" 28 "Gen10" 29 "Gen11" 30 "Gen12" 31 "Gen13" 32 "Gen14" 33 "Gen15" 34 "Gen16" 35 "AC1" 36 "AC2" 37 "AC3" 38 "AC4" 39 "AC5" 40 "AC6" 41 "AC7" 42 "AC8" 43 "AC9" 44 "AC10" 45 "AC11" 46 "AC12" 47 "AC13" 48 "AC14" 49 "AC15" 50 "AC16" 51 "AC Load1" 52 "AC Load2" 53 "AC Load3" 54 "AC Load4" 55 "AC Load5" 56 "AC Load6" 57 "AC Load7" 58 "AC Load8" 59 "AC Load9" 60 "AC Load10" 61 "AC Load11" 62 "AC Load12" 63 "AC Load13" 64 "AC Load14" 65 "AC Load15" 66 "AC Load16" 67 "Grid1" 68 "Grid2" 69 "Grid3" 70 "Grid4" 71 "Grid5" 72 "Grid6" 73 "Grid7" 74 "Grid8" 75 "Grid9" 76 "Grid10" 77 "Grid11" 78 "Grid12" 79 "Grid13" 80 "Grid14" 81 "Grid15" 82 "Grid16" 252 "All" 253 "Reserved" 254 "Out Of Range" 255 "Data Not Available Do Not Change" ;
VAL_ 2147558912 CfgType 0 "User" 1 "OEM" 2 "Factory" 3 "Reserved" ;
VAL_ 2147558912 AcSrcId 0 "Invalid" 1 "None" 2 "Anonymous" 3 "Shore1" 4 "Shore2" 5 "Shore3" 6 "Shore4" 7 "Shore5" 8 "Shore6" 9 "Shore7" 10 "Shore8" 11 "Shore9" 12 "Shore10" 13 "Shore11" 14 "Shore12" 15 "Shore13" 16 "Shore14" 17 "Shore15" 18 "Shore16" 19 "Gen1" 20 "Gen2" 21 "Gen3" 22 "Gen4" 23 "Gen5" 24 "Gen6" 25 "Gen7" 26 "Gen8" 27 "Gen9" 28 "Gen10" 29 "Gen11" 30 "Gen12" 31 "Gen13" 32 "Gen14" 33 "Gen15" 34 "Gen16" 35 "AC1" 36 "AC2" 37 "AC3" 38 "AC4" 39 "AC5" 40 "AC6" 41 "AC7" 42 "AC8" 43 "AC9" 44 "AC10" 45 "AC11" 46 "AC12" 47 "AC13" 48 "AC14" 49 "AC15" 50 "AC16" 51 "AC Load1" 52 "AC Load2" 53 "AC Load3" 54 "AC Load4" 55 "AC Load5" 56 "AC Load6" 57 "AC Load7" 58 "AC Load8" 59 "AC Load9" 60 "AC Load10" 61 "AC Load11" 62 "AC Load12" 63 "AC Load13" 64 "AC Load14" 65 "AC Load15" 66 "AC Load16" 67 "Grid1" 68 "Grid2" 69 "Grid3" 70 "Grid4" 71 "Grid5" 72 "Grid6" 73 "Grid7" 74 "Grid8" 75 "Grid9" 76 "Grid10" 77 "Grid11" 78 "Grid12" 79 "Grid13" 80 "Grid14" 81 "Grid15" 82 "Grid16" 252 "All" 253 "Reserved" 254 "Out Of Range" 255 "Data Not Available Do Not Change" ;
